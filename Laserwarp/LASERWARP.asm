; ============================================================================
;  LASERWARP  -  Amstrad CPC  (Amsoft / Mikro-Gen, 1985)  /  'Attaque au Laser'
;  Original game code: Chris Hinsley.
;  FULL disassembly reconstructed from the cassette image 'Laserwarp (E).cdt'.
; ----------------------------------------------------------------------------
;  SOURCE: a TZX/CDT tape holding TWO files:
;    1. BASIC loader  - type &01, loads at &0170 (title screen + loader).
;    2. Machine code  - type &02, 10 blocks loading at &4000,&4800,...,&8800,
;       forming one contiguous image &4000-&88FF (18,688 bytes).
;  All 95 tape data-chunks pass their CRC-16/CCITT checks, so this image is an
;  EXACT reconstruction of the original (verified, complete, uncracked).
;
;  This supersedes the earlier LASERWRP.BIN rip, which was a cracked PARTIAL
;  copy (only ~&4000-&73xx, with a 20-byte 'CHANY from NPS' tag at &3FEC and
;  modified/garbled data). The tape version is clean and contains the MAIN LOOP
;  at &75FE that was missing before.
;
;  ENTRY  &4000 : call snd_init (&4008); jp main (&75FE)
;  MAIN   &75FE : ld hl,&4118; call print_string; set lives=3; run the game
;
;  MEMORY MAP (run-time):
;    &4000-&4007  entry stub
;    &4008-&4064  sound + ink initialisation
;    &4065-&414F  envelope / sound-effect / ink / status-panel data
;    &4150-&6865  sprite & character graphics (~10 KB)
;    &6866-&7BC8  game routines (drawing, movement, collision, scoring, main loop)
;    &7BC9-&8881  'THE MASTER' message text, enemy names, UI strings
;    &8882-&88FF  small trailing tables
;
;  METHOD: recursive-descent trace from the real entry point &4000 (the main
;  loop at &75FE is now present, so this is genuine flow-traced code, not a
;  guess). Bytes not reached by the trace are shown as DEFB data. Every byte of
;  the &4000-&88FF image is accounted for.
; ============================================================================

; --- CPC firmware jumpblock entries referenced by the code ---
f_BB03     equ &BB03        ; KM RESET
f_BB09     equ &BB09        ; KM READ CHAR
f_BB1E     equ &BB1E        ; KM TEST KEY
f_BB24     equ &BB24        ; KM GET JOYSTICK
f_BB5A     equ &BB5A        ; TXT OUTPUT
f_BCAA     equ &BCAA        ; SOUND QUEUE
f_BCBC     equ &BCBC        ; SOUND AMPL ENVELOPE
f_BCBF     equ &BCBF        ; SOUND TONE ENVELOPE

            org   &4000

entry:
            call snd_init               ; 4000
            jp main                     ; 4003

; -------- &4006+  data / tables --------
            defb &00,&00                                  ; 4006 '..'
snd_init:
            ld hl,&4065                 ; 4008
            ld a,&01                    ; 400B
            call &BCBC                  ; SOUND AMPL ENVELOPE
            ld hl,&4069                 ; 4010
            ld a,&02                    ; 4013
            call &BCBC                  ; SOUND AMPL ENVELOPE
            ld hl,&406D                 ; 4018
            ld a,&03                    ; 401B
            call &BCBC                  ; SOUND AMPL ENVELOPE
            ld hl,&4071                 ; 4020
            ld a,&04                    ; 4023
            call &BCBC                  ; SOUND AMPL ENVELOPE
            ld hl,&4075                 ; 4028
            ld a,&05                    ; 402B
            call &BCBC                  ; SOUND AMPL ENVELOPE
            ld hl,&407F                 ; 4030
            ld a,&06                    ; 4033
            call &BCBC                  ; SOUND AMPL ENVELOPE
            ld hl,&4083                 ; 4038
            ld a,&01                    ; 403B
            call &BCBF                  ; SOUND TONE ENVELOPE
            ld hl,&408A                 ; 4040
            ld a,&02                    ; 4043
            call &BCBF                  ; SOUND TONE ENVELOPE
            ld hl,&4091                 ; 4048
            ld a,&03                    ; 404B
            call &BCBF                  ; SOUND TONE ENVELOPE
            ld hl,&4098                 ; 4050
            ld a,&04                    ; 4053
            call &BCBF                  ; SOUND TONE ENVELOPE
            ld hl,&40D2                 ; 4058
print_string:
            ld a,(hl)                   ; 405B
            cp &FF                      ; 405C
            ret z                       ; 405E
            call &BB5A                  ; TXT OUTPUT
            inc hl                      ; 4062
            jr print_string             ; 4063

; -------- &4065+  Sound envelopes, sound-effect blocks, ink + status-panel strings --------
            defb &01,&0F,&FF,&03,&01,&0F,&FF,&05          ; 4065 '........'
            defb &01,&08,&01,&06,&01,&07,&FE,&28          ; 406D '.......('
            defb &03,&0A,&00,&01,&0A,&FF,&06,&05          ; 4075 '........'
            defb &FF,&07,&01,&0F,&FF,&3C,&02,&00          ; 407D '.....<..'
            defb &3C,&01,&78,&03,&01,&02,&00,&32          ; 4085 '<.x....2'
            defb &01,&64,&01,&01,&02,&00,&14,&01          ; 408D '.d......'
            defb &64,&00,&01,&01,&64,&01,&05,&81          ; 4095 'd...d...'
            defb &01,&01,&00,&00,&00,&0F,&00,&00          ; 409D '........'
            defb &82,&02,&00,&00,&00,&06,&0F,&00          ; 40A5 '........'
            defb &00,&84,&03,&02,&00,&00,&00,&03          ; 40AD '........'
            defb &00,&00,&81,&04,&00,&00,&00,&10          ; 40B5 '........'
            defb &0F,&00,&00,&82,&05,&03,&00,&00          ; 40BD '........'
            defb &00,&0F,&00,&00,&82,&06,&04,&64          ; 40C5 '.......d'
            defb &00,&00,&0F,&00,&00,&04,&20,&1C          ; 40CD '...... .'
            defb &00,&20,&20,&1C,&01,&21,&21,&1C          ; 40D5 '.  ..!!.'
            defb &02,&22,&22,&1C,&03,&23,&23,&1C          ; 40DD '.""..##.'
            defb &04,&29,&29,&1C,&05,&2C,&2C,&1C          ; 40E5 '.))..,,.'
            defb &06,&2D,&2D,&1C,&07,&2F,&2F,&1D          ; 40ED '.--..//.'
            defb &00,&00,&1C,&08,&30,&30,&1C,&09          ; 40F5 '....00..'
            defb &32,&32,&1C,&0A,&38,&38,&1C,&0B          ; 40FD '22..88..'
            defb &28,&28,&1C,&0C,&3A,&3A,&1C,&0D          ; 4105 '((..::..'
            defb &27,&27,&1C,&0E,&26,&26,&1C,&0F          ; 410D '''..&&..'
            defb &2A,&2A,&FF,&0F,&09,&1F,&01,&01          ; 4115 '**......'
            defb &53,&43,&4F,&52,&45,&3D,&0F,&0F          ; 411D 'SCORE=..'
            defb &30,&30,&30,&30,&30,&30,&1F,&01          ; 4125 '000000..'
            defb &03,&2D,&2D,&2D,&2D,&2D,&2D,&2D          ; 412D '.-------'
            defb &2D,&2D,&2D,&2D,&2D,&2D,&2D,&2D          ; 4135 '--------'
            defb &2D,&2D,&2D,&2D,&2D,&1F,&01,&02          ; 413D '-----...'
            defb &0F,&0D,&53,&45,&43,&54,&49,&4F          ; 4145 '..SECTIO'
            defb &4E,&3D,&FF                              ; 414D 'N=.'
sub_4150:
            ld a,(hl)                   ; 4150
            cp &FE                      ; 4151
            ret z                       ; 4153
            ld (hl),&FF                 ; 4154
            inc hl                      ; 4156
            jr sub_4150                 ; 4157

; -------- &4159+  GRAPHICS DATA - sprite & character bitmaps (enemies, player, explosions) --------
            defb &00,&C0,&00,&C8,&00,&D0,&00,&D8          ; 4159 '........'
            defb &00,&E0,&00,&E8,&00,&F0,&00,&F8          ; 4161 '........'
            defb &50,&C0,&50,&C8,&50,&D0,&50,&D8          ; 4169 'P.P.P.P.'
            defb &50,&E0,&50,&E8,&50,&F0,&50,&F8          ; 4171 'P.P.P.P.'
            defb &A0,&C0,&A0,&C8,&A0,&D0,&A0,&D8          ; 4179 '........'
            defb &A0,&E0,&A0,&E8,&A0,&F0,&A0,&F8          ; 4181 '........'
            defb &F0,&C0,&F0,&C8,&F0,&D0,&F0,&D8          ; 4189 '........'
            defb &F0,&E0,&F0,&E8,&F0,&F0,&F0,&F8          ; 4191 '........'
            defb &40,&C1,&40,&C9,&40,&D1,&40,&D9          ; 4199 '@.@.@.@.'
            defb &40,&E1,&40,&E9,&40,&F1,&40,&F9          ; 41A1 '@.@.@.@.'
            defb &90,&C1,&90,&C9,&90,&D1,&90,&D9          ; 41A9 '........'
            defb &90,&E1,&90,&E9,&90,&F1,&90,&F9          ; 41B1 '........'
            defb &E0,&C1,&E0,&C9,&E0,&D1,&E0,&D9          ; 41B9 '........'
            defb &E0,&E1,&E0,&E9,&E0,&F1,&E0,&F9          ; 41C1 '........'
            defb &30,&C2,&30,&CA,&30,&D2,&30,&DA          ; 41C9 '0.0.0.0.'
            defb &30,&E2,&30,&EA,&30,&F2,&30,&FA          ; 41D1 '0.0.0.0.'
            defb &80,&C2,&80,&CA,&80,&D2,&80,&DA          ; 41D9 '........'
            defb &80,&E2,&80,&EA,&80,&F2,&80,&FA          ; 41E1 '........'
            defb &D0,&C2,&D0,&CA,&D0,&D2,&D0,&DA          ; 41E9 '........'
            defb &D0,&E2,&D0,&EA,&D0,&F2,&D0,&FA          ; 41F1 '........'
            defb &20,&C3,&20,&CB,&20,&D3,&20,&DB          ; 41F9 ' . . . .'
            defb &20,&E3,&20,&EB,&20,&F3,&20,&FB          ; 4201 ' . . . .'
            defb &70,&C3,&70,&CB,&70,&D3,&70,&DB          ; 4209 'p.p.p.p.'
            defb &70,&E3,&70,&EB,&70,&F3,&70,&FB          ; 4211 'p.p.p.p.'
            defb &C0,&C3,&C0,&CB,&C0,&D3,&C0,&DB          ; 4219 '........'
            defb &C0,&E3,&C0,&EB,&C0,&F3,&C0,&FB          ; 4221 '........'
            defb &10,&C4,&10,&CC,&10,&D4,&10,&DC          ; 4229 '........'
            defb &10,&E4,&10,&EC,&10,&F4,&10,&FC          ; 4231 '........'
            defb &60,&C4,&60,&CC,&60,&D4,&60,&DC          ; 4239 '`.`.`.`.'
            defb &60,&E4,&60,&EC,&60,&F4,&60,&FC          ; 4241 '`.`.`.`.'
            defb &B0,&C4,&B0,&CC,&B0,&D4,&B0,&DC          ; 4249 '........'
            defb &B0,&E4,&B0,&EC,&B0,&F4,&B0,&FC          ; 4251 '........'
            defb &00,&C5,&00,&CD,&00,&D5,&00,&DD          ; 4259 '........'
            defb &00,&E5,&00,&ED,&00,&F5,&00,&FD          ; 4261 '........'
            defb &50,&C5,&50,&CD,&50,&D5,&50,&DD          ; 4269 'P.P.P.P.'
            defb &50,&E5,&50,&ED,&50,&F5,&50,&FD          ; 4271 'P.P.P.P.'
            defb &A0,&C5,&A0,&CD,&A0,&D5,&A0,&DD          ; 4279 '........'
            defb &A0,&E5,&A0,&ED,&A0,&F5,&A0,&FD          ; 4281 '........'
            defb &F0,&C5,&F0,&CD,&F0,&D5,&F0,&DD          ; 4289 '........'
            defb &F0,&E5,&F0,&ED,&F0,&F5,&F0,&FD          ; 4291 '........'
            defb &40,&C6,&40,&CE,&40,&D6,&40,&DE          ; 4299 '@.@.@.@.'
            defb &40,&E6,&40,&EE,&40,&F6,&40,&FE          ; 42A1 '@.@.@.@.'
            defb &90,&C6,&90,&CE,&90,&D6,&90,&DE          ; 42A9 '........'
            defb &90,&E6,&90,&EE,&90,&F6,&90,&FE          ; 42B1 '........'
            defb &E0,&C6,&E0,&CE,&E0,&D6,&E0,&DE          ; 42B9 '........'
            defb &E0,&E6,&E0,&EE,&E0,&F6,&E0,&FE          ; 42C1 '........'
            defb &30,&C7,&30,&CF,&30,&D7,&30,&DF          ; 42C9 '0.0.0.0.'
            defb &30,&E7,&30,&EF,&30,&F7,&30,&FF          ; 42D1 '0.0.0.0.'
            defb &80,&C7,&80,&CF,&80,&D7,&80,&DF          ; 42D9 '........'
            defb &80,&E7,&80,&EF,&80,&F7,&80,&FF          ; 42E1 '........'
            defb &81,&43,&75,&5D,&85,&5E,&95,&5F          ; 42E9 '.Cu].^._'
            defb &A5,&60,&B5,&61,&C5,&62,&D5,&63          ; 42F1 '.`.a.b.c'
            defb &E5,&53,&F5,&54,&05,&56,&11,&44          ; 42F9 '.S.T.V.D'
            defb &59,&45,&A1,&44,&15,&46,&15,&57          ; 4301 'YE.D.F.W'
            defb &25,&58,&35,&59,&65,&4B,&75,&4C          ; 4309 '%X5YeKuL'
            defb &25,&47,&35,&48,&85,&4D,&95,&4E          ; 4311 '%G5H.M.N'
            defb &45,&49,&55,&4A,&A5,&4F,&B5,&50          ; 4319 'EIUJ.O.P'
            defb &45,&5A,&55,&5B,&65,&5C,&C5,&51          ; 4321 'EZU[e\.Q'
            defb &D5,&52,&C9,&44,&37,&66,&47,&67          ; 4329 '.R.D7fGg'
            defb &F7,&67,&3F,&68,&81,&43,&F5,&5C          ; 4331 '.g?h.C.\'
            defb &05,&5E,&15,&5F,&25,&60,&35,&61          ; 4339 '.^._%`5a'
            defb &45,&62,&55,&63,&65,&53,&75,&54          ; 4341 'EbUceSuT'
            defb &85,&55,&65,&64,&85,&65,&E5,&64          ; 4349 '.Ued.e.d'
            defb &95,&45,&95,&56,&A5,&57,&B5,&58          ; 4351 '.E.V.W.X'
            defb &E5,&4A,&F5,&4B,&A5,&46,&B5,&47          ; 4359 '.J.K.F.G'
            defb &05,&4D,&15,&4E,&C5,&48,&D5,&49          ; 4361 '.M.N.H.I'
            defb &25,&4F,&35,&50,&C5,&59,&D5,&5A          ; 4369 '%O5P.Y.Z'
            defb &E5,&5B,&45,&51,&55,&52,&05,&65          ; 4371 '.[EQUR.e'
            defb &B7,&65,&C7,&66,&D7,&67,&1F,&68          ; 4379 '.e.f.g.h'
            defb &00,&00,&00,&00,&00,&00,&00,&00          ; 4381 '........'
            defb &00,&00,&00,&00,&00,&00,&00,&00          ; 4389 '........'
            defb &00,&00,&00,&00,&00,&00,&00,&00          ; 4391 '........'
            defb &00,&00,&00,&00,&00,&00,&00,&00          ; 4399 '........'
            defb &00,&00,&00,&00,&00,&00,&00,&00          ; 43A1 '........'
            defb &00,&00,&00,&00,&00,&00,&00,&00          ; 43A9 '........'
            defb &00,&00,&00,&00,&00,&00,&00,&00          ; 43B1 '........'
            defb &00,&00,&00,&00,&00,&00,&00,&00          ; 43B9 '........'
            defb &00,&00,&00,&00,&00,&00,&00,&00          ; 43C1 '........'
            defb &00,&00,&00,&00,&00,&00,&00,&00          ; 43C9 '........'
            defb &00,&00,&00,&00,&00,&00,&00,&00          ; 43D1 '........'
            defb &00,&00,&00,&00,&00,&00,&00,&00          ; 43D9 '........'
            defb &00,&00,&00,&00,&00,&00,&00,&00          ; 43E1 '........'
            defb &00,&00,&00,&00,&00,&00,&00,&00          ; 43E9 '........'
            defb &00,&00,&00,&00,&00,&00,&00,&00          ; 43F1 '........'
            defb &00,&00,&00,&00,&00,&00,&00,&00          ; 43F9 '........'
            defb &00,&00,&00,&00,&00,&00,&00,&00          ; 4401 '........'
            defb &00,&00,&00,&00,&00,&00,&00,&00          ; 4409 '........'
            defb &00,&00,&00,&3B,&00,&3B,&00,&00          ; 4411 '...;.;..'
            defb &00,&00,&00,&00,&3B,&00,&3B,&00          ; 4419 '....;.;.'
            defb &00,&00,&00,&00,&00,&3B,&00,&3B          ; 4421 '.....;.;'
            defb &00,&00,&00,&00,&00,&00,&3B,&00          ; 4429 '......;.'
            defb &3B,&00,&00,&00,&00,&00,&00,&8E          ; 4431 ';.......'
            defb &30,&4D,&00,&00,&00,&00,&00,&45          ; 4439 '0M.....E'
            defb &0C,&30,&0C,&8A,&00,&00,&00,&00          ; 4441 '.0......'
            defb &45,&0C,&30,&0C,&8A,&00,&00,&00          ; 4449 'E.0.....'
            defb &00,&8E,&18,&30,&24,&4D,&00,&00          ; 4451 '...0$M..'
            defb &00,&00,&8E,&18,&30,&24,&4D,&00          ; 4459 '....0$M.'
            defb &00,&00,&45,&0C,&18,&30,&24,&0C          ; 4461 '..E..0$.'
            defb &8A,&00,&00,&45,&0C,&30,&30,&30          ; 4469 '...E.000'
            defb &0C,&8A,&00,&00,&8E,&0C,&30,&30          ; 4471 '......00'
            defb &30,&0C,&4D,&00,&00,&CF,&CF,&30          ; 4479 '0.M....0'
            defb &30,&30,&CF,&CF,&00,&00,&00,&2A          ; 4481 '00.....*'
            defb &00,&00,&00,&15,&00,&00,&00,&15          ; 4489 '........'
            defb &3F,&00,&00,&00,&3F,&2A,&00,&00          ; 4491 '?...?*..'
            defb &3F,&3F,&2A,&00,&15,&3F,&3F,&00          ; 4499 '??*..??.'
            defb &00,&2F,&00,&2F,&00,&00,&7E,&00          ; 44A1 '././..~.'
            defb &7E,&00,&00,&2F,&00,&2F,&00,&00          ; 44A9 '~.././..'
            defb &7E,&00,&7E,&00,&00,&2F,&00,&2F          ; 44B1 '~.~.././'
            defb &00,&00,&7E,&00,&7E,&00,&00,&00          ; 44B9 '..~.~...'
            defb &00,&00,&00,&00,&00,&00,&00,&00          ; 44C1 '........'
            defb &00,&00,&00,&00,&00,&00,&00,&00          ; 44C9 '........'
            defb &00,&00,&FC,&FC,&FC,&00,&FC,&FC          ; 44D1 '........'
            defb &FC,&00,&00,&54,&FC,&A8,&00,&54          ; 44D9 '...T...T'
            defb &FC,&A8,&00,&00,&00,&FC,&00,&00          ; 44E1 '........'
            defb &00,&FC,&00,&00,&00,&15,&3F,&3F          ; 44E9 '......??'
            defb &3F,&3F,&3F,&2A,&00,&00,&35,&35          ; 44F1 '???*..55'
            defb &35,&35,&35,&35,&35,&00,&00,&3A          ; 44F9 '55555..:'
            defb &3A,&3A,&3A,&3A,&3A,&3A,&00,&00          ; 4501 '::::::..'
            defb &15,&3F,&3F,&3F,&3F,&3F,&2A,&00          ; 4509 '.?????*.'
            defb &00,&05,&3F,&7F,&FF,&BF,&3F,&0A          ; 4511 '..?...?.'
            defb &00,&00,&00,&1F,&3F,&FF,&3F,&2F          ; 4519 '....?.?/'
            defb &00,&00,&00,&00,&1F,&3F,&3F,&3F          ; 4521 '.....???'
            defb &2F,&00,&00,&00,&00,&1F,&7F,&FF          ; 4529 '/.......'
            defb &BF,&2F,&00,&00,&00,&00,&05,&3F          ; 4531 './.....?'
            defb &FF,&3F,&0A,&00,&00,&00,&00,&00          ; 4539 '.?......'
            defb &1F,&3F,&2F,&00,&00,&00,&00,&00          ; 4541 '.?/.....'
            defb &00,&05,&3F,&0A,&00,&00,&00,&00          ; 4549 '..?.....'
            defb &00,&00,&00,&0F,&00,&00,&00,&00          ; 4551 '........'
            defb &00,&00,&00,&00,&00,&00,&00,&00          ; 4559 '........'
            defb &00,&00,&00,&00,&00,&8A,&9D,&6E          ; 4561 '.......n'
            defb &45,&00,&00,&CF,&15,&2A,&CF,&00          ; 4569 'E....*..'
            defb &00,&45,&8E,&4D,&8A,&00,&00,&45          ; 4571 '.E.M...E'
            defb &8E,&4D,&8A,&00,&00,&00,&8E,&4D          ; 4579 '.M.....M'
            defb &00,&00,&00,&00,&8E,&4D,&00,&00          ; 4581 '.....M..'
            defb &00,&00,&04,&08,&00,&00,&00,&00          ; 4589 '........'
            defb &04,&08,&00,&00,&00,&00,&0C,&00          ; 4591 '........'
            defb &00,&0C,&00,&00,&00,&00,&0C,&00          ; 4599 '........'
            defb &00,&0C,&00,&00,&00,&00,&0C,&08          ; 45A1 '........'
            defb &04,&0C,&00,&00,&00,&00,&4D,&CF          ; 45A9 '......M.'
            defb &CF,&8E,&00,&00,&00,&04,&A8,&45          ; 45B1 '.......E'
            defb &8A,&54,&08,&00,&00,&0C,&A8,&67          ; 45B9 '.T.....g'
            defb &9B,&54,&0C,&00,&00,&0C,&A8,&67          ; 45C1 '.T.....g'
            defb &9B,&54,&0C,&00,&04,&0C,&ED,&CF          ; 45C9 '.T......'
            defb &CF,&DE,&0C,&08,&04,&04,&ED,&CF          ; 45D1 '........'
            defb &CF,&DE,&08,&08,&04,&04,&B8,&33          ; 45D9 '.......3'
            defb &33,&74,&08,&08,&04,&04,&B8,&30          ; 45E1 '3t.....0'
            defb &30,&74,&08,&08,&04,&00,&0C,&5C          ; 45E9 '0t.....\'
            defb &AC,&0C,&00,&08,&04,&08,&00,&5C          ; 45F1 '.......\'
            defb &AC,&00,&04,&08,&04,&08,&00,&08          ; 45F9 '........'
            defb &04,&00,&04,&08,&00,&00,&0C,&08          ; 4601 '........'
            defb &04,&0C,&00,&00,&00,&00,&0C,&08          ; 4609 '........'
            defb &04,&0C,&00,&00,&00,&00,&04,&08          ; 4611 '........'
            defb &00,&04,&08,&00,&00,&00,&00,&04          ; 4619 '........'
            defb &08,&00,&04,&08,&00,&00,&00,&00          ; 4621 '........'
            defb &04,&0C,&00,&0C,&08,&00,&00,&00          ; 4629 '........'
            defb &00,&04,&CF,&CF,&CF,&08,&00,&00          ; 4631 '........'
            defb &00,&00,&5C,&00,&CF,&00,&AC,&00          ; 4639 '..\.....'
            defb &00,&00,&04,&5C,&11,&CF,&22,&AC          ; 4641 '...\..".'
            defb &08,&00,&00,&04,&5C,&11,&CF,&22          ; 4649 '....\.."'
            defb &AC,&08,&00,&00,&0C,&5C,&CF,&CF          ; 4651 '.....\..'
            defb &CF,&AC,&0C,&00,&00,&08,&5C,&CF          ; 4659 '......\.'
            defb &CF,&CF,&AC,&04,&00,&00,&08,&5C          ; 4661 '.......\'
            defb &31,&33,&32,&AC,&04,&00,&00,&08          ; 4669 '132.....'
            defb &5C,&30,&30,&30,&AC,&04,&00,&00          ; 4671 '\000....'
            defb &08,&04,&0C,&FC,&0C,&08,&04,&00          ; 4679 '........'
            defb &00,&0C,&00,&04,&FC,&08,&00,&0C          ; 4681 '........'
            defb &00,&00,&0C,&00,&04,&00,&08,&00          ; 4689 '........'
            defb &0C,&00,&00,&00,&04,&0C,&00,&0C          ; 4691 '........'
            defb &08,&00,&00,&00,&00,&04,&0C,&00          ; 4699 '........'
            defb &0C,&08,&00,&00,&00,&00,&00,&00          ; 46A1 '........'
            defb &00,&00,&00,&00,&00,&C3,&C3,&C3          ; 46A9 '........'
            defb &C3,&C3,&C3,&00,&41,&C3,&3C,&3C          ; 46B1 '....A.<<'
            defb &3C,&3C,&C3,&82,&41,&96,&3C,&3C          ; 46B9 '<<..A.<<'
            defb &3C,&3C,&69,&82,&41,&97,&3F,&2C          ; 46C1 '<<i.A.?,'
            defb &1C,&3F,&6B,&82,&41,&96,&3F,&2C          ; 46C9 '.?k.A.?,'
            defb &1C,&3F,&69,&82,&41,&96,&3C,&2C          ; 46D1 '.?i.A.<,'
            defb &1C,&3C,&69,&82,&41,&96,&3C,&CF          ; 46D9 '.<i.A.<.'
            defb &CF,&3C,&69,&82,&41,&C3,&3C,&CF          ; 46E1 '.<i.A.<.'
            defb &CF,&3C,&C3,&82,&00,&C3,&C3,&C3          ; 46E9 '.<......'
            defb &C3,&C3,&C3,&00,&00,&00,&00,&41          ; 46F1 '.......A'
            defb &82,&00,&00,&00,&00,&00,&00,&41          ; 46F9 '.......A'
            defb &82,&00,&00,&00,&00,&00,&00,&41          ; 4701 '.......A'
            defb &82,&00,&00,&00,&00,&00,&0F,&0F          ; 4709 '........'
            defb &0F,&0F,&00,&00,&00,&41,&C3,&C3          ; 4711 '.....A..'
            defb &C3,&C3,&82,&00,&00,&00,&00,&00          ; 4719 '........'
            defb &00,&00,&00,&00,&00,&00,&00,&00          ; 4721 '........'
            defb &00,&00,&00,&00,&00,&00,&41,&C3          ; 4729 '......A.'
            defb &C3,&C3,&C3,&C3,&82,&00,&00,&C3          ; 4731 '........'
            defb &96,&3C,&3C,&3C,&69,&C3,&00,&00          ; 4739 '.<<<i...'
            defb &C3,&3C,&3C,&3C,&3C,&3C,&C3,&00          ; 4741 '.<<<<<..'
            defb &00,&C3,&3F,&3E,&0C,&3D,&3F,&C3          ; 4749 '..?>.=?.'
            defb &00,&00,&C3,&3D,&3E,&0C,&3D,&3E          ; 4751 '...=>.=>'
            defb &C3,&00,&00,&C3,&3C,&3C,&0C,&3C          ; 4759 '....<<.<'
            defb &3C,&C3,&00,&00,&C3,&3C,&6D,&CF          ; 4761 '<....<m.'
            defb &9E,&3C,&C3,&00,&00,&C3,&96,&6D          ; 4769 '.<.....m'
            defb &CF,&9E,&69,&C3,&00,&00,&41,&C3          ; 4771 '..i...A.'
            defb &C3,&C3,&C3,&C3,&82,&00,&00,&00          ; 4779 '........'
            defb &00,&00,&C3,&00,&00,&00,&00,&00          ; 4781 '........'
            defb &00,&00,&00,&C3,&00,&00,&00,&00          ; 4789 '........'
            defb &00,&00,&00,&00,&C3,&00,&00,&00          ; 4791 '........'
            defb &00,&00,&00,&05,&0F,&0F,&0F,&0A          ; 4799 '........'
            defb &00,&00,&00,&00,&C3,&C3,&C3,&C3          ; 47A1 '........'
            defb &C3,&00,&00,&00,&00,&00,&00,&00          ; 47A9 '........'
            defb &00,&00,&00,&00,&00,&00,&00,&00          ; 47B1 '........'
            defb &00,&00,&00,&00,&00,&C3,&C3,&C3          ; 47B9 '........'
            defb &C3,&C3,&C3,&00,&41,&C3,&3C,&3C          ; 47C1 '....A.<<'
            defb &3C,&3C,&C3,&82,&41,&96,&3C,&3C          ; 47C9 '<<..A.<<'
            defb &3C,&3C,&69,&82,&41,&97,&3F,&2C          ; 47D1 '<<i.A.?,'
            defb &1C,&3F,&6B,&82,&41,&96,&3F,&2C          ; 47D9 '.?k.A.?,'
            defb &1C,&3F,&69,&82,&41,&96,&3C,&2C          ; 47E1 '.?i.A.<,'
            defb &1C,&3C,&69,&82,&41,&96,&3C,&CF          ; 47E9 '.<i.A.<.'
            defb &CF,&3C,&69,&82,&41,&96,&3C,&CF          ; 47F1 '.<i.A.<.'
            defb &CF,&3C,&69,&82,&41,&C3,&3C,&3C          ; 47F9 '.<i.A.<<'
            defb &3C,&3C,&C3,&82,&00,&C3,&C3,&C3          ; 4801 '<<......'
            defb &C3,&C3,&C3,&00,&00,&00,&FC,&FC          ; 4809 '........'
            defb &FC,&FC,&00,&00,&00,&41,&C3,&C3          ; 4811 '.....A..'
            defb &C3,&C3,&82,&00,&00,&00,&00,&00          ; 4819 '........'
            defb &00,&00,&00,&00,&00,&00,&00,&00          ; 4821 '........'
            defb &00,&00,&00,&00,&00,&00,&00,&00          ; 4829 '........'
            defb &00,&00,&00,&00,&00,&00,&00,&00          ; 4831 '........'
            defb &00,&00,&00,&00,&00,&00,&41,&C3          ; 4839 '......A.'
            defb &C3,&C3,&C3,&C3,&82,&00,&00,&C3          ; 4841 '........'
            defb &96,&3C,&3C,&3C,&69,&C3,&00,&00          ; 4849 '.<<<i...'
            defb &C3,&3C,&3C,&3C,&3C,&3C,&C3,&00          ; 4851 '.<<<<<..'
            defb &00,&C3,&3F,&3E,&0C,&3D,&3F,&C3          ; 4859 '..?>.=?.'
            defb &00,&00,&C3,&3D,&3E,&0C,&3D,&3E          ; 4861 '...=>.=>'
            defb &C3,&00,&00,&C3,&3C,&3C,&0C,&3C          ; 4869 '....<<.<'
            defb &3C,&C3,&00,&00,&C3,&3C,&6D,&CF          ; 4871 '<....<m.'
            defb &9E,&3C,&C3,&00,&00,&C3,&3C,&6D          ; 4879 '.<....<m'
            defb &CF,&9E,&3C,&C3,&00,&00,&C3,&96          ; 4881 '..<.....'
            defb &3C,&3C,&3C,&69,&C3,&00,&00,&41          ; 4889 '<<<i...A'
            defb &C3,&C3,&C3,&C3,&C3,&82,&00,&00          ; 4891 '........'
            defb &00,&54,&FC,&FC,&FC,&A8,&00,&00          ; 4899 '.T......'
            defb &00,&00,&C3,&C3,&C3,&C3,&C3,&00          ; 48A1 '........'
            defb &00,&00,&00,&00,&00,&00,&00,&00          ; 48A9 '........'
            defb &00,&00,&00,&00,&00,&00,&00,&00          ; 48B1 '........'
            defb &00,&00,&00,&00,&00,&00,&00,&00          ; 48B9 '........'
            defb &00,&00,&00,&00,&00,&00,&00,&00          ; 48C1 '........'
            defb &00,&00,&00,&00,&11,&F3,&F3,&F3          ; 48C9 '........'
            defb &F3,&F3,&F3,&22,&00,&F3,&F3,&30          ; 48D1 '..."...0'
            defb &30,&F3,&F3,&00,&00,&51,&B2,&31          ; 48D9 '0....Q.1'
            defb &32,&71,&A2,&00,&00,&00,&F3,&31          ; 48E1 '2q.....1'
            defb &32,&F3,&00,&00,&00,&00,&F3,&30          ; 48E9 '2......0'
            defb &30,&A2,&00,&00,&00,&51,&F3,&F3          ; 48F1 '0....Q..'
            defb &F3,&F3,&A2,&00,&11,&F3,&F3,&F3          ; 48F9 '........'
            defb &F3,&F3,&F3,&22,&11,&F3,&F3,&F3          ; 4901 '..."....'
            defb &F3,&F3,&F3,&22,&00,&51,&F3,&F3          ; 4909 '...".Q..'
            defb &F3,&F3,&A2,&00,&00,&00,&F3,&30          ; 4911 '.......0'
            defb &30,&A2,&00,&00,&00,&00,&F3,&31          ; 4919 '0......1'
            defb &32,&F3,&00,&00,&00,&51,&B2,&31          ; 4921 '2....Q.1'
            defb &32,&71,&A2,&00,&00,&F3,&F3,&30          ; 4929 '2q.....0'
            defb &30,&F3,&F3,&00,&11,&F3,&F3,&F3          ; 4931 '0.......'
            defb &F3,&F3,&F3,&22,&00,&00,&00,&00          ; 4939 '..."....'
            defb &00,&00,&00,&00,&00,&00,&00,&00          ; 4941 '........'
            defb &00,&00,&00,&00,&00,&00,&73,&F3          ; 4949 '......s.'
            defb &F3,&F3,&F3,&F3,&B3,&00,&00,&51          ; 4951 '.......Q'
            defb &F3,&B2,&30,&71,&F3,&A2,&00,&00          ; 4959 '..0q....'
            defb &00,&F3,&30,&33,&30,&F3,&00,&00          ; 4961 '..030...'
            defb &00,&00,&51,&B2,&33,&71,&A2,&00          ; 4969 '..Q.3q..'
            defb &00,&00,&00,&51,&B2,&30,&71,&00          ; 4971 '...Q.0q.'
            defb &00,&00,&00,&00,&F3,&F3,&F3,&F3          ; 4979 '........'
            defb &F3,&00,&00,&00,&73,&F3,&F3,&F3          ; 4981 '....s...'
            defb &F3,&F3,&B3,&00,&00,&73,&F3,&F3          ; 4989 '.....s..'
            defb &F3,&F3,&F3,&B3,&00,&00,&00,&F3          ; 4991 '........'
            defb &F3,&F3,&F3,&F3,&00,&00,&00,&00          ; 4999 '........'
            defb &51,&B2,&30,&71,&00,&00,&00,&00          ; 49A1 'Q.0q....'
            defb &00,&51,&B2,&33,&71,&A2,&00,&00          ; 49A9 '.Q.3q...'
            defb &00,&00,&F3,&30,&33,&30,&F3,&00          ; 49B1 '...030..'
            defb &00,&00,&51,&F3,&B2,&30,&71,&F3          ; 49B9 '..Q..0q.'
            defb &A2,&00,&00,&73,&F3,&F3,&F3,&F3          ; 49C1 '...s....'
            defb &F3,&B3,&00,&00,&00,&00,&00,&00          ; 49C9 '........'
            defb &00,&00,&00,&00,&00,&00,&00,&00          ; 49D1 '........'
            defb &00,&00,&00,&00,&00,&00,&F3,&F3          ; 49D9 '........'
            defb &F3,&F3,&00,&00,&00,&00,&F3,&30          ; 49E1 '.......0'
            defb &30,&F3,&00,&00,&00,&51,&B2,&31          ; 49E9 '0....Q.1'
            defb &32,&71,&A2,&00,&11,&F3,&F3,&31          ; 49F1 '2q.....1'
            defb &32,&F3,&F3,&22,&11,&F3,&F3,&30          ; 49F9 '2.."...0'
            defb &30,&F3,&F3,&22,&00,&51,&F3,&F3          ; 4A01 '0..".Q..'
            defb &F3,&F3,&A2,&00,&00,&00,&F3,&F3          ; 4A09 '........'
            defb &F3,&F3,&00,&00,&00,&00,&F3,&F3          ; 4A11 '........'
            defb &F3,&F3,&00,&00,&00,&51,&F3,&F3          ; 4A19 '.....Q..'
            defb &F3,&F3,&A2,&00,&11,&F3,&F3,&30          ; 4A21 '.......0'
            defb &30,&F3,&F3,&22,&11,&F3,&F3,&31          ; 4A29 '0.."...1'
            defb &32,&F3,&F3,&22,&00,&51,&B2,&31          ; 4A31 '2..".Q.1'
            defb &32,&71,&A2,&00,&00,&00,&F3,&30          ; 4A39 '2q.....0'
            defb &30,&F3,&00,&00,&00,&00,&F3,&F3          ; 4A41 '0.......'
            defb &F3,&F3,&00,&00,&00,&00,&00,&00          ; 4A49 '........'
            defb &00,&00,&00,&00,&00,&00,&00,&00          ; 4A51 '........'
            defb &00,&00,&00,&00,&00,&00,&00,&51          ; 4A59 '.......Q'
            defb &F3,&F3,&F3,&A2,&00,&00,&00,&00          ; 4A61 '........'
            defb &51,&B2,&30,&71,&A2,&00,&00,&00          ; 4A69 'Q.0q....'
            defb &00,&F3,&30,&33,&30,&F3,&00,&00          ; 4A71 '..030...'
            defb &00,&73,&F3,&B2,&33,&71,&F3,&B3          ; 4A79 '.s..3q..'
            defb &00,&00,&73,&F3,&B2,&30,&71,&F3          ; 4A81 '..s..0q.'
            defb &B3,&00,&00,&00,&F3,&F3,&F3,&F3          ; 4A89 '........'
            defb &F3,&00,&00,&00,&00,&51,&F3,&F3          ; 4A91 '.....Q..'
            defb &F3,&A2,&00,&00,&00,&00,&51,&F3          ; 4A99 '......Q.'
            defb &F3,&F3,&A2,&00,&00,&00,&00,&F3          ; 4AA1 '........'
            defb &F3,&F3,&F3,&F3,&00,&00,&00,&73          ; 4AA9 '.......s'
            defb &F3,&B2,&30,&71,&F3,&B3,&00,&00          ; 4AB1 '..0q....'
            defb &73,&F3,&B2,&33,&71,&F3,&B3,&00          ; 4AB9 's..3q...'
            defb &00,&00,&F3,&30,&33,&30,&F3,&00          ; 4AC1 '...030..'
            defb &00,&00,&00,&51,&B2,&30,&71,&A2          ; 4AC9 '...Q.0q.'
            defb &00,&00,&00,&00,&51,&F3,&F3,&F3          ; 4AD1 '....Q...'
            defb &A2,&00,&00,&00,&00,&00,&00,&00          ; 4AD9 '........'
            defb &00,&00,&00,&00,&00,&00,&00,&00          ; 4AE1 '........'
            defb &00,&00,&00,&00,&54,&FC,&FC,&FC          ; 4AE9 '....T...'
            defb &FC,&FC,&FC,&A8,&54,&FC,&FC,&EC          ; 4AF1 '....T...'
            defb &DC,&FC,&FC,&A8,&54,&FC,&FC,&CC          ; 4AF9 '....T...'
            defb &CC,&FC,&FC,&A8,&54,&FC,&EC,&CC          ; 4B01 '....T...'
            defb &CC,&DC,&FC,&A8,&54,&FC,&8C,&08          ; 4B09 '....T...'
            defb &04,&4C,&FC,&A8,&54,&EC,&8C,&00          ; 4B11 '.L..T...'
            defb &00,&4C,&DC,&A8,&54,&CC,&88,&05          ; 4B19 '.L..T...'
            defb &0A,&44,&CC,&A8,&54,&CC,&88,&05          ; 4B21 '.D..T...'
            defb &0A,&44,&CC,&A8,&54,&EC,&8C,&00          ; 4B29 '.D..T...'
            defb &00,&4C,&DC,&A8,&54,&FC,&8C,&08          ; 4B31 '.L..T...'
            defb &04,&4C,&FC,&A8,&54,&FC,&EC,&CC          ; 4B39 '.L..T...'
            defb &CC,&DC,&FC,&A8,&54,&FC,&FC,&CC          ; 4B41 '....T...'
            defb &CC,&FC,&FC,&A8,&54,&FC,&FC,&EC          ; 4B49 '....T...'
            defb &DC,&FC,&FC,&A8,&54,&FC,&FC,&FC          ; 4B51 '....T...'
            defb &FC,&FC,&FC,&A8,&00,&00,&00,&00          ; 4B59 '........'
            defb &00,&00,&00,&00,&00,&00,&00,&00          ; 4B61 '........'
            defb &00,&00,&00,&00,&00,&00,&FC,&FC          ; 4B69 '........'
            defb &FC,&FC,&FC,&FC,&FC,&00,&00,&FC          ; 4B71 '........'
            defb &FC,&FC,&CC,&FC,&FC,&FC,&00,&00          ; 4B79 '........'
            defb &FC,&FC,&EC,&CC,&DC,&FC,&FC,&00          ; 4B81 '........'
            defb &00,&FC,&FC,&CC,&CC,&CC,&FC,&FC          ; 4B89 '........'
            defb &00,&00,&FC,&EC,&0C,&00,&0C,&DC          ; 4B91 '........'
            defb &FC,&00,&00,&FC,&CC,&08,&00,&04          ; 4B99 '........'
            defb &CC,&FC,&00,&00,&EC,&CC,&00,&0F          ; 4BA1 '........'
            defb &00,&CC,&DC,&00,&00,&EC,&CC,&00          ; 4BA9 '........'
            defb &0F,&00,&CC,&DC,&00,&00,&FC,&CC          ; 4BB1 '........'
            defb &08,&00,&04,&CC,&FC,&00,&00,&FC          ; 4BB9 '........'
            defb &EC,&0C,&00,&0C,&DC,&FC,&00,&00          ; 4BC1 '........'
            defb &FC,&FC,&CC,&CC,&CC,&FC,&FC,&00          ; 4BC9 '........'
            defb &00,&FC,&FC,&EC,&CC,&DC,&FC,&FC          ; 4BD1 '........'
            defb &00,&00,&FC,&FC,&FC,&CC,&FC,&FC          ; 4BD9 '........'
            defb &FC,&00,&00,&FC,&FC,&FC,&FC,&FC          ; 4BE1 '........'
            defb &FC,&FC,&00,&00,&00,&00,&00,&00          ; 4BE9 '........'
            defb &00,&00,&00,&00,&00,&00,&00,&00          ; 4BF1 '........'
            defb &00,&00,&00,&00,&00,&00,&00,&6E          ; 4BF9 '.......n'
            defb &9D,&00,&00,&00,&00,&00,&15,&CC          ; 4C01 '........'
            defb &CC,&2A,&00,&00,&00,&00,&6E,&CC          ; 4C09 '.*....n.'
            defb &CC,&9D,&00,&00,&00,&15,&CC,&CC          ; 4C11 '........'
            defb &CC,&CC,&2A,&00,&00,&6E,&8C,&08          ; 4C19 '..*..n..'
            defb &04,&4C,&9D,&00,&15,&CC,&8C,&00          ; 4C21 '.L......'
            defb &00,&4C,&CC,&2A,&44,&CC,&88,&05          ; 4C29 '.L.*D...'
            defb &0A,&44,&CC,&88,&44,&CC,&88,&05          ; 4C31 '.D..D...'
            defb &0A,&44,&CC,&88,&15,&CC,&8C,&00          ; 4C39 '.D......'
            defb &00,&4C,&CC,&2A,&00,&6E,&8C,&08          ; 4C41 '.L.*.n..'
            defb &04,&4C,&9D,&00,&00,&15,&CC,&CC          ; 4C49 '.L......'
            defb &CC,&CC,&2A,&00,&00,&00,&6E,&CC          ; 4C51 '..*...n.'
            defb &CC,&9D,&00,&00,&00,&00,&15,&CC          ; 4C59 '........'
            defb &CC,&2A,&00,&00,&00,&00,&00,&6E          ; 4C61 '.*.....n'
            defb &9D,&00,&00,&00,&00,&00,&00,&00          ; 4C69 '........'
            defb &00,&00,&00,&00,&00,&00,&00,&00          ; 4C71 '........'
            defb &00,&00,&00,&00,&00,&00,&00,&00          ; 4C79 '........'
            defb &15,&CC,&2A,&00,&00,&00,&00,&00          ; 4C81 '..*.....'
            defb &00,&6E,&CC,&9D,&00,&00,&00,&00          ; 4C89 '.n......'
            defb &00,&15,&CC,&CC,&CC,&2A,&00,&00          ; 4C91 '.....*..'
            defb &00,&00,&6E,&CC,&CC,&CC,&9D,&00          ; 4C99 '..n.....'
            defb &00,&00,&15,&CC,&0C,&00,&0C,&CC          ; 4CA1 '........'
            defb &2A,&00,&00,&6E,&CC,&08,&00,&04          ; 4CA9 '*..n....'
            defb &CC,&9D,&00,&00,&CC,&CC,&00,&0F          ; 4CB1 '........'
            defb &00,&CC,&CC,&00,&00,&CC,&CC,&00          ; 4CB9 '........'
            defb &0F,&00,&CC,&CC,&00,&00,&6E,&CC          ; 4CC1 '......n.'
            defb &08,&00,&04,&CC,&9D,&00,&00,&15          ; 4CC9 '........'
            defb &CC,&0C,&00,&0C,&CC,&2A,&00,&00          ; 4CD1 '.....*..'
            defb &00,&6E,&CC,&CC,&CC,&9D,&00,&00          ; 4CD9 '.n......'
            defb &00,&00,&15,&CC,&CC,&CC,&2A,&00          ; 4CE1 '......*.'
            defb &00,&00,&00,&00,&6E,&CC,&9D,&00          ; 4CE9 '....n...'
            defb &00,&00,&00,&00,&00,&15,&CC,&2A          ; 4CF1 '.......*'
            defb &00,&00,&00,&00,&00,&00,&00,&00          ; 4CF9 '........'
            defb &00,&00,&00,&00,&00,&00,&45,&8A          ; 4D01 '......E.'
            defb &45,&8A,&00,&00,&00,&00,&00,&8A          ; 4D09 'E.......'
            defb &45,&00,&00,&00,&00,&00,&00,&8A          ; 4D11 'E.......'
            defb &45,&00,&00,&00,&00,&00,&CC,&3F          ; 4D19 'E......?'
            defb &3F,&CC,&00,&00,&00,&44,&3B,&37          ; 4D21 '?....D;7'
            defb &3B,&37,&88,&00,&44,&9D,&11,&37          ; 4D29 ';7..D..7'
            defb &3B,&22,&6E,&88,&15,&2A,&50,&3F          ; 4D31 ';"n..*P?'
            defb &3F,&A0,&15,&2A,&00,&00,&F0,&B5          ; 4D39 '?..*....'
            defb &7A,&F0,&00,&00,&00,&00,&F0,&5A          ; 4D41 'z......Z'
            defb &A5,&F0,&00,&00,&00,&44,&7A,&0F          ; 4D49 '.....Dz.'
            defb &0F,&B5,&88,&00,&00,&9D,&7A,&A5          ; 4D51 '......z.'
            defb &5A,&B5,&6E,&00,&44,&2A,&F0,&5A          ; 4D59 'Z.n.D*.Z'
            defb &A5,&F0,&15,&88,&15,&00,&50,&0F          ; 4D61 '......P.'
            defb &0F,&A0,&00,&2A,&00,&44,&9D,&A5          ; 4D69 '...*.D..'
            defb &5A,&6E,&88,&00,&44,&9D,&2A,&50          ; 4D71 'Zn..D.*P'
            defb &A0,&15,&6E,&88,&15,&2A,&00,&00          ; 4D79 '..n..*..'
            defb &00,&00,&15,&2A,&00,&00,&00,&CF          ; 4D81 '...*....'
            defb &00,&CF,&00,&00,&00,&00,&00,&00          ; 4D89 '........'
            defb &45,&00,&8A,&00,&00,&00,&00,&00          ; 4D91 'E.......'
            defb &00,&45,&00,&8A,&00,&00,&00,&00          ; 4D99 '.E......'
            defb &00,&44,&9D,&3F,&6E,&88,&00,&00          ; 4DA1 '.D.?n...'
            defb &00,&00,&9D,&33,&3F,&33,&6E,&00          ; 4DA9 '...3?3n.'
            defb &00,&00,&CC,&2A,&33,&3F,&33,&15          ; 4DB1 '...*3?3.'
            defb &CC,&00,&00,&3F,&00,&B5,&3F,&7A          ; 4DB9 '...?..?z'
            defb &00,&3F,&00,&00,&00,&50,&F0,&3F          ; 4DC1 '.?...P.?'
            defb &F0,&A0,&00,&00,&00,&00,&50,&A5          ; 4DC9 '......P.'
            defb &F0,&5A,&A0,&00,&00,&00,&00,&9D          ; 4DD1 '.Z......'
            defb &A5,&0F,&5A,&6E,&00,&00,&00,&44          ; 4DD9 '..Zn...D'
            defb &3F,&F0,&0F,&F0,&3F,&88,&00,&00          ; 4DE1 '?...?...'
            defb &9D,&50,&A5,&F0,&5A,&A0,&6E,&00          ; 4DE9 '.P..Z.n.'
            defb &00,&2A,&00,&A5,&0F,&5A,&00,&15          ; 4DF1 '.*...Z..'
            defb &00,&00,&00,&CC,&7A,&0F,&B5,&CC          ; 4DF9 '....z...'
            defb &00,&00,&00,&CC,&3F,&00,&F0,&00          ; 4E01 '....?...'
            defb &3F,&CC,&00,&00,&3F,&00,&00,&00          ; 4E09 '?...?...'
            defb &00,&00,&3F,&00,&00,&00,&45,&8A          ; 4E11 '..?...E.'
            defb &45,&8A,&00,&00,&44,&00,&00,&8A          ; 4E19 'E...D...'
            defb &45,&00,&00,&88,&15,&88,&00,&8A          ; 4E21 'E.......'
            defb &45,&00,&44,&2A,&00,&6E,&CC,&3F          ; 4E29 'E.D*.n.?'
            defb &3F,&CC,&9D,&00,&00,&15,&3B,&37          ; 4E31 '?.....;7'
            defb &3B,&37,&2A,&00,&00,&00,&11,&37          ; 4E39 ';7*....7'
            defb &3B,&22,&00,&00,&00,&00,&50,&3F          ; 4E41 ';"....P?'
            defb &3F,&A0,&00,&00,&00,&00,&F0,&B5          ; 4E49 '?.......'
            defb &7A,&F0,&00,&00,&44,&00,&F0,&5A          ; 4E51 'z...D..Z'
            defb &A5,&F0,&00,&88,&15,&CC,&7A,&0F          ; 4E59 '......z.'
            defb &0F,&B5,&CC,&2A,&00,&3F,&7A,&A5          ; 4E61 '...*.?z.'
            defb &5A,&B5,&3F,&00,&00,&00,&F0,&5A          ; 4E69 'Z.?....Z'
            defb &A5,&F0,&00,&00,&44,&88,&50,&0F          ; 4E71 '....D.P.'
            defb &0F,&A0,&44,&88,&15,&6E,&9D,&A5          ; 4E79 '..D..n..'
            defb &5A,&6E,&9D,&2A,&00,&15,&2A,&50          ; 4E81 'Zn.*..*P'
            defb &A0,&15,&2A,&00,&00,&00,&00,&00          ; 4E89 '..*.....'
            defb &00,&00,&00,&00,&00,&00,&00,&CF          ; 4E91 '........'
            defb &00,&CF,&00,&00,&00,&00,&88,&00          ; 4E99 '........'
            defb &45,&00,&8A,&00,&44,&00,&00,&6E          ; 4EA1 'E...D..n'
            defb &00,&45,&00,&8A,&00,&9D,&00,&00          ; 4EA9 '.E......'
            defb &15,&CC,&9D,&3F,&6E,&CC,&2A,&00          ; 4EB1 '...?n.*.'
            defb &00,&00,&3F,&33,&3F,&33,&3F,&00          ; 4EB9 '..?3?3?.'
            defb &00,&00,&00,&00,&33,&3F,&33,&00          ; 4EC1 '....3?3.'
            defb &00,&00,&00,&00,&00,&B5,&3F,&7A          ; 4EC9 '......?z'
            defb &00,&00,&00,&00,&00,&50,&F0,&3F          ; 4ED1 '.....P.?'
            defb &F0,&A0,&00,&00,&00,&88,&50,&A5          ; 4ED9 '......P.'
            defb &F0,&5A,&A0,&44,&00,&00,&6E,&9D          ; 4EE1 '.Z.D..n.'
            defb &A5,&0F,&5A,&6E,&9D,&00,&00,&15          ; 4EE9 '..Zn....'
            defb &3F,&F0,&0F,&F0,&3F,&2A,&00,&00          ; 4EF1 '?...?*..'
            defb &00,&50,&A5,&F0,&5A,&A0,&00,&00          ; 4EF9 '.P..Z...'
            defb &00,&CC,&00,&A5,&0F,&5A,&00,&CC          ; 4F01 '.....Z..'
            defb &00,&00,&3F,&CC,&7A,&0F,&B5,&CC          ; 4F09 '..?.z...'
            defb &3F,&00,&00,&00,&3F,&00,&F0,&00          ; 4F11 '?...?...'
            defb &3F,&00,&00,&00,&00,&00,&00,&00          ; 4F19 '?.......'
            defb &00,&00,&00,&00,&00,&00,&00,&00          ; 4F21 '........'
            defb &00,&00,&00,&00,&00,&00,&03,&03          ; 4F29 '........'
            defb &03,&03,&00,&00,&00,&01,&03,&03          ; 4F31 '........'
            defb &03,&03,&02,&00,&00,&03,&07,&4F          ; 4F39 '.......O'
            defb &8F,&0B,&03,&00,&01,&03,&0F,&4F          ; 4F41 '.......O'
            defb &8F,&0F,&03,&02,&01,&47,&CF,&CF          ; 4F49 '.....G..'
            defb &CF,&CF,&8B,&02,&01,&47,&CF,&CF          ; 4F51 '.....G..'
            defb &CF,&CF,&8B,&02,&01,&03,&CF,&CF          ; 4F59 '........'
            defb &CF,&CF,&03,&02,&10,&03,&03,&12          ; 4F61 '........'
            defb &21,&03,&03,&20,&10,&21,&03,&12          ; 4F69 '!.. .!..'
            defb &21,&03,&12,&20,&10,&20,&01,&12          ; 4F71 '!.. . ..'
            defb &21,&02,&10,&20,&10,&20,&01,&02          ; 4F79 '!.. . ..'
            defb &01,&02,&10,&20,&00,&00,&01,&02          ; 4F81 '... ....'
            defb &01,&02,&00,&00,&00,&00,&01,&02          ; 4F89 '........'
            defb &01,&02,&00,&00,&00,&00,&03,&00          ; 4F91 '........'
            defb &00,&03,&00,&00,&00,&01,&03,&00          ; 4F99 '........'
            defb &00,&03,&02,&00,&00,&00,&00,&00          ; 4FA1 '........'
            defb &00,&00,&00,&00,&00,&00,&00,&01          ; 4FA9 '........'
            defb &03,&03,&03,&02,&00,&00,&00,&00          ; 4FB1 '........'
            defb &03,&03,&03,&03,&03,&00,&00,&00          ; 4FB9 '........'
            defb &01,&03,&0F,&CF,&0F,&03,&02,&00          ; 4FC1 '........'
            defb &00,&03,&07,&0F,&CF,&0F,&0B,&03          ; 4FC9 '........'
            defb &00,&00,&03,&CF,&CF,&CF,&CF,&CF          ; 4FD1 '........'
            defb &03,&00,&00,&03,&CF,&CF,&CF,&CF          ; 4FD9 '........'
            defb &CF,&03,&00,&00,&03,&47,&CF,&CF          ; 4FE1 '.....G..'
            defb &CF,&8B,&03,&00,&00,&21,&03,&03          ; 4FE9 '.....!..'
            defb &30,&03,&03,&12,&00,&00,&30,&03          ; 4FF1 '0.....0.'
            defb &03,&30,&03,&03,&30,&00,&00,&30          ; 4FF9 '.0..0..0'
            defb &00,&03,&30,&03,&00,&30,&00,&00          ; 5001 '..0..0..'
            defb &30,&00,&03,&00,&03,&00,&30,&00          ; 5009 '0.....0.'
            defb &00,&00,&00,&03,&00,&03,&00,&00          ; 5011 '........'
            defb &00,&00,&00,&00,&03,&00,&03,&00          ; 5019 '........'
            defb &00,&00,&00,&00,&01,&02,&00,&01          ; 5021 '........'
            defb &02,&00,&00,&00,&00,&03,&02,&00          ; 5029 '........'
            defb &01,&03,&00,&00,&00,&00,&00,&00          ; 5031 '........'
            defb &00,&00,&00,&00,&15,&00,&03,&03          ; 5039 '........'
            defb &03,&03,&00,&2A,&00,&3F,&03,&03          ; 5041 '...*.?..'
            defb &03,&03,&3F,&00,&00,&03,&07,&4F          ; 5049 '..?....O'
            defb &8F,&0B,&03,&00,&01,&03,&0F,&4F          ; 5051 '.......O'
            defb &8F,&0F,&03,&02,&01,&47,&CF,&CF          ; 5059 '.....G..'
            defb &CF,&CF,&8B,&02,&01,&47,&CF,&CF          ; 5061 '.....G..'
            defb &CF,&CF,&8B,&02,&01,&03,&CF,&CF          ; 5069 '........'
            defb &CF,&CF,&03,&02,&00,&03,&03,&12          ; 5071 '........'
            defb &21,&03,&03,&00,&00,&10,&21,&12          ; 5079 '!.....!.'
            defb &21,&12,&20,&00,&00,&10,&21,&02          ; 5081 '!. ...!.'
            defb &01,&12,&20,&00,&00,&00,&01,&02          ; 5089 '.. .....'
            defb &01,&02,&00,&00,&00,&00,&01,&02          ; 5091 '........'
            defb &01,&02,&00,&00,&00,&00,&01,&02          ; 5099 '........'
            defb &01,&02,&00,&00,&00,&00,&01,&03          ; 50A1 '........'
            defb &03,&02,&00,&00,&00,&00,&03,&03          ; 50A9 '........'
            defb &03,&03,&00,&00,&00,&00,&00,&00          ; 50B1 '........'
            defb &00,&00,&00,&00,&00,&00,&2A,&01          ; 50B9 '......*.'
            defb &03,&03,&03,&02,&15,&00,&00,&15          ; 50C1 '........'
            defb &2B,&03,&03,&03,&17,&2A,&00,&00          ; 50C9 '+....*..'
            defb &01,&03,&0F,&CF,&0F,&03,&02,&00          ; 50D1 '........'
            defb &00,&03,&07,&0F,&CF,&0F,&0B,&03          ; 50D9 '........'
            defb &00,&00,&03,&CF,&CF,&CF,&CF,&CF          ; 50E1 '........'
            defb &03,&00,&00,&03,&CF,&CF,&CF,&CF          ; 50E9 '........'
            defb &CF,&03,&00,&00,&03,&47,&CF,&CF          ; 50F1 '.....G..'
            defb &CF,&8B,&03,&00,&00,&01,&03,&03          ; 50F9 '........'
            defb &30,&03,&03,&02,&00,&00,&00,&30          ; 5101 '0......0'
            defb &03,&30,&03,&30,&00,&00,&00,&00          ; 5109 '.0.0....'
            defb &30,&03,&00,&03,&30,&00,&00,&00          ; 5111 '0...0...'
            defb &00,&00,&03,&00,&03,&00,&00,&00          ; 5119 '........'
            defb &00,&00,&00,&03,&00,&03,&00,&00          ; 5121 '........'
            defb &00,&00,&00,&00,&03,&00,&03,&00          ; 5129 '........'
            defb &00,&00,&00,&00,&00,&03,&03,&03          ; 5131 '........'
            defb &00,&00,&00,&00,&00,&01,&03,&03          ; 5139 '........'
            defb &03,&02,&00,&00,&00,&00,&00,&00          ; 5141 '........'
            defb &00,&00,&00,&00,&00,&00,&00,&00          ; 5149 '........'
            defb &00,&00,&00,&00,&0A,&A2,&F3,&00          ; 5151 '........'
            defb &0A,&0F,&05,&51,&05,&5B,&5B,&5B          ; 5159 '...Q.[[['
            defb &5B,&5B,&5B,&A2,&00,&5B,&5B,&5B          ; 5161 '[[[..[[['
            defb &5B,&5B,&5B,&00,&15,&3F,&3F,&3F          ; 5169 '[[[..???'
            defb &3F,&3F,&3F,&2A,&00,&3F,&3F,&3F          ; 5171 '???*.???'
            defb &3F,&3F,&3F,&00,&00,&15,&3F,&3F          ; 5179 '???...??'
            defb &3F,&3F,&2A,&00,&00,&00,&3F,&3F          ; 5181 '??*...??'
            defb &3F,&3F,&00,&00,&00,&00,&3F,&C3          ; 5189 '??....?.'
            defb &C3,&3F,&00,&00,&00,&15,&2A,&0A          ; 5191 '.?....*.'
            defb &0A,&1F,&2A,&00,&00,&3F,&05,&05          ; 5199 '..*..?..'
            defb &05,&05,&3F,&00,&15,&2A,&0A,&0A          ; 51A1 '..?..*..'
            defb &0A,&0A,&1F,&2A,&3F,&3F,&3F,&3F          ; 51A9 '...*????'
            defb &3F,&3F,&3F,&3F,&3F,&3F,&3F,&3F          ; 51B1 '????????'
            defb &3F,&3F,&3F,&3F,&3F,&3F,&3F,&3F          ; 51B9 '????????'
            defb &3F,&3F,&3F,&3F,&00,&00,&00,&00          ; 51C1 '????....'
            defb &00,&00,&00,&00,&00,&00,&00,&00          ; 51C9 '........'
            defb &00,&00,&00,&00,&00,&00,&05,&51          ; 51D1 '.......Q'
            defb &51,&A2,&05,&05,&0A,&0A,&A2,&00          ; 51D9 'Q.......'
            defb &0F,&A7,&A7,&A7,&A7,&A7,&F3,&00          ; 51E1 '........'
            defb &00,&05,&A7,&A7,&A7,&A7,&A7,&A2          ; 51E9 '........'
            defb &00,&00,&3F,&3F,&3F,&3F,&3F,&3F          ; 51F1 '..??????'
            defb &3F,&00,&00,&15,&3F,&3F,&3F,&3F          ; 51F9 '?...????'
            defb &3F,&2A,&00,&00,&00,&3F,&3F,&3F          ; 5201 '?*...???'
            defb &3F,&3F,&00,&00,&00,&00,&15,&3F          ; 5209 '??.....?'
            defb &3F,&3F,&2A,&00,&00,&00,&00,&15          ; 5211 '??*.....'
            defb &6B,&C3,&97,&2A,&00,&00,&00,&00          ; 5219 'k..*....'
            defb &3F,&05,&05,&05,&3F,&00,&00,&00          ; 5221 '?...?...'
            defb &15,&2A,&0A,&0A,&0A,&1F,&2A,&00          ; 5229 '.*....*.'
            defb &00,&3F,&05,&05,&05,&05,&05,&3F          ; 5231 '.?.....?'
            defb &00,&15,&3F,&3F,&3F,&3F,&3F,&3F          ; 5239 '..??????'
            defb &3F,&2A,&15,&3F,&3F,&3F,&3F,&3F          ; 5241 '?*.?????'
            defb &3F,&3F,&2A,&15,&3F,&3F,&3F,&3F          ; 5249 '??*.????'
            defb &3F,&3F,&3F,&2A,&00,&00,&00,&00          ; 5251 '???*....'
            defb &00,&00,&00,&00,&00,&00,&00,&00          ; 5259 '........'
            defb &00,&00,&00,&00,&A2,&0A,&0F,&00          ; 5261 '........'
            defb &A2,&F3,&51,&05,&51,&A7,&A7,&A7          ; 5269 '..Q.Q...'
            defb &A7,&A7,&A7,&0A,&00,&A7,&A7,&A7          ; 5271 '........'
            defb &A7,&A7,&A7,&00,&15,&3F,&3F,&3F          ; 5279 '.....???'
            defb &3F,&3F,&3F,&2A,&00,&3F,&3F,&3F          ; 5281 '???*.???'
            defb &3F,&3F,&3F,&00,&00,&15,&3F,&3F          ; 5289 '???...??'
            defb &3F,&3F,&2A,&00,&00,&00,&3F,&3F          ; 5291 '??*...??'
            defb &3F,&3F,&00,&00,&00,&00,&3F,&C3          ; 5299 '??....?.'
            defb &C3,&3F,&00,&00,&00,&15,&2A,&0A          ; 52A1 '.?....*.'
            defb &0A,&1F,&2A,&00,&00,&3F,&05,&05          ; 52A9 '..*..?..'
            defb &05,&05,&3F,&00,&15,&2A,&0A,&0A          ; 52B1 '..?..*..'
            defb &0A,&0A,&1F,&2A,&3F,&3F,&3F,&3F          ; 52B9 '...*????'
            defb &3F,&3F,&3F,&3F,&3F,&3F,&3F,&3F          ; 52C1 '????????'
            defb &3F,&3F,&3F,&3F,&3F,&3F,&3F,&3F          ; 52C9 '????????'
            defb &3F,&3F,&3F,&3F,&00,&00,&00,&00          ; 52D1 '????....'
            defb &00,&00,&00,&00,&00,&00,&00,&00          ; 52D9 '........'
            defb &00,&00,&00,&00,&00,&00,&51,&05          ; 52E1 '......Q.'
            defb &05,&0A,&51,&51,&A2,&A2,&0A,&00          ; 52E9 '..QQ....'
            defb &F3,&5B,&5B,&5B,&5B,&5B,&0F,&00          ; 52F1 '.[[[[[..'
            defb &00,&51,&5B,&5B,&5B,&5B,&5B,&0A          ; 52F9 '.Q[[[[[.'
            defb &00,&00,&3F,&3F,&3F,&3F,&3F,&3F          ; 5301 '..??????'
            defb &3F,&00,&00,&15,&3F,&3F,&3F,&3F          ; 5309 '?...????'
            defb &3F,&2A,&00,&00,&00,&3F,&3F,&3F          ; 5311 '?*...???'
            defb &3F,&3F,&00,&00,&00,&00,&15,&3F          ; 5319 '??.....?'
            defb &3F,&3F,&2A,&00,&00,&00,&00,&15          ; 5321 '??*.....'
            defb &6B,&C3,&97,&2A,&00,&00,&00,&00          ; 5329 'k..*....'
            defb &3F,&05,&05,&05,&3F,&00,&00,&00          ; 5331 '?...?...'
            defb &15,&2A,&0A,&0A,&0A,&1F,&2A,&00          ; 5339 '.*....*.'
            defb &00,&3F,&05,&05,&05,&05,&05,&3F          ; 5341 '.?.....?'
            defb &00,&15,&3F,&3F,&3F,&3F,&3F,&3F          ; 5349 '..??????'
            defb &3F,&2A,&15,&3F,&3F,&3F,&3F,&3F          ; 5351 '?*.?????'
            defb &3F,&3F,&2A,&15,&3F,&3F,&3F,&3F          ; 5359 '??*.????'
            defb &3F,&3F,&3F,&2A,&00,&00,&00,&00          ; 5361 '???*....'
            defb &00,&00,&00,&00,&00,&00,&FF,&FF          ; 5369 '........'
            defb &FF,&FF,&00,&00,&00,&00,&55,&BF          ; 5371 '......U.'
            defb &7F,&AA,&00,&00,&00,&00,&00,&FF          ; 5379 '........'
            defb &FF,&00,&00,&00,&55,&00,&00,&05          ; 5381 '....U...'
            defb &AA,&00,&00,&AA,&55,&AA,&00,&8F          ; 5389 '....U...'
            defb &EF,&00,&55,&AA,&55,&FF,&45,&8F          ; 5391 '..U.U.E.'
            defb &EF,&8A,&FF,&AA,&55,&7F,&FF,&FF          ; 5399 '....U...'
            defb &AF,&0F,&BF,&AA,&55,&7F,&0F,&5F          ; 53A1 '....U.._'
            defb &FF,&FF,&BF,&AA,&55,&FF,&45,&DF          ; 53A9 '....U.E.'
            defb &4F,&8A,&FF,&AA,&55,&AA,&00,&DF          ; 53B1 'O...U...'
            defb &4F,&00,&55,&AA,&55,&00,&00,&55          ; 53B9 'O.U.U..U'
            defb &0A,&00,&00,&AA,&00,&00,&00,&FF          ; 53C1 '........'
            defb &FF,&00,&00,&00,&00,&00,&55,&BF          ; 53C9 '......U.'
            defb &7F,&AA,&00,&00,&00,&00,&FF,&FF          ; 53D1 '........'
            defb &FF,&FF,&00,&00,&00,&00,&00,&00          ; 53D9 '........'
            defb &00,&00,&00,&00,&00,&00,&00,&00          ; 53E1 '........'
            defb &00,&00,&00,&00,&00,&00,&00,&55          ; 53E9 '.......U'
            defb &FF,&FF,&FF,&AA,&00,&00,&00,&00          ; 53F1 '........'
            defb &00,&FF,&3F,&FF,&00,&00,&00,&00          ; 53F9 '..?.....'
            defb &00,&00,&55,&FF,&AA,&00,&00,&00          ; 5401 '..U.....'
            defb &00,&AA,&00,&00,&5F,&00,&00,&55          ; 5409 '...._..U'
            defb &00,&00,&FF,&00,&45,&5F,&8A,&00          ; 5411 '....E_..'
            defb &FF,&00,&00,&FF,&AA,&CF,&5F,&CF          ; 5419 '......_.'
            defb &55,&FF,&00,&00,&BF,&FF,&FF,&FF          ; 5421 'U.......'
            defb &0F,&5F,&7F,&00,&00,&BF,&AF,&0F          ; 5429 '._......'
            defb &FF,&FF,&FF,&7F,&00,&00,&FF,&AA          ; 5431 '........'
            defb &CF,&AF,&CF,&55,&FF,&00,&00,&FF          ; 5439 '...U....'
            defb &00,&45,&AF,&8A,&00,&FF,&00,&00          ; 5441 '.E......'
            defb &AA,&00,&00,&AF,&00,&00,&55,&00          ; 5449 '......U.'
            defb &00,&00,&00,&55,&FF,&AA,&00,&00          ; 5451 '...U....'
            defb &00,&00,&00,&00,&FF,&3F,&FF,&00          ; 5459 '.....?..'
            defb &00,&00,&00,&00,&55,&FF,&FF,&FF          ; 5461 '....U...'
            defb &AA,&00,&00,&00,&00,&00,&00,&00          ; 5469 '........'
            defb &00,&00,&00,&00,&00,&00,&00,&00          ; 5471 '........'
            defb &00,&00,&00,&00,&00,&00,&FF,&FF          ; 5479 '........'
            defb &FF,&FF,&00,&00,&00,&00,&55,&BF          ; 5481 '......U.'
            defb &7F,&AA,&00,&00,&00,&00,&45,&FF          ; 5489 '......E.'
            defb &FF,&8A,&00,&00,&55,&00,&CF,&8F          ; 5491 '....U...'
            defb &EF,&CF,&00,&AA,&55,&EF,&CF,&8F          ; 5499 '....U...'
            defb &EF,&CF,&DF,&AA,&55,&FF,&CF,&8F          ; 54A1 '....U...'
            defb &EF,&CF,&FF,&AA,&55,&7F,&FF,&FF          ; 54A9 '....U...'
            defb &AF,&0F,&BF,&AA,&55,&7F,&0F,&5F          ; 54B1 '....U.._'
            defb &FF,&FF,&BF,&AA,&55,&FF,&CF,&DF          ; 54B9 '....U...'
            defb &4F,&CF,&FF,&AA,&55,&EF,&CF,&DF          ; 54C1 'O...U...'
            defb &4F,&CF,&DF,&AA,&55,&00,&CF,&DF          ; 54C9 'O...U...'
            defb &4F,&CF,&00,&AA,&00,&00,&45,&FF          ; 54D1 'O.....E.'
            defb &FF,&8A,&00,&00,&00,&00,&55,&BF          ; 54D9 '......U.'
            defb &7F,&AA,&00,&00,&00,&00,&FF,&FF          ; 54E1 '........'
            defb &FF,&FF,&00,&00,&00,&00,&00,&00          ; 54E9 '........'
            defb &00,&00,&00,&00,&00,&00,&00,&00          ; 54F1 '........'
            defb &00,&00,&00,&00,&00,&00,&00,&55          ; 54F9 '.......U'
            defb &FF,&FF,&FF,&AA,&00,&00,&00,&00          ; 5501 '........'
            defb &00,&FF,&3F,&FF,&00,&00,&00,&00          ; 5509 '..?.....'
            defb &00,&00,&DF,&FF,&EF,&00,&00,&00          ; 5511 '........'
            defb &00,&AA,&45,&CF,&5F,&CF,&8A,&55          ; 5519 '..E._..U'
            defb &00,&00,&FF,&CF,&CF,&5F,&CF,&CF          ; 5521 '....._..'
            defb &FF,&00,&00,&FF,&EF,&CF,&5F,&CF          ; 5529 '......_.'
            defb &DF,&FF,&00,&00,&BF,&FF,&FF,&FF          ; 5531 '........'
            defb &0F,&5F,&7F,&00,&00,&BF,&AF,&0F          ; 5539 '._......'
            defb &FF,&FF,&FF,&7F,&00,&00,&FF,&EF          ; 5541 '........'
            defb &CF,&AF,&CF,&DF,&FF,&00,&00,&FF          ; 5549 '........'
            defb &CF,&CF,&AF,&CF,&CF,&FF,&00,&00          ; 5551 '........'
            defb &AA,&45,&CF,&AF,&CF,&8A,&55,&00          ; 5559 '.E....U.'
            defb &00,&00,&00,&DF,&FF,&EF,&00,&00          ; 5561 '........'
            defb &00,&00,&00,&00,&FF,&3F,&FF,&00          ; 5569 '.....?..'
            defb &00,&00,&00,&00,&55,&FF,&FF,&FF          ; 5571 '....U...'
            defb &AA,&00,&00,&00,&00,&00,&00,&00          ; 5579 '........'
            defb &00,&00,&00,&00,&00,&00,&00,&00          ; 5581 '........'
            defb &00,&00,&00,&00,&00,&45,&FF,&FF          ; 5589 '.....E..'
            defb &FF,&FF,&8A,&00,&00,&CF,&DF,&BF          ; 5591 '........'
            defb &7F,&EF,&CF,&00,&45,&CF,&CF,&FF          ; 5599 '....E...'
            defb &FF,&CF,&CF,&8A,&55,&CF,&CF,&8F          ; 55A1 '....U...'
            defb &EF,&CF,&CF,&AA,&55,&EF,&CF,&8F          ; 55A9 '....U...'
            defb &EF,&CF,&DF,&AA,&55,&FF,&CF,&8F          ; 55B1 '....U...'
            defb &EF,&CF,&FF,&AA,&55,&7F,&FF,&FF          ; 55B9 '....U...'
            defb &AF,&0F,&BF,&AA,&55,&7F,&0F,&5F          ; 55C1 '....U.._'
            defb &FF,&FF,&BF,&AA,&55,&FF,&CF,&DF          ; 55C9 '....U...'
            defb &4F,&CF,&FF,&AA,&55,&EF,&CF,&DF          ; 55D1 'O...U...'
            defb &4F,&CF,&DF,&AA,&55,&CF,&CF,&DF          ; 55D9 'O...U...'
            defb &4F,&CF,&CF,&AA,&45,&CF,&CF,&FF          ; 55E1 'O...E...'
            defb &FF,&CF,&CF,&8A,&00,&CF,&DF,&BF          ; 55E9 '........'
            defb &7F,&EF,&CF,&00,&00,&45,&FF,&FF          ; 55F1 '.....E..'
            defb &FF,&FF,&8A,&00,&00,&00,&00,&00          ; 55F9 '........'
            defb &00,&00,&00,&00,&00,&00,&00,&00          ; 5601 '........'
            defb &00,&00,&00,&00,&00,&00,&00,&DF          ; 5609 '........'
            defb &FF,&FF,&FF,&EF,&00,&00,&00,&45          ; 5611 '.......E'
            defb &CF,&FF,&3F,&FF,&CF,&8A,&00,&00          ; 5619 '..?.....'
            defb &CF,&CF,&DF,&FF,&EF,&CF,&CF,&00          ; 5621 '........'
            defb &00,&EF,&CF,&CF,&5F,&CF,&CF,&DF          ; 5629 '...._...'
            defb &00,&00,&FF,&CF,&CF,&5F,&CF,&CF          ; 5631 '....._..'
            defb &FF,&00,&00,&FF,&EF,&CF,&5F,&CF          ; 5639 '......_.'
            defb &DF,&FF,&00,&00,&BF,&FF,&FF,&FF          ; 5641 '........'
            defb &0F,&5F,&7F,&00,&00,&BF,&AF,&0F          ; 5649 '._......'
            defb &FF,&FF,&FF,&7F,&00,&00,&FF,&EF          ; 5651 '........'
            defb &CF,&AF,&CF,&DF,&FF,&00,&00,&FF          ; 5659 '........'
            defb &CF,&CF,&AF,&CF,&CF,&FF,&00,&00          ; 5661 '........'
            defb &EF,&CF,&CF,&AF,&CF,&CF,&DF,&00          ; 5669 '........'
            defb &00,&CF,&CF,&DF,&FF,&EF,&CF,&CF          ; 5671 '........'
            defb &00,&00,&45,&CF,&FF,&3F,&FF,&CF          ; 5679 '..E..?..'
            defb &8A,&00,&00,&00,&DF,&FF,&FF,&FF          ; 5681 '........'
            defb &EF,&00,&00,&00,&00,&00,&00,&00          ; 5689 '........'
            defb &00,&00,&00,&00,&00,&00,&00,&00          ; 5691 '........'
            defb &00,&00,&00,&00,&10,&30,&04,&0C          ; 5699 '.....0..'
            defb &0C,&08,&30,&20,&10,&9A,&08,&00          ; 56A1 '..0 ....'
            defb &00,&04,&65,&20,&10,&30,&00,&00          ; 56A9 '..e .0..'
            defb &00,&00,&30,&20,&00,&08,&30,&0C          ; 56B1 '..0 ..0.'
            defb &0C,&30,&04,&00,&04,&00,&30,&0C          ; 56B9 '.0....0.'
            defb &0C,&30,&00,&08,&04,&00,&0C,&30          ; 56C1 '.0.....0'
            defb &30,&0C,&00,&08,&04,&00,&0C,&30          ; 56C9 '0......0'
            defb &30,&0C,&00,&08,&04,&00,&0C,&30          ; 56D1 '0......0'
            defb &30,&0C,&00,&08,&04,&00,&0C,&30          ; 56D9 '0......0'
            defb &30,&0C,&00,&08,&04,&00,&30,&0C          ; 56E1 '0.....0.'
            defb &0C,&30,&00,&08,&00,&08,&30,&0C          ; 56E9 '.0....0.'
            defb &0C,&30,&04,&00,&10,&30,&00,&00          ; 56F1 '.0...0..'
            defb &00,&00,&30,&20,&10,&9A,&08,&00          ; 56F9 '..0 ....'
            defb &00,&04,&65,&20,&10,&30,&04,&0C          ; 5701 '..e .0..'
            defb &0C,&08,&30,&20,&00,&00,&00,&00          ; 5709 '..0 ....'
            defb &00,&00,&00,&00,&00,&00,&00,&00          ; 5711 '........'
            defb &00,&00,&00,&00,&00,&00,&30,&20          ; 5719 '......0 '
            defb &0C,&0C,&0C,&10,&30,&00,&00,&65          ; 5721 '....0..e'
            defb &24,&00,&00,&00,&18,&9A,&00,&00          ; 5729 '$.......'
            defb &30,&20,&00,&00,&00,&10,&30,&00          ; 5731 '0 ....0.'
            defb &00,&04,&10,&24,&0C,&18,&20,&08          ; 5739 '...$.. .'
            defb &00,&00,&08,&10,&24,&0C,&18,&20          ; 5741 '....$.. '
            defb &04,&00,&00,&08,&04,&18,&30,&24          ; 5749 '......0$'
            defb &08,&04,&00,&00,&08,&04,&18,&30          ; 5751 '.......0'
            defb &24,&08,&04,&00,&00,&08,&04,&18          ; 5759 '$.......'
            defb &30,&24,&08,&04,&00,&00,&08,&04          ; 5761 '0$......'
            defb &18,&30,&24,&08,&04,&00,&00,&08          ; 5769 '.0$.....'
            defb &10,&24,&0C,&18,&20,&04,&00,&00          ; 5771 '.$.. ...'
            defb &04,&10,&24,&0C,&18,&20,&08,&00          ; 5779 '..$.. ..'
            defb &00,&30,&20,&00,&00,&00,&10,&30          ; 5781 '.0 ....0'
            defb &00,&00,&65,&24,&00,&00,&00,&18          ; 5789 '..e$....'
            defb &9A,&00,&00,&30,&20,&0C,&0C,&0C          ; 5791 '...0 ...'
            defb &10,&30,&00,&00,&00,&00,&00,&00          ; 5799 '.0......'
            defb &00,&00,&00,&00,&00,&00,&00,&00          ; 57A1 '........'
            defb &00,&00,&00,&00,&10,&30,&00,&00          ; 57A9 '.....0..'
            defb &00,&00,&30,&20,&10,&9A,&00,&00          ; 57B1 '..0 ....'
            defb &00,&00,&65,&20,&10,&30,&04,&0C          ; 57B9 '..e .0..'
            defb &0C,&08,&30,&20,&00,&00,&30,&0C          ; 57C1 '..0 ..0.'
            defb &0C,&30,&00,&00,&00,&04,&30,&00          ; 57C9 '.0....0.'
            defb &00,&30,&08,&00,&00,&04,&08,&30          ; 57D1 '.0.....0'
            defb &30,&04,&08,&00,&00,&04,&08,&30          ; 57D9 '0......0'
            defb &30,&04,&08,&00,&00,&04,&08,&30          ; 57E1 '0......0'
            defb &30,&04,&08,&00,&00,&04,&08,&30          ; 57E9 '0......0'
            defb &30,&04,&08,&00,&00,&04,&30,&00          ; 57F1 '0.....0.'
            defb &00,&30,&08,&00,&00,&00,&30,&0C          ; 57F9 '.0....0.'
            defb &0C,&30,&00,&00,&10,&30,&04,&0C          ; 5801 '.0...0..'
            defb &0C,&08,&30,&20,&10,&9A,&00,&00          ; 5809 '..0 ....'
            defb &00,&00,&65,&20,&10,&30,&00,&00          ; 5811 '..e .0..'
            defb &00,&00,&30,&20,&00,&00,&00,&00          ; 5819 '..0 ....'
            defb &00,&00,&00,&00,&00,&00,&00,&00          ; 5821 '........'
            defb &00,&00,&00,&00,&00,&00,&30,&20          ; 5829 '......0 '
            defb &00,&00,&00,&10,&30,&00,&00,&65          ; 5831 '....0..e'
            defb &20,&00,&00,&00,&10,&9A,&00,&00          ; 5839 ' .......'
            defb &30,&20,&0C,&0C,&0C,&10,&30,&00          ; 5841 '0 ....0.'
            defb &00,&00,&10,&24,&0C,&18,&20,&00          ; 5849 '...$.. .'
            defb &00,&00,&00,&18,&20,&00,&10,&24          ; 5851 '.... ..$'
            defb &00,&00,&00,&00,&0C,&10,&30,&20          ; 5859 '......0 '
            defb &0C,&00,&00,&00,&00,&0C,&10,&30          ; 5861 '.......0'
            defb &20,&0C,&00,&00,&00,&00,&0C,&10          ; 5869 ' .......'
            defb &30,&20,&0C,&00,&00,&00,&00,&0C          ; 5871 '0 ......'
            defb &10,&30,&20,&0C,&00,&00,&00,&00          ; 5879 '.0 .....'
            defb &18,&20,&00,&10,&24,&00,&00,&00          ; 5881 '. ..$...'
            defb &00,&10,&24,&0C,&18,&20,&00,&00          ; 5889 '..$.. ..'
            defb &00,&30,&20,&0C,&0C,&0C,&10,&30          ; 5891 '.0 ....0'
            defb &00,&00,&65,&20,&00,&00,&00,&10          ; 5899 '..e ....'
            defb &9A,&00,&00,&30,&20,&00,&00,&00          ; 58A1 '...0 ...'
            defb &10,&30,&00,&00,&00,&00,&00,&00          ; 58A9 '.0......'
            defb &00,&00,&00,&00,&00,&00,&00,&00          ; 58B1 '........'
            defb &00,&00,&00,&00,&10,&30,&00,&0C          ; 58B9 '.....0..'
            defb &0C,&00,&30,&20,&10,&9A,&04,&0C          ; 58C1 '..0 ....'
            defb &0C,&08,&65,&20,&10,&30,&0C,&00          ; 58C9 '..e .0..'
            defb &00,&0C,&30,&20,&00,&04,&30,&00          ; 58D1 '..0 ..0.'
            defb &00,&30,&08,&00,&00,&0C,&30,&00          ; 58D9 '.0....0.'
            defb &00,&30,&0C,&00,&04,&08,&00,&30          ; 58E1 '.0.....0'
            defb &30,&00,&04,&08,&04,&08,&00,&35          ; 58E9 '0......5'
            defb &3A,&00,&04,&08,&04,&08,&00,&35          ; 58F1 ':......5'
            defb &3A,&00,&04,&08,&04,&08,&00,&30          ; 58F9 ':......0'
            defb &30,&00,&04,&08,&00,&0C,&30,&00          ; 5901 '0.....0.'
            defb &00,&30,&0C,&00,&00,&04,&30,&00          ; 5909 '.0....0.'
            defb &00,&30,&08,&00,&10,&30,&0C,&00          ; 5911 '.0...0..'
            defb &00,&0C,&30,&20,&10,&9A,&04,&0C          ; 5919 '..0 ....'
            defb &0C,&08,&65,&20,&10,&30,&00,&0C          ; 5921 '..e .0..'
            defb &0C,&00,&30,&20,&00,&00,&00,&00          ; 5929 '..0 ....'
            defb &00,&00,&00,&00,&00,&00,&00,&00          ; 5931 '........'
            defb &00,&00,&00,&00,&00,&00,&30,&20          ; 5939 '......0 '
            defb &04,&0C,&08,&10,&30,&00,&00,&65          ; 5941 '....0..e'
            defb &20,&0C,&0C,&0C,&10,&9A,&00,&00          ; 5949 ' .......'
            defb &30,&24,&08,&00,&04,&18,&30,&00          ; 5951 '0$....0.'
            defb &00,&00,&18,&20,&00,&10,&24,&00          ; 5959 '... ..$.'
            defb &00,&00,&04,&18,&20,&00,&10,&24          ; 5961 '.... ..$'
            defb &08,&00,&00,&0C,&00,&10,&30,&20          ; 5969 '......0 '
            defb &00,&0C,&00,&00,&0C,&00,&10,&3F          ; 5971 '.......?'
            defb &20,&00,&0C,&00,&00,&0C,&00,&10          ; 5979 ' .......'
            defb &3F,&20,&00,&0C,&00,&00,&0C,&00          ; 5981 '? ......'
            defb &10,&30,&20,&00,&0C,&00,&00,&04          ; 5989 '.0 .....'
            defb &18,&20,&00,&10,&24,&08,&00,&00          ; 5991 '. ..$...'
            defb &00,&18,&20,&00,&10,&24,&00,&00          ; 5999 '.. ..$..'
            defb &00,&30,&24,&08,&00,&04,&18,&30          ; 59A1 '.0$....0'
            defb &00,&00,&65,&20,&0C,&0C,&0C,&10          ; 59A9 '..e ....'
            defb &9A,&00,&00,&30,&20,&04,&0C,&08          ; 59B1 '...0 ...'
            defb &10,&30,&00,&00,&00,&00,&00,&00          ; 59B9 '.0......'
            defb &00,&00,&00,&00,&00,&00,&00,&00          ; 59C1 '........'
            defb &00,&00,&00,&00,&10,&00,&00,&22          ; 59C9 '......."'
            defb &11,&00,&00,&20,&00,&20,&00,&76          ; 59D1 '... . .v'
            defb &B9,&00,&10,&00,&00,&30,&00,&54          ; 59D9 '.....0.T'
            defb &A8,&00,&30,&00,&00,&10,&20,&54          ; 59E1 '..0... T'
            defb &A8,&10,&20,&00,&00,&10,&30,&CF          ; 59E9 '.. ...0.'
            defb &CF,&30,&20,&00,&00,&00,&30,&CF          ; 59F1 '.0 ...0.'
            defb &CF,&30,&00,&00,&00,&00,&30,&CF          ; 59F9 '.0....0.'
            defb &CF,&30,&00,&00,&00,&00,&10,&CF          ; 5A01 '.0......'
            defb &CF,&20,&00,&00,&00,&00,&00,&6F          ; 5A09 '. .....o'
            defb &9F,&00,&00,&00,&00,&00,&00,&6F          ; 5A11 '.......o'
            defb &9F,&00,&00,&00,&00,&00,&00,&2A          ; 5A19 '.......*'
            defb &15,&00,&00,&00,&00,&00,&15,&2A          ; 5A21 '.......*'
            defb &15,&2A,&00,&00,&00,&00,&3F,&00          ; 5A29 '.*....?.'
            defb &00,&3F,&00,&00,&00,&15,&15,&00          ; 5A31 '.?......'
            defb &00,&2A,&2A,&00,&00,&00,&00,&00          ; 5A39 '.**.....'
            defb &00,&00,&00,&00,&00,&00,&00,&00          ; 5A41 '........'
            defb &00,&00,&00,&00,&00,&00,&20,&00          ; 5A49 '...... .'
            defb &11,&00,&22,&00,&10,&00,&00,&10          ; 5A51 '..".....'
            defb &00,&11,&FC,&22,&00,&20,&00,&00          ; 5A59 '...". ..'
            defb &10,&20,&00,&FC,&00,&10,&20,&00          ; 5A61 '. .... .'
            defb &00,&00,&30,&00,&FC,&00,&30,&00          ; 5A69 '..0...0.'
            defb &00,&00,&00,&30,&65,&CF,&9A,&30          ; 5A71 '...0e..0'
            defb &00,&00,&00,&00,&10,&65,&CF,&9A          ; 5A79 '.....e..'
            defb &20,&00,&00,&00,&00,&10,&65,&CF          ; 5A81 ' .....e.'
            defb &9A,&20,&00,&00,&00,&00,&00,&65          ; 5A89 '. .....e'
            defb &CF,&9A,&00,&00,&00,&00,&00,&00          ; 5A91 '........'
            defb &15,&CF,&2A,&00,&00,&00,&00,&00          ; 5A99 '..*.....'
            defb &00,&15,&CF,&2A,&00,&00,&00,&00          ; 5AA1 '...*....'
            defb &00,&00,&15,&00,&2A,&00,&00,&00          ; 5AA9 '....*...'
            defb &00,&00,&00,&3F,&00,&3F,&00,&00          ; 5AB1 '...?.?..'
            defb &00,&00,&00,&15,&2A,&00,&15,&2A          ; 5AB9 '....*..*'
            defb &00,&00,&00,&00,&2A,&2A,&00,&15          ; 5AC1 '....**..'
            defb &15,&00,&00,&00,&00,&00,&00,&00          ; 5AC9 '........'
            defb &00,&00,&00,&00,&00,&00,&00,&00          ; 5AD1 '........'
            defb &00,&00,&00,&00,&00,&00,&00,&22          ; 5AD9 '......."'
            defb &11,&00,&00,&00,&00,&00,&00,&76          ; 5AE1 '.......v'
            defb &B9,&00,&00,&00,&00,&00,&00,&54          ; 5AE9 '.......T'
            defb &A8,&00,&00,&00,&00,&00,&00,&54          ; 5AF1 '.......T'
            defb &A8,&00,&00,&00,&10,&30,&30,&CF          ; 5AF9 '.....00.'
            defb &CF,&30,&30,&20,&00,&30,&30,&CF          ; 5B01 '.00 .00.'
            defb &CF,&30,&30,&00,&00,&10,&30,&CF          ; 5B09 '.00...0.'
            defb &CF,&30,&20,&00,&00,&00,&30,&CF          ; 5B11 '.0 ...0.'
            defb &CF,&30,&00,&00,&00,&00,&00,&6F          ; 5B19 '.0.....o'
            defb &9F,&00,&00,&00,&00,&00,&00,&6F          ; 5B21 '.......o'
            defb &9F,&00,&00,&00,&00,&00,&00,&2A          ; 5B29 '.......*'
            defb &15,&00,&00,&00,&00,&00,&15,&2A          ; 5B31 '.......*'
            defb &15,&2A,&00,&00,&00,&00,&3F,&00          ; 5B39 '.*....?.'
            defb &00,&3F,&00,&00,&00,&15,&15,&00          ; 5B41 '.?......'
            defb &00,&2A,&2A,&00,&00,&00,&00,&00          ; 5B49 '.**.....'
            defb &00,&00,&00,&00,&00,&00,&00,&00          ; 5B51 '........'
            defb &00,&00,&00,&00,&00,&00,&00,&00          ; 5B59 '........'
            defb &11,&00,&22,&00,&00,&00,&00,&00          ; 5B61 '..".....'
            defb &00,&11,&FC,&22,&00,&00,&00,&00          ; 5B69 '..."....'
            defb &00,&00,&00,&FC,&00,&00,&00,&00          ; 5B71 '........'
            defb &00,&00,&00,&00,&FC,&00,&00,&00          ; 5B79 '........'
            defb &00,&00,&30,&30,&65,&CF,&9A,&30          ; 5B81 '..00e..0'
            defb &30,&00,&00,&10,&30,&65,&CF,&9A          ; 5B89 '0...0e..'
            defb &30,&20,&00,&00,&00,&30,&65,&CF          ; 5B91 '0 ...0e.'
            defb &9A,&30,&00,&00,&00,&00,&10,&65          ; 5B99 '.0.....e'
            defb &CF,&9A,&20,&00,&00,&00,&00,&00          ; 5BA1 '.. .....'
            defb &15,&CF,&2A,&00,&00,&00,&00,&00          ; 5BA9 '..*.....'
            defb &00,&15,&CF,&2A,&00,&00,&00,&00          ; 5BB1 '...*....'
            defb &00,&00,&15,&00,&2A,&00,&00,&00          ; 5BB9 '....*...'
            defb &00,&00,&00,&3F,&00,&3F,&00,&00          ; 5BC1 '...?.?..'
            defb &00,&00,&00,&15,&2A,&00,&15,&2A          ; 5BC9 '....*..*'
            defb &00,&00,&00,&00,&2A,&2A,&00,&15          ; 5BD1 '....**..'
            defb &15,&00,&00,&00,&00,&00,&00,&00          ; 5BD9 '........'
            defb &00,&00,&00,&00,&00,&00,&00,&00          ; 5BE1 '........'
            defb &00,&00,&00,&00,&00,&00,&00,&22          ; 5BE9 '......."'
            defb &11,&00,&00,&00,&00,&00,&00,&76          ; 5BF1 '.......v'
            defb &B9,&00,&00,&00,&00,&00,&00,&54          ; 5BF9 '.......T'
            defb &A8,&00,&00,&00,&00,&00,&00,&54          ; 5C01 '.......T'
            defb &A8,&00,&00,&00,&00,&00,&10,&CF          ; 5C09 '........'
            defb &CF,&20,&00,&00,&00,&10,&30,&CF          ; 5C11 '. ....0.'
            defb &CF,&30,&20,&00,&00,&30,&30,&CF          ; 5C19 '.0 ..00.'
            defb &CF,&30,&30,&00,&10,&30,&30,&CF          ; 5C21 '.00..00.'
            defb &CF,&30,&30,&20,&00,&00,&10,&6F          ; 5C29 '.00 ...o'
            defb &9F,&20,&00,&00,&00,&00,&00,&6F          ; 5C31 '. .....o'
            defb &9F,&00,&00,&00,&00,&00,&00,&2A          ; 5C39 '.......*'
            defb &15,&00,&00,&00,&00,&00,&15,&2A          ; 5C41 '.......*'
            defb &15,&2A,&00,&00,&00,&00,&3F,&00          ; 5C49 '.*....?.'
            defb &00,&3F,&00,&00,&00,&15,&15,&00          ; 5C51 '.?......'
            defb &00,&2A,&2A,&00,&00,&00,&00,&00          ; 5C59 '.**.....'
            defb &00,&00,&00,&00,&00,&00,&00,&00          ; 5C61 '........'
            defb &00,&00,&00,&00,&00,&00,&00,&00          ; 5C69 '........'
            defb &11,&00,&22,&00,&00,&00,&00,&00          ; 5C71 '..".....'
            defb &00,&11,&FC,&22,&00,&00,&00,&00          ; 5C79 '..."....'
            defb &00,&00,&00,&FC,&00,&00,&00,&00          ; 5C81 '........'
            defb &00,&00,&00,&00,&FC,&00,&00,&00          ; 5C89 '........'
            defb &00,&00,&00,&00,&65,&CF,&9A,&00          ; 5C91 '....e...'
            defb &00,&00,&00,&00,&30,&65,&CF,&9A          ; 5C99 '....0e..'
            defb &30,&00,&00,&00,&10,&30,&65,&CF          ; 5CA1 '0....0e.'
            defb &9A,&30,&20,&00,&00,&30,&30,&65          ; 5CA9 '.0 ..00e'
            defb &CF,&9A,&30,&30,&00,&00,&00,&00          ; 5CB1 '..00....'
            defb &35,&CF,&3A,&00,&00,&00,&00,&00          ; 5CB9 '5.:.....'
            defb &00,&15,&CF,&2A,&00,&00,&00,&00          ; 5CC1 '...*....'
            defb &00,&00,&15,&00,&2A,&00,&00,&00          ; 5CC9 '....*...'
            defb &00,&00,&00,&3F,&00,&3F,&00,&00          ; 5CD1 '...?.?..'
            defb &00,&00,&00,&15,&2A,&00,&15,&2A          ; 5CD9 '....*..*'
            defb &00,&00,&00,&00,&2A,&2A,&00,&15          ; 5CE1 '....**..'
            defb &15,&00,&00,&00,&00,&00,&00,&00          ; 5CE9 '........'
            defb &00,&00,&00,&00,&00,&00,&00,&00          ; 5CF1 '........'
            defb &00,&00,&00,&00,&00,&00,&00,&00          ; 5CF9 '........'
            defb &00,&00,&00,&00,&00,&00,&00,&00          ; 5D01 '........'
            defb &00,&00,&00,&00,&00,&00,&00,&00          ; 5D09 '........'
            defb &00,&00,&00,&00,&00,&00,&00,&00          ; 5D11 '........'
            defb &00,&00,&00,&00,&00,&00,&00,&11          ; 5D19 '........'
            defb &22,&00,&00,&00,&00,&00,&00,&33          ; 5D21 '"......3'
            defb &33,&00,&00,&00,&00,&00,&11,&33          ; 5D29 '3......3'
            defb &33,&22,&00,&00,&00,&00,&11,&33          ; 5D31 '3".....3'
            defb &33,&22,&00,&00,&00,&00,&00,&33          ; 5D39 '3".....3'
            defb &33,&00,&00,&00,&00,&00,&00,&11          ; 5D41 '3.......'
            defb &22,&00,&00,&00,&00,&00,&00,&00          ; 5D49 '".......'
            defb &00,&00,&00,&00,&00,&00,&00,&00          ; 5D51 '........'
            defb &00,&00,&00,&00,&00,&00,&00,&00          ; 5D59 '........'
            defb &00,&00,&00,&00,&00,&00,&00,&00          ; 5D61 '........'
            defb &00,&00,&00,&00,&00,&00,&00,&00          ; 5D69 '........'
            defb &00,&00,&00,&00,&00,&00,&00,&00          ; 5D71 '........'
            defb &00,&00,&00,&00,&00,&00,&00,&00          ; 5D79 '........'
            defb &00,&00,&00,&00,&00,&00,&00,&00          ; 5D81 '........'
            defb &00,&00,&00,&00,&00,&00,&00,&00          ; 5D89 '........'
            defb &00,&00,&00,&00,&00,&00,&00,&00          ; 5D91 '........'
            defb &00,&00,&00,&00,&00,&00,&00,&00          ; 5D99 '........'
            defb &00,&00,&00,&00,&00,&33,&00,&00          ; 5DA1 '.....3..'
            defb &00,&00,&00,&00,&00,&11,&33,&22          ; 5DA9 '......3"'
            defb &00,&00,&00,&00,&00,&00,&33,&33          ; 5DB1 '......33'
            defb &33,&00,&00,&00,&00,&00,&00,&33          ; 5DB9 '3......3'
            defb &33,&33,&00,&00,&00,&00,&00,&00          ; 5DC1 '33......'
            defb &11,&33,&22,&00,&00,&00,&00,&00          ; 5DC9 '.3".....'
            defb &00,&00,&33,&00,&00,&00,&00,&00          ; 5DD1 '..3.....'
            defb &00,&00,&00,&00,&00,&00,&00,&00          ; 5DD9 '........'
            defb &00,&00,&00,&00,&00,&00,&00,&00          ; 5DE1 '........'
            defb &00,&00,&00,&00,&00,&00,&00,&00          ; 5DE9 '........'
            defb &00,&00,&00,&00,&00,&00,&00,&00          ; 5DF1 '........'
            defb &00,&00,&00,&00,&00,&00,&00,&00          ; 5DF9 '........'
            defb &00,&00,&00,&00,&00,&00,&00,&00          ; 5E01 '........'
            defb &00,&00,&00,&00,&00,&00,&00,&00          ; 5E09 '........'
            defb &00,&00,&00,&00,&00,&00,&00,&00          ; 5E11 '........'
            defb &00,&00,&00,&00,&00,&00,&00,&11          ; 5E19 '........'
            defb &22,&00,&00,&00,&00,&00,&11,&33          ; 5E21 '"......3'
            defb &33,&22,&00,&00,&00,&00,&33,&33          ; 5E29 '3"....33'
            defb &33,&33,&00,&00,&00,&00,&33,&27          ; 5E31 '33....3''
            defb &1B,&33,&00,&00,&00,&11,&33,&0F          ; 5E39 '.3....3.'
            defb &0F,&33,&22,&00,&00,&11,&33,&0F          ; 5E41 '.3"...3.'
            defb &0F,&33,&22,&00,&00,&00,&33,&27          ; 5E49 '.3"...3''
            defb &1B,&33,&00,&00,&00,&00,&33,&33          ; 5E51 '.3....33'
            defb &33,&33,&00,&00,&00,&00,&11,&33          ; 5E59 '33.....3'
            defb &33,&22,&00,&00,&00,&00,&00,&11          ; 5E61 '3"......'
            defb &22,&00,&00,&00,&00,&00,&00,&00          ; 5E69 '".......'
            defb &00,&00,&00,&00,&00,&00,&00,&00          ; 5E71 '........'
            defb &00,&00,&00,&00,&00,&00,&00,&00          ; 5E79 '........'
            defb &00,&00,&00,&00,&00,&00,&00,&00          ; 5E81 '........'
            defb &00,&00,&00,&00,&00,&00,&00,&00          ; 5E89 '........'
            defb &00,&00,&00,&00,&00,&00,&00,&00          ; 5E91 '........'
            defb &00,&00,&00,&00,&00,&00,&00,&00          ; 5E99 '........'
            defb &00,&00,&00,&33,&00,&00,&00,&00          ; 5EA1 '...3....'
            defb &00,&00,&00,&33,&33,&33,&00,&00          ; 5EA9 '...333..'
            defb &00,&00,&00,&11,&33,&33,&33,&22          ; 5EB1 '....333"'
            defb &00,&00,&00,&00,&11,&33,&0F,&33          ; 5EB9 '.....3.3'
            defb &22,&00,&00,&00,&00,&33,&27,&0F          ; 5EC1 '"....3'.'
            defb &1B,&33,&00,&00,&00,&00,&33,&27          ; 5EC9 '.3....3''
            defb &0F,&1B,&33,&00,&00,&00,&00,&11          ; 5ED1 '..3.....'
            defb &33,&0F,&33,&22,&00,&00,&00,&00          ; 5ED9 '3.3"....'
            defb &11,&33,&33,&33,&22,&00,&00,&00          ; 5EE1 '.333"...'
            defb &00,&00,&33,&33,&33,&00,&00,&00          ; 5EE9 '..333...'
            defb &00,&00,&00,&00,&33,&00,&00,&00          ; 5EF1 '....3...'
            defb &00,&00,&00,&00,&00,&00,&00,&00          ; 5EF9 '........'
            defb &00,&00,&00,&00,&00,&00,&00,&00          ; 5F01 '........'
            defb &00,&00,&00,&00,&00,&00,&00,&00          ; 5F09 '........'
            defb &00,&00,&00,&00,&00,&00,&00,&11          ; 5F11 '........'
            defb &22,&00,&00,&00,&00,&00,&11,&33          ; 5F19 '"......3'
            defb &33,&22,&00,&00,&00,&11,&33,&33          ; 5F21 '3"....33'
            defb &33,&33,&22,&00,&00,&33,&33,&27          ; 5F29 '33"..33''
            defb &1B,&33,&33,&00,&00,&33,&27,&0F          ; 5F31 '.33..3'.'
            defb &0F,&1B,&33,&00,&11,&33,&0F,&0F          ; 5F39 '..3..3..'
            defb &0F,&0F,&33,&22,&11,&33,&0F,&1F          ; 5F41 '..3".3..'
            defb &2F,&0F,&33,&22,&33,&27,&0F,&3F          ; 5F49 '/.3"3'.?'
            defb &3F,&0F,&1B,&33,&33,&27,&0F,&3F          ; 5F51 '?..33'.?'
            defb &3F,&0F,&1B,&33,&11,&33,&0F,&1F          ; 5F59 '?..3.3..'
            defb &2F,&0F,&33,&22,&11,&33,&0F,&0F          ; 5F61 '/.3".3..'
            defb &0F,&0F,&33,&22,&00,&33,&27,&0F          ; 5F69 '..3".3'.'
            defb &0F,&1B,&33,&00,&00,&33,&33,&27          ; 5F71 '..3..33''
            defb &1B,&33,&33,&00,&00,&11,&33,&33          ; 5F79 '.33...33'
            defb &33,&33,&22,&00,&00,&00,&33,&33          ; 5F81 '33"...33'
            defb &33,&22,&00,&00,&00,&00,&00,&11          ; 5F89 '3"......'
            defb &22,&00,&00,&00,&00,&00,&00,&00          ; 5F91 '".......'
            defb &33,&00,&00,&00,&00,&00,&00,&00          ; 5F99 '3.......'
            defb &33,&33,&33,&00,&00,&00,&00,&00          ; 5FA1 '333.....'
            defb &33,&33,&33,&33,&33,&00,&00,&00          ; 5FA9 '33333...'
            defb &11,&33,&33,&0F,&33,&33,&22,&00          ; 5FB1 '.33.33".'
            defb &00,&11,&33,&0F,&0F,&0F,&33,&22          ; 5FB9 '..3...3"'
            defb &00,&00,&33,&27,&0F,&0F,&0F,&1B          ; 5FC1 '..3'....'
            defb &33,&00,&00,&33,&27,&0F,&3F,&0F          ; 5FC9 '3..3'.?.'
            defb &1B,&33,&00,&11,&33,&0F,&1F,&3F          ; 5FD1 '.3..3..?'
            defb &2F,&0F,&33,&22,&11,&33,&0F,&1F          ; 5FD9 '/.3".3..'
            defb &3F,&2F,&0F,&33,&22,&00,&33,&27          ; 5FE1 '?/.3".3''
            defb &0F,&3F,&0F,&1B,&33,&00,&00,&33          ; 5FE9 '.?..3..3'
            defb &27,&0F,&0F,&0F,&1B,&33,&00,&00          ; 5FF1 ''....3..'
            defb &11,&33,&0F,&0F,&0F,&33,&22,&00          ; 5FF9 '.3...3".'
            defb &00,&11,&33,&33,&0F,&33,&33,&22          ; 6001 '..33.33"'
            defb &00,&00,&00,&33,&33,&33,&33,&33          ; 6009 '...33333'
            defb &00,&00,&00,&00,&11,&33,&33,&33          ; 6011 '.....333'
            defb &00,&00,&00,&00,&00,&00,&00,&33          ; 6019 '.......3'
            defb &00,&00,&00,&00,&00,&00,&00,&05          ; 6021 '........'
            defb &0A,&00,&00,&00,&00,&00,&05,&0F          ; 6029 '........'
            defb &0F,&0A,&00,&00,&00,&05,&0F,&0F          ; 6031 '........'
            defb &0F,&0F,&0A,&00,&00,&0F,&0F,&1F          ; 6039 '........'
            defb &2F,&0F,&0F,&00,&00,&0F,&1F,&3F          ; 6041 '/......?'
            defb &3F,&2F,&0F,&00,&05,&0F,&3F,&3F          ; 6049 '?/....??'
            defb &3F,&3F,&0F,&0A,&05,&0F,&3F,&6E          ; 6051 '??....?n'
            defb &9D,&3F,&0F,&0A,&0F,&1F,&3F,&CC          ; 6059 '.?....?.'
            defb &CC,&3F,&2F,&0F,&0F,&1F,&3F,&CC          ; 6061 '.?/...?.'
            defb &CC,&3F,&2F,&0F,&05,&0F,&3F,&6E          ; 6069 '.?/...?n'
            defb &9D,&3F,&0F,&0A,&05,&0F,&3F,&3F          ; 6071 '.?....??'
            defb &3F,&3F,&0F,&0A,&00,&0F,&1F,&3F          ; 6079 '??.....?'
            defb &3F,&2F,&0F,&00,&00,&0F,&0F,&1F          ; 6081 '?/......'
            defb &2F,&0F,&0F,&00,&00,&05,&0F,&0F          ; 6089 '/.......'
            defb &0F,&0F,&0A,&00,&00,&00,&0F,&0F          ; 6091 '........'
            defb &0F,&0A,&00,&00,&00,&00,&00,&05          ; 6099 '........'
            defb &0A,&00,&00,&00,&00,&00,&00,&00          ; 60A1 '........'
            defb &0F,&00,&00,&00,&00,&00,&00,&00          ; 60A9 '........'
            defb &0F,&0F,&0F,&00,&00,&00,&00,&00          ; 60B1 '........'
            defb &0F,&0F,&0F,&0F,&0F,&00,&00,&00          ; 60B9 '........'
            defb &05,&0F,&0F,&3F,&0F,&0F,&0A,&00          ; 60C1 '...?....'
            defb &00,&05,&0F,&3F,&3F,&3F,&0F,&0A          ; 60C9 '...???..'
            defb &00,&00,&0F,&1F,&3F,&3F,&3F,&2F          ; 60D1 '....???/'
            defb &0F,&00,&00,&0F,&1F,&3F,&CC,&3F          ; 60D9 '.....?.?'
            defb &2F,&0F,&00,&05,&0F,&3F,&6E,&CC          ; 60E1 '/....?n.'
            defb &9D,&3F,&0F,&0A,&05,&0F,&3F,&6E          ; 60E9 '.?....?n'
            defb &CC,&9D,&3F,&0F,&0A,&00,&0F,&1F          ; 60F1 '..?.....'
            defb &3F,&CC,&3F,&2F,&0F,&00,&00,&0F          ; 60F9 '?.?/....'
            defb &1F,&3F,&3F,&3F,&2F,&0F,&00,&00          ; 6101 '.???/...'
            defb &05,&0F,&3F,&3F,&3F,&0F,&0A,&00          ; 6109 '..???...'
            defb &00,&05,&0F,&0F,&3F,&0F,&0F,&0A          ; 6111 '....?...'
            defb &00,&00,&00,&0F,&0F,&0F,&0F,&0F          ; 6119 '........'
            defb &00,&00,&00,&00,&05,&0F,&0F,&0F          ; 6121 '........'
            defb &00,&00,&00,&00,&00,&00,&00,&0F          ; 6129 '........'
            defb &00,&00,&00,&00,&00,&00,&00,&15          ; 6131 '........'
            defb &2A,&00,&00,&00,&00,&00,&15,&3F          ; 6139 '*......?'
            defb &3F,&2A,&00,&00,&00,&15,&3F,&3F          ; 6141 '?*....??'
            defb &3F,&3F,&2A,&00,&00,&3F,&3F,&6E          ; 6149 '??*..??n'
            defb &9D,&3F,&3F,&00,&00,&3F,&6E,&CC          ; 6151 '.??..?n.'
            defb &CC,&9D,&3F,&00,&15,&3F,&CC,&CC          ; 6159 '..?..?..'
            defb &CC,&CC,&3F,&2A,&15,&3F,&CC,&88          ; 6161 '..?*.?..'
            defb &44,&CC,&3F,&2A,&3F,&6E,&CC,&00          ; 6169 'D.?*?n..'
            defb &00,&CC,&9D,&3F,&3F,&6E,&CC,&00          ; 6171 '...??n..'
            defb &00,&CC,&9D,&3F,&15,&3F,&CC,&88          ; 6179 '...?.?..'
            defb &44,&CC,&3F,&2A,&15,&3F,&CC,&CC          ; 6181 'D.?*.?..'
            defb &CC,&CC,&3F,&2A,&00,&3F,&6E,&CC          ; 6189 '..?*.?n.'
            defb &CC,&9D,&3F,&00,&00,&3F,&3F,&6E          ; 6191 '..?..??n'
            defb &9D,&3F,&3F,&00,&00,&15,&3F,&3F          ; 6199 '.??...??'
            defb &3F,&3F,&2A,&00,&00,&00,&3F,&3F          ; 61A1 '??*...??'
            defb &3F,&2A,&00,&00,&00,&00,&00,&15          ; 61A9 '?*......'
            defb &2A,&00,&00,&00,&00,&00,&00,&00          ; 61B1 '*.......'
            defb &3F,&00,&00,&00,&00,&00,&00,&00          ; 61B9 '?.......'
            defb &3F,&3F,&3F,&00,&00,&00,&00,&00          ; 61C1 '???.....'
            defb &3F,&3F,&3F,&3F,&3F,&00,&00,&00          ; 61C9 '?????...'
            defb &15,&3F,&3F,&CC,&3F,&3F,&2A,&00          ; 61D1 '.??.??*.'
            defb &00,&15,&3F,&CC,&CC,&CC,&3F,&2A          ; 61D9 '..?...?*'
            defb &00,&00,&3F,&6E,&CC,&CC,&CC,&9D          ; 61E1 '..?n....'
            defb &3F,&00,&00,&3F,&6E,&CC,&00,&CC          ; 61E9 '?..?n...'
            defb &9D,&3F,&00,&15,&3F,&CC,&88,&00          ; 61F1 '.?..?...'
            defb &44,&CC,&3F,&2A,&15,&3F,&CC,&88          ; 61F9 'D.?*.?..'
            defb &00,&44,&CC,&3F,&2A,&00,&3F,&6E          ; 6201 '.D.?*.?n'
            defb &CC,&00,&CC,&9D,&3F,&00,&00,&3F          ; 6209 '....?..?'
            defb &6E,&CC,&CC,&CC,&9D,&3F,&00,&00          ; 6211 'n....?..'
            defb &15,&3F,&CC,&CC,&CC,&3F,&2A,&00          ; 6219 '.?...?*.'
            defb &00,&15,&3F,&3F,&CC,&3F,&3F,&2A          ; 6221 '..??.??*'
            defb &00,&00,&00,&3F,&3F,&3F,&3F,&3F          ; 6229 '...?????'
            defb &00,&00,&00,&00,&15,&3F,&3F,&3F          ; 6231 '.....???'
            defb &00,&00,&00,&00,&00,&00,&00,&3F          ; 6239 '.......?'
            defb &00,&00,&00,&00,&00,&00,&00,&44          ; 6241 '.......D'
            defb &88,&00,&00,&00,&00,&00,&44,&CC          ; 6249 '......D.'
            defb &CC,&88,&00,&00,&00,&44,&CC,&CC          ; 6251 '.....D..'
            defb &CC,&CC,&88,&00,&00,&CC,&CC,&CC          ; 6259 '........'
            defb &CC,&CC,&CC,&00,&00,&CC,&CC,&88          ; 6261 '........'
            defb &44,&CC,&CC,&00,&44,&CC,&CC,&00          ; 6269 'D...D...'
            defb &00,&CC,&CC,&88,&44,&CC,&88,&00          ; 6271 '....D...'
            defb &00,&44,&CC,&88,&CC,&CC,&00,&00          ; 6279 '.D......'
            defb &00,&00,&CC,&CC,&CC,&CC,&00,&00          ; 6281 '........'
            defb &00,&00,&CC,&CC,&44,&CC,&88,&00          ; 6289 '....D...'
            defb &00,&44,&CC,&88,&44,&CC,&CC,&00          ; 6291 '.D..D...'
            defb &00,&CC,&CC,&88,&00,&CC,&CC,&88          ; 6299 '........'
            defb &44,&CC,&CC,&00,&00,&CC,&CC,&CC          ; 62A1 'D.......'
            defb &CC,&CC,&CC,&00,&00,&44,&CC,&CC          ; 62A9 '.....D..'
            defb &CC,&CC,&88,&00,&00,&00,&CC,&CC          ; 62B1 '........'
            defb &CC,&88,&00,&00,&00,&00,&00,&44          ; 62B9 '.......D'
            defb &88,&00,&00,&00,&00,&00,&00,&00          ; 62C1 '........'
            defb &CC,&00,&00,&00,&00,&00,&00,&00          ; 62C9 '........'
            defb &CC,&CC,&CC,&00,&00,&00,&00,&00          ; 62D1 '........'
            defb &CC,&CC,&CC,&CC,&CC,&00,&00,&00          ; 62D9 '........'
            defb &44,&CC,&CC,&CC,&CC,&CC,&88,&00          ; 62E1 'D.......'
            defb &00,&44,&CC,&CC,&00,&CC,&CC,&88          ; 62E9 '.D......'
            defb &00,&00,&CC,&CC,&88,&00,&44,&CC          ; 62F1 '......D.'
            defb &CC,&00,&00,&CC,&CC,&00,&00,&00          ; 62F9 '........'
            defb &CC,&CC,&00,&44,&CC,&88,&00,&00          ; 6301 '...D....'
            defb &00,&44,&CC,&88,&44,&CC,&88,&00          ; 6309 '.D..D...'
            defb &00,&00,&44,&CC,&88,&00,&CC,&CC          ; 6311 '..D.....'
            defb &00,&00,&00,&CC,&CC,&00,&00,&CC          ; 6319 '........'
            defb &CC,&88,&00,&44,&CC,&CC,&00,&00          ; 6321 '...D....'
            defb &44,&CC,&CC,&00,&CC,&CC,&88,&00          ; 6329 'D.......'
            defb &00,&44,&CC,&CC,&CC,&CC,&CC,&88          ; 6331 '.D......'
            defb &00,&00,&00,&CC,&CC,&CC,&CC,&CC          ; 6339 '........'
            defb &00,&00,&00,&00,&44,&CC,&CC,&CC          ; 6341 '....D...'
            defb &00,&00,&00,&00,&00,&00,&00,&CC          ; 6349 '........'
            defb &00,&00,&00,&00,&00,&00,&00,&44          ; 6351 '.......D'
            defb &88,&00,&00,&00,&00,&00,&44,&88          ; 6359 '......D.'
            defb &88,&00,&00,&00,&00,&44,&88,&88          ; 6361 '.....D..'
            defb &00,&44,&88,&00,&00,&88,&00,&CC          ; 6369 '.D......'
            defb &CC,&00,&CC,&00,&00,&88,&CC,&88          ; 6371 '........'
            defb &44,&CC,&CC,&00,&44,&44,&00,&00          ; 6379 'D...DD..'
            defb &00,&44,&88,&88,&44,&CC,&88,&00          ; 6381 '.D..D...'
            defb &00,&44,&44,&88,&CC,&88,&00,&00          ; 6389 '.DD.....'
            defb &00,&00,&44,&88,&88,&CC,&00,&00          ; 6391 '..D.....'
            defb &00,&00,&00,&44,&44,&44,&88,&00          ; 6399 '...DDD..'
            defb &00,&44,&88,&88,&44,&44,&00,&00          ; 63A1 '.D..DD..'
            defb &00,&44,&00,&88,&00,&CC,&44,&88          ; 63A9 '.D....D.'
            defb &00,&CC,&44,&00,&00,&88,&00,&CC          ; 63B1 '..D.....'
            defb &00,&44,&CC,&00,&00,&00,&88,&88          ; 63B9 '.D......'
            defb &44,&44,&88,&00,&00,&00,&88,&44          ; 63C1 'DD.....D'
            defb &CC,&88,&00,&00,&00,&00,&00,&44          ; 63C9 '.......D'
            defb &88,&00,&00,&00,&00,&00,&00,&00          ; 63D1 '........'
            defb &CC,&00,&00,&00,&00,&00,&00,&00          ; 63D9 '........'
            defb &CC,&44,&00,&00,&00,&00,&00,&00          ; 63E1 '.D......'
            defb &CC,&44,&00,&00,&CC,&00,&00,&00          ; 63E9 '.D......'
            defb &44,&00,&44,&CC,&88,&44,&88,&00          ; 63F1 'D.D..D..'
            defb &00,&44,&44,&CC,&00,&CC,&CC,&88          ; 63F9 '.DD.....'
            defb &00,&00,&88,&88,&00,&00,&00,&CC          ; 6401 '........'
            defb &44,&00,&00,&CC,&CC,&00,&00,&00          ; 6409 'D.......'
            defb &88,&CC,&00,&44,&CC,&00,&00,&00          ; 6411 '...D....'
            defb &00,&00,&CC,&00,&44,&44,&88,&00          ; 6419 '....DD..'
            defb &00,&00,&00,&00,&88,&00,&88,&CC          ; 6421 '........'
            defb &00,&00,&00,&CC,&44,&00,&00,&88          ; 6429 '....D...'
            defb &88,&00,&00,&00,&88,&44,&00,&00          ; 6431 '.....D..'
            defb &44,&88,&CC,&00,&44,&88,&88,&00          ; 6439 'D...D...'
            defb &00,&44,&00,&44,&88,&00,&CC,&88          ; 6441 '.D.D....'
            defb &00,&00,&00,&44,&44,&00,&88,&CC          ; 6449 '...DD...'
            defb &00,&00,&00,&00,&44,&00,&CC,&CC          ; 6451 '....D...'
            defb &00,&00,&00,&00,&00,&00,&00,&CC          ; 6459 '........'
            defb &00,&00,&00,&00,&00,&00,&11,&2A          ; 6461 '.......*'
            defb &11,&2A,&00,&00,&00,&00,&11,&2A          ; 6469 '.*.....*'
            defb &11,&2A,&00,&00,&00,&00,&11,&2A          ; 6471 '.*.....*'
            defb &11,&2A,&00,&00,&00,&00,&11,&2A          ; 6479 '.*.....*'
            defb &11,&2A,&00,&00,&00,&00,&45,&18          ; 6481 '.*....E.'
            defb &24,&8A,&00,&00,&00,&00,&8E,&18          ; 6489 '$.......'
            defb &24,&4D,&00,&00,&00,&00,&8E,&18          ; 6491 '$M......'
            defb &24,&4D,&00,&00,&00,&45,&0C,&30          ; 6499 '$M...E.0'
            defb &30,&0C,&8A,&00,&00,&45,&0C,&30          ; 64A1 '0....E.0'
            defb &30,&0C,&8A,&00,&00,&8E,&0C,&30          ; 64A9 '0......0'
            defb &30,&0C,&4D,&00,&00,&8E,&18,&30          ; 64B1 '0.M....0'
            defb &30,&24,&4D,&00,&45,&0C,&18,&30          ; 64B9 '0$M.E..0'
            defb &30,&24,&0C,&8A,&45,&CF,&9A,&30          ; 64C1 '0$..E..0'
            defb &30,&65,&CF,&8A,&00,&05,&00,&00          ; 64C9 '0e......'
            defb &00,&00,&0A,&00,&00,&0F,&0A,&00          ; 64D1 '........'
            defb &00,&05,&0F,&00,&05,&0F,&0F,&00          ; 64D9 '........'
            defb &00,&0F,&0F,&0A,&05,&2A,&05,&2A          ; 64E1 '.....*.*'
            defb &54,&2A,&54,&2A,&05,&2A,&05,&2A          ; 64E9 'T*T*.*.*'
            defb &54,&2A,&54,&2A,&05,&2A,&05,&2A          ; 64F1 'T*T*.*.*'
            defb &54,&2A,&54,&2A,&00,&00,&00,&00          ; 64F9 'T*T*....'
            defb &00,&00,&00,&00,&00,&00,&00,&00          ; 6501 '........'
            defb &00,&00,&00,&00,&45,&CF,&CF,&8A          ; 6509 '....E...'
            defb &45,&CF,&CF,&8A,&00,&CF,&CF,&00          ; 6511 'E.......'
            defb &00,&CF,&CF,&00,&00,&45,&8A,&00          ; 6519 '.....E..'
            defb &00,&45,&8A,&00,&00,&3F,&3F,&3F          ; 6521 '.E...???'
            defb &3F,&3F,&3F,&00,&15,&35,&35,&35          ; 6529 '???..555'
            defb &35,&35,&35,&2A,&10,&3A,&3A,&3A          ; 6531 '555*.:::'
            defb &3A,&3A,&3A,&20,&00,&3F,&3F,&3F          ; 6539 '::: .???'
            defb &3F,&3F,&3F,&00,&00,&1F,&3F,&FF          ; 6541 '???...?.'
            defb &FF,&3F,&2F,&00,&00,&05,&3F,&7F          ; 6549 '.?/...?.'
            defb &BF,&3F,&0A,&00,&00,&05,&3F,&3F          ; 6551 '.?....??'
            defb &3F,&3F,&0A,&00,&00,&05,&3F,&FF          ; 6559 '??....?.'
            defb &FF,&3F,&0A,&00,&00,&00,&1F,&7F          ; 6561 '.?......'
            defb &BF,&2F,&00,&00,&00,&00,&05,&3F          ; 6569 './.....?'
            defb &3F,&0A,&00,&00,&00,&00,&00,&1F          ; 6571 '?.......'
            defb &2F,&00,&00,&00,&00,&00,&00,&05          ; 6579 '/.......'
            defb &0A,&00,&00,&00,&00,&00,&00,&00          ; 6581 '........'
            defb &00,&00,&00,&00,&00,&00,&45,&44          ; 6589 '......ED'
            defb &3F,&88,&8A,&45,&8A,&3F,&45,&8A          ; 6591 '?..E.?E.'
            defb &00,&CF,&C3,&CF,&00,&00,&CF,&C3          ; 6599 '........'
            defb &CF,&00,&00,&45,&C3,&8A,&00,&00          ; 65A1 '...E....'
            defb &45,&C3,&8A,&00,&00,&00,&C3,&00          ; 65A9 'E.......'
            defb &00,&00,&00,&C3,&00,&00,&0C,&00          ; 65B1 '........'
            defb &00,&0F,&0F,&00,&00,&0C,&0C,&00          ; 65B9 '........'
            defb &05,&0F,&0F,&0A,&00,&0C,&04,&08          ; 65C1 '........'
            defb &0F,&0F,&0F,&0F,&04,&08,&04,&0D          ; 65C9 '........'
            defb &CF,&CF,&CF,&CF,&0E,&08,&00,&4F          ; 65D1 '.......O'
            defb &00,&45,&8A,&00,&8F,&00,&05,&4F          ; 65D9 '.E.....O'
            defb &11,&67,&8A,&33,&8F,&0A,&0F,&4F          ; 65E1 '.g.3...O'
            defb &11,&45,&8A,&22,&8F,&0F,&0F,&4F          ; 65E9 '.E."...O'
            defb &CF,&CF,&CF,&CF,&8F,&0F,&05,&0F          ; 65F1 '........'
            defb &0F,&0F,&0F,&0F,&0F,&0A,&05,&1A          ; 65F9 '........'
            defb &30,&30,&30,&30,&25,&0A,&00,&0F          ; 6601 '0000%...'
            defb &1A,&30,&30,&25,&0F,&00,&00,&05          ; 6609 '.00%....'
            defb &0F,&0F,&0F,&0F,&0A,&00,&00,&15          ; 6611 '........'
            defb &3F,&00,&00,&3F,&2A,&00,&00,&15          ; 6619 '?..?*...'
            defb &3F,&00,&00,&3F,&3F,&3F,&00,&15          ; 6621 '?..???..'
            defb &3F,&00,&00,&00,&00,&00,&3F,&3F          ; 6629 '?.....??'
            defb &3F,&00,&00,&00,&00,&00,&04,&08          ; 6631 '?.......'
            defb &00,&05,&0F,&0A,&00,&04,&08,&04          ; 6639 '........'
            defb &08,&00,&0F,&0F,&0F,&00,&04,&08          ; 6641 '........'
            defb &00,&0C,&05,&0F,&0F,&0F,&0A,&0C          ; 6649 '........'
            defb &00,&00,&0C,&4F,&CF,&CF,&CF,&8F          ; 6651 '...O....'
            defb &0C,&00,&00,&05,&8A,&00,&CF,&00          ; 6659 '........'
            defb &45,&0A,&00,&00,&0F,&8A,&33,&CF          ; 6661 'E.....3.'
            defb &11,&67,&0F,&00,&05,&0F,&8A,&22          ; 6669 '.g....."'
            defb &CF,&11,&45,&0F,&0A,&05,&0F,&CF          ; 6671 '..E.....'
            defb &CF,&CF,&CF,&CF,&0F,&0A,&00,&0F          ; 6679 '........'
            defb &0F,&0F,&0F,&0F,&0F,&0F,&00,&00          ; 6681 '........'
            defb &0F,&30,&30,&30,&30,&30,&0F,&00          ; 6689 '.00000..'
            defb &00,&05,&0F,&30,&30,&30,&0F,&0A          ; 6691 '...000..'
            defb &00,&00,&00,&0F,&0F,&0F,&0F,&0F          ; 6699 '........'
            defb &00,&00,&00,&00,&3F,&2A,&00,&15          ; 66A1 '....?*..'
            defb &3F,&00,&00,&00,&00,&3F,&2A,&00          ; 66A9 '?....?*.'
            defb &15,&3F,&3F,&2A,&00,&00,&3F,&2A          ; 66B1 '.??*..?*'
            defb &00,&00,&00,&00,&00,&15,&3F,&3F          ; 66B9 '......??'
            defb &2A,&00,&00,&00,&00,&00,&0C,&00          ; 66C1 '*.......'
            defb &00,&0F,&0F,&00,&00,&0C,&0C,&00          ; 66C9 '........'
            defb &05,&0F,&0F,&0A,&00,&0C,&04,&08          ; 66D1 '........'
            defb &0F,&0F,&0F,&0F,&04,&08,&04,&0D          ; 66D9 '........'
            defb &CF,&CF,&CF,&CF,&0E,&08,&00,&4F          ; 66E1 '.......O'
            defb &00,&45,&8A,&00,&8F,&00,&05,&4F          ; 66E9 '.E.....O'
            defb &33,&45,&9B,&22,&8F,&0A,&0F,&4F          ; 66F1 '3E."...O'
            defb &11,&45,&8A,&22,&8F,&0F,&0F,&4F          ; 66F9 '.E."...O'
            defb &CF,&CF,&CF,&CF,&8F,&0F,&05,&0F          ; 6701 '........'
            defb &0F,&0F,&0F,&0F,&0F,&0A,&05,&1A          ; 6709 '........'
            defb &30,&30,&30,&30,&25,&0A,&00,&0F          ; 6711 '0000%...'
            defb &1A,&30,&30,&25,&0F,&00,&00,&05          ; 6719 '.00%....'
            defb &0F,&0F,&0F,&0F,&0A,&00,&00,&15          ; 6721 '........'
            defb &3F,&00,&00,&3F,&2A,&00,&00,&15          ; 6729 '?..?*...'
            defb &3F,&00,&00,&3F,&2A,&00,&3F,&3F          ; 6731 '?..?*.??'
            defb &3F,&00,&00,&3F,&2A,&00,&00,&00          ; 6739 '?..?*...'
            defb &00,&00,&00,&3F,&3F,&3F,&04,&08          ; 6741 '...???..'
            defb &00,&05,&0F,&0A,&00,&04,&08,&04          ; 6749 '........'
            defb &08,&00,&0F,&0F,&0F,&00,&04,&08          ; 6751 '........'
            defb &00,&0C,&05,&0F,&0F,&0F,&0A,&0C          ; 6759 '........'
            defb &00,&00,&0C,&4F,&CF,&CF,&CF,&8F          ; 6761 '...O....'
            defb &0C,&00,&00,&05,&8A,&00,&CF,&00          ; 6769 '........'
            defb &45,&0A,&00,&00,&0F,&9B,&22,&CF          ; 6771 'E.....".'
            defb &33,&45,&0F,&00,&05,&0F,&8A,&22          ; 6779 '3E....."'
            defb &CF,&11,&45,&0F,&0A,&05,&0F,&CF          ; 6781 '..E.....'
            defb &CF,&CF,&CF,&CF,&0F,&0A,&00,&0F          ; 6789 '........'
            defb &0F,&0F,&0F,&0F,&0F,&0F,&00,&00          ; 6791 '........'
            defb &0F,&30,&30,&30,&30,&30,&0F,&00          ; 6799 '.00000..'
            defb &00,&05,&0F,&30,&30,&30,&0F,&0A          ; 67A1 '...000..'
            defb &00,&00,&00,&0F,&0F,&0F,&0F,&0F          ; 67A9 '........'
            defb &00,&00,&00,&00,&3F,&2A,&00,&15          ; 67B1 '....?*..'
            defb &3F,&00,&00,&00,&00,&3F,&2A,&00          ; 67B9 '?....?*.'
            defb &15,&3F,&00,&00,&15,&3F,&3F,&2A          ; 67C1 '.?...??*'
            defb &00,&15,&3F,&00,&00,&00,&00,&00          ; 67C9 '..?.....'
            defb &00,&00,&15,&3F,&3F,&2A,&30,&30          ; 67D1 '...??*00'
            defb &30,&30,&3F,&3F,&3F,&3F,&30,&30          ; 67D9 '00????00'
            defb &30,&30,&3F,&3F,&3F,&3F,&30,&30          ; 67E1 '00????00'
            defb &30,&30,&3F,&3F,&3F,&3F,&30,&30          ; 67E9 '00????00'
            defb &30,&30,&3F,&3F,&3F,&3F,&30,&30          ; 67F1 '00????00'
            defb &30,&30,&30,&3F,&3F,&3F,&3F,&3F          ; 67F9 '000?????'
            defb &30,&30,&30,&30,&30,&3F,&3F,&3F          ; 6801 '00000???'
            defb &3F,&3F,&30,&30,&30,&30,&30,&3F          ; 6809 '??00000?'
            defb &3F,&3F,&3F,&3F,&30,&30,&30,&30          ; 6811 '????0000'
            defb &30,&3F,&3F,&3F,&3F,&3F,&00,&00          ; 6819 '0?????..'
            defb &00,&00,&00,&00,&00,&00,&00,&00          ; 6821 '........'
            defb &00,&00,&00,&00,&00,&00,&00,&00          ; 6829 '........'
            defb &00,&00,&00,&00,&00,&00,&00,&00          ; 6831 '........'
            defb &00,&00,&00,&00,&00,&00,&30,&00          ; 6839 '......0.'
            defb &00,&00,&00,&3F,&00,&00,&00,&00          ; 6841 '...?....'
            defb &30,&00,&00,&00,&00,&3F,&00,&00          ; 6849 '0....?..'
            defb &00,&00,&30,&00,&00,&00,&00,&3F          ; 6851 '..0....?'
            defb &00,&00,&00,&00,&30,&00,&00,&00          ; 6859 '....0...'
            defb &00,&3F,&00,&00,&00,&00                  ; 6861 '.?....'
sub_6867:
            di                          ; 6867
            push af                     ; 6868
            push ix                     ; 6869
            push iy                     ; 686B
            push hl                     ; 686D
            push bc                     ; 686E
            push de                     ; 686F
            ld hl,(&4006)               ; 6870
            ld b,c                      ; 6873
            srl b                       ; 6874
            srl l                       ; 6876
            jr nc,L_6880                ; 6878
            ld de,&42E9                 ; 687A
            inc b                       ; 687D
            jr L_6883                   ; 687E
L_6880:
            ld de,&4335                 ; 6880
L_6883:
            push hl                     ; 6883
            add a,a                     ; 6884
            ld l,a                      ; 6885
            ld h,&00                    ; 6886
            add hl,de                   ; 6888
            ld a,(hl)                   ; 6889
            inc hl                      ; 688A
            ld h,(hl)                   ; 688B
            ld l,a                      ; 688C
            push hl                     ; 688D
            pop iy                      ; 688E
            pop hl                      ; 6890
            ld a,l                      ; 6891
            ld (&689E),a                ; 6892
            ld l,h                      ; 6895
            ld h,&00                    ; 6896
            add hl,hl                   ; 6898
            ld de,&4159                 ; 6899
            add hl,de                   ; 689C
L_689D:
            ld a,&00                    ; 689D
            add a,(hl)                  ; 689F
            inc hl                      ; 68A0
            ld e,a                      ; 68A1
            ld a,(hl)                   ; 68A2
            adc a,&00                   ; 68A3
            ld d,a                      ; 68A5
            inc hl                      ; 68A6
            push bc                     ; 68A7
L_68A8:
            ld a,(iy+0)                 ; 68A8
            inc iy                      ; 68AB
            ld (de),a                   ; 68AD
            inc de                      ; 68AE
            djnz L_68A8                 ; 68AF
            pop bc                      ; 68B1
            dec c                       ; 68B2
            jr nz,L_689D                ; 68B3
            pop de                      ; 68B5
            pop bc                      ; 68B6
            pop hl                      ; 68B7
            pop iy                      ; 68B8
            pop ix                      ; 68BA
            pop af                      ; 68BC
            ei                          ; 68BD
            ret                         ; 68BE

; -------- &68BF+  data / tables --------
            defb &FF,&FF,&01,&FF,&FF,&01,&FF,&FF          ; 68BF '........'
            defb &01,&FF,&FF,&01,&FF,&FF,&01,&FF          ; 68C7 '........'
            defb &FF,&01,&FF,&FF,&01,&FF,&FF,&01          ; 68CF '........'
            defb &FF,&FF,&01,&FF,&FF,&01,&FF,&FF          ; 68D7 '........'
            defb &01,&FF,&FF,&01,&FF,&FF,&01,&FF          ; 68DF '........'
            defb &FF,&01,&FF,&FF,&01,&FF,&FF,&01          ; 68E7 '........'
            defb &FF,&FF,&01,&FF,&FF,&01,&FF,&FF          ; 68EF '........'
            defb &01,&FF,&FF,&01,&FF,&FF,&01,&FF          ; 68F7 '........'
            defb &FF,&01,&FF,&FF,&01,&FF,&FF,&01          ; 68FF '........'
            defb &FE,&00                                  ; 6907 '..'
            ld a,(&6908)                ; 6909
            inc a                       ; 690C
            ld (&6908),a                ; 690D
            cp &05                      ; 6910
            jr nz,sub_6919              ; 6912
            xor a                       ; 6914
            ld (&6908),a                ; 6915
            ret                         ; 6918
sub_6919:
            ld ix,&68BF                 ; 6919
L_691D:
            ld a,(ix+0)                 ; 691D
            cp &FE                      ; 6920
            ret z                       ; 6922
            cp &FF                      ; 6923
            jr nz,L_692F                ; 6925
L_6927:
            inc ix                      ; 6927
            inc ix                      ; 6929
            inc ix                      ; 692B
            jr L_691D                   ; 692D
L_692F:
            ld l,a                      ; 692F
            ld h,(ix+1)                 ; 6930
            ld (&4006),hl               ; 6933
            ld a,(ix+2)                 ; 6936
            cp &08                      ; 6939
            jr nz,L_6942                ; 693B
            xor a                       ; 693D
            ld (ix+0),&FF               ; 693E
L_6942:
            ld c,&10                    ; 6942
            call sub_6867               ; 6944
            inc a                       ; 6947
            ld (ix+2),a                 ; 6948
            jr L_6927                   ; 694B
            defb &01,&00,&FF,&00,&01,&00,&FF,&00          ; 694D '........'
            defb &01,&00,&FF,&00,&01,&00,&FF,&00          ; 6955 '........'
            defb &01,&00,&FF,&00,&01,&00,&FF,&00          ; 695D '........'
            defb &01,&00,&FF,&00,&01,&00,&FF,&00          ; 6965 '........'
            defb &01,&01,&FF,&FF,&01,&00,&FF,&00          ; 696D '........'
            defb &01,&00,&FF,&00,&01,&01,&FF,&FF          ; 6975 '........'
            defb &01,&00,&FF,&00,&01,&01,&FF,&FF          ; 697D '........'
            defb &01,&01,&FF,&FF,&01,&01,&FF,&FF          ; 6985 '........'
            defb &00,&01,&00,&FF,&01,&01,&FF,&FF          ; 698D '........'
            defb &00,&01,&00,&FF,&00,&01,&00,&FF          ; 6995 '........'
            defb &00,&01,&00,&FF,&FF,&01,&01,&FF          ; 699D '........'
            defb &FF,&01,&01,&FF,&FF,&01,&01,&FF          ; 69A5 '........'
            defb &FF,&01,&01,&FF,&FF,&00,&01,&00          ; 69AD '........'
            defb &FF,&01,&01,&FF,&FF,&00,&01,&00          ; 69B5 '........'
            defb &FF,&00,&01,&00,&FF,&00,&01,&00          ; 69BD '........'
            defb &FF,&00,&01,&00,&FF,&FF,&01,&01          ; 69C5 '........'
            defb &FF,&FF,&01,&01,&FF,&FF,&01,&01          ; 69CD '........'
            defb &00,&FF,&00,&01,&00,&FF,&00,&01          ; 69D5 '........'
            defb &00,&FF,&00,&01,&00,&FF,&00,&01          ; 69DD '........'
            defb &00,&FF,&00,&01,&01,&FF,&FF,&01          ; 69E5 '........'
            defb &01,&FF,&FF,&01,&01,&FF,&FF,&01          ; 69ED '........'
            defb &01,&FF,&FF,&01,&01,&FF,&FF,&01          ; 69F5 '........'
            defb &01,&00,&FF,&00,&01,&FF,&FF,&01          ; 69FD '........'
            defb &01,&00,&FF,&00,&01,&00,&FF,&00          ; 6A05 '........'
            defb &01,&00,&FF,&00,&01,&00,&FF,&00          ; 6A0D '........'
            defb &01,&00,&FF,&00,&01,&FF,&FF,&01          ; 6A15 '........'
            defb &01,&00,&FF,&00,&01,&00,&FF,&00          ; 6A1D '........'
            defb &01,&00,&FF,&00,&01,&00,&FF,&00          ; 6A25 '........'
            defb &01,&00,&FF,&00,&01,&00,&FF,&00          ; 6A2D '........'
            defb &01,&00,&FF,&00,&01,&00,&FF,&00          ; 6A35 '........'
            defb &01,&00,&FF,&00,&01,&00,&FF,&00          ; 6A3D '........'
            defb &01,&00,&FF,&00,&01,&00,&FF,&00          ; 6A45 '........'
            defb &00,&00,&00,&6F,&64,&08,&00,&09          ; 6A4D '...od...'
            defb &64,&08,&00,&A3,&64,&08,&00,&49          ; 6A55 'd...d..I'
            defb &64,&08,&00,&57,&64,&08,&00,&71          ; 6A5D 'd..Wd..q'
            defb &64,&08,&00,&0B,&64,&08,&00,&A5          ; 6A65 'd...d...'
            defb &64,&08,&00,&45,&64,&08,&00,&59          ; 6A6D 'd..Ed..Y'
            defb &64,&08,&00,&FE,&04,&22                  ; 6A75 'd...."'
            ld a,(&6A79)                ; 6A7B
            dec a                       ; 6A7E
            ld (&6A79),a                ; 6A7F
            ret nz                      ; 6A82
            ld a,&0A                    ; 6A83
            ld (&6A79),a                ; 6A85
            ld l,&48                    ; 6A88
            ld h,&1A                    ; 6A8A
            ld a,(&6A7A)                ; 6A8C
            inc a                       ; 6A8F
            cp &24                      ; 6A90
            jr nz,L_6A96                ; 6A92
            ld a,&22                    ; 6A94
L_6A96:
            ld (&6A7A),a                ; 6A96
            ld c,&10                    ; 6A99
            ld (&4006),hl               ; 6A9B
            call sub_6867               ; 6A9E
            ret                         ; 6AA1
            ld h,&48                    ; 6AA2
            ld l,&30                    ; 6AA4
            ld b,&08                    ; 6AA6
            ld c,&08                    ; 6AA8
            ld de,&0008                 ; 6AAA
            ld a,&24                    ; 6AAD
L_6AAF:
            ld (&4006),hl               ; 6AAF
            call sub_6867               ; 6AB2
            add hl,de                   ; 6AB5
            djnz L_6AAF                 ; 6AB6
            ret                         ; 6AB8
            defb &50                                      ; 6AB9 'P'
            ld c,&08                    ; 6ABA
            ld h,&48                    ; 6ABC
            ld a,(&6AB9)                ; 6ABE
            inc a                       ; 6AC1
            cp &60                      ; 6AC2
            jr nz,L_6AD3                ; 6AC4
            add a,&08                   ; 6AC6
            ld l,a                      ; 6AC8
            ld a,&24                    ; 6AC9
            ld (&4006),hl               ; 6ACB
            call sub_6867               ; 6ACE
            ld a,&30                    ; 6AD1
L_6AD3:
            ld (&6AB9),a                ; 6AD3
            ld l,a                      ; 6AD6
            ld a,&24                    ; 6AD7
            ld (&4006),hl               ; 6AD9
            call sub_6867               ; 6ADC
            ld a,l                      ; 6ADF
            add a,&08                   ; 6AE0
            ld l,a                      ; 6AE2
            ld a,&25                    ; 6AE3
            ld (&4006),hl               ; 6AE5
            call sub_6867               ; 6AE8
            ret                         ; 6AEB
            defb &50,&B8                                  ; 6AEC 'P.'
            ld hl,(&6AEC)               ; 6AEE
            ld a,l                      ; 6AF1
            add a,&08                   ; 6AF2
            ld l,a                      ; 6AF4
            ld a,h                      ; 6AF5
            add a,&09                   ; 6AF6
            ld h,a                      ; 6AF8
            ex de,hl                    ; 6AF9
            ld l,d                      ; 6AFA
            ld h,&00                    ; 6AFB
            add hl,hl                   ; 6AFD
            ld bc,&4159                 ; 6AFE
            add hl,bc                   ; 6B01
            ld a,(hl)                   ; 6B02
            inc hl                      ; 6B03
            ld h,(hl)                   ; 6B04
            ld l,a                      ; 6B05
            ld d,&00                    ; 6B06
            srl e                       ; 6B08
            add hl,de                   ; 6B0A
            ld a,(hl)                   ; 6B0B
            cp &30                      ; 6B0C
            jr z,L_6B14                 ; 6B0E
            or a                        ; 6B10
            jp nz,L_6B6A                ; 6B11
L_6B14:
            ld a,&47                    ; 6B14
            call &BB1E                  ; KM TEST KEY
            ld hl,(&6AEC)               ; 6B19
            jr z,L_6B25                 ; 6B1C
            ld a,l                      ; 6B1E
            dec a                       ; 6B1F
            cp &FF                      ; 6B20
            jr z,L_6B25                 ; 6B22
            ld l,a                      ; 6B24
L_6B25:
            push hl                     ; 6B25
            ld a,&3F                    ; 6B26
            call &BB1E                  ; KM TEST KEY
            pop hl                      ; 6B2B
            jr z,L_6B35                 ; 6B2C
            ld a,l                      ; 6B2E
            inc a                       ; 6B2F
            cp &91                      ; 6B30
            jr z,L_6B35                 ; 6B32
            ld l,a                      ; 6B34
L_6B35:
            ld (&6AEC),hl               ; 6B35
            call &BB24                  ; KM GET JOYSTICK
            bit 2,h                     ; 6B3B
            ld hl,(&6AEC)               ; 6B3D
            jr z,L_6B49                 ; 6B40
            ld a,l                      ; 6B42
            dec a                       ; 6B43
            cp &FF                      ; 6B44
            jr z,L_6B49                 ; 6B46
            ld l,a                      ; 6B48
L_6B49:
            push hl                     ; 6B49
            call &BB24                  ; KM GET JOYSTICK
            bit 3,h                     ; 6B4D
            pop hl                      ; 6B4F
            jr z,L_6B59                 ; 6B50
            ld a,l                      ; 6B52
            inc a                       ; 6B53
            cp &91                      ; 6B54
            jr z,L_6B59                 ; 6B56
            ld l,a                      ; 6B58
L_6B59:
            ld (&6AEC),hl               ; 6B59
            ld hl,(&6AEC)               ; 6B5C
            ld (&4006),hl               ; 6B5F
            ld a,&0B                    ; 6B62
            ld c,&10                    ; 6B64
            call sub_6867               ; 6B66
            ret                         ; 6B69
L_6B6A:
            ld hl,&40B7                 ; 6B6A
            call &BCAA                  ; SOUND QUEUE
            ld a,&FF                    ; 6B70
            ld (&6CA9),a                ; 6B72
            ld a,(&726F)                ; 6B75
            dec a                       ; 6B78
            ld (&726F),a                ; 6B79
            or a                        ; 6B7C
            jp z,L_75A4                 ; 6B7D
            call sub_7270               ; 6B80
            ld de,(&6AEC)               ; 6B83
            ld l,&48                    ; 6B87
            ld h,&B8                    ; 6B89
            ld (&6AEC),hl               ; 6B8B
            ld hl,&6BDA                 ; 6B8E
            call sub_4150               ; 6B91
            ld hl,&68BF                 ; 6B94
            call sub_4150               ; 6B97
            ex de,hl                    ; 6B9A
            call sub_6BBD               ; 6B9B
            ld b,&08                    ; 6B9E
L_6BA0:
            push bc                     ; 6BA0
            call sub_6919               ; 6BA1
            ld de,&8000                 ; 6BA4
L_6BA7:
            dec de                      ; 6BA7
            ld a,d                      ; 6BA8
            or e                        ; 6BA9
            jr nz,L_6BA7                ; 6BAA
            pop bc                      ; 6BAC
            djnz L_6BA0                 ; 6BAD
            call sub_729D               ; 6BAF
            ld a,(&72C5)                ; 6BB2
            dec a                       ; 6BB5
            add a,a                     ; 6BB6
            ld e,a                      ; 6BB7
            ld d,&00                    ; 6BB8
            jp L_78AD                   ; 6BBA
sub_6BBD:
            push hl                     ; 6BBD
            push de                     ; 6BBE
            ex de,hl                    ; 6BBF
            ld hl,&68BF                 ; 6BC0
L_6BC3:
            ld a,(hl)                   ; 6BC3
            cp &FE                      ; 6BC4
            jr z,L_6BD7                 ; 6BC6
            cp &FF                      ; 6BC8
            jr z,L_6BD1                 ; 6BCA
            inc hl                      ; 6BCC
            inc hl                      ; 6BCD
            inc hl                      ; 6BCE
            jr L_6BC3                   ; 6BCF
L_6BD1:
            ld (hl),e                   ; 6BD1
            inc hl                      ; 6BD2
            ld (hl),d                   ; 6BD3
            inc hl                      ; 6BD4
            ld (hl),&01                 ; 6BD5
L_6BD7:
            pop de                      ; 6BD7
            pop hl                      ; 6BD8
            ret                         ; 6BD9
            defb &08,&00,&08,&00,&08,&00,&08,&00          ; 6BDA '........'
            defb &08,&00,&08,&00,&08,&00,&08,&00          ; 6BE2 '........'
            defb &08,&00,&08,&00,&FE,&02,&02,&02          ; 6BEA '........'
            defb &02,&02,&02,&02,&02,&02,&02,&02          ; 6BF2 '........'
            defb &00,&00                                  ; 6BFA '..'
sub_6BFC:
            push hl                     ; 6BFC
            push bc                     ; 6BFD
            push de                     ; 6BFE
            call sub_72BA               ; 6BFF
            cp &04                      ; 6C02
            jr c,L_6C0A                 ; 6C04
L_6C06:
            pop de                      ; 6C06
            pop bc                      ; 6C07
            pop hl                      ; 6C08
            ret                         ; 6C09
L_6C0A:
            ex de,hl                    ; 6C0A
            ld hl,&6BDA                 ; 6C0B
L_6C0E:
            ld a,(hl)                   ; 6C0E
            cp &FE                      ; 6C0F
            jr z,L_6C06                 ; 6C11
            cp &FF                      ; 6C13
            jr z,L_6C1B                 ; 6C15
            inc hl                      ; 6C17
            inc hl                      ; 6C18
            jr L_6C0E                   ; 6C19
L_6C1B:
            ld a,e                      ; 6C1B
            add a,&04                   ; 6C1C
            ld (hl),a                   ; 6C1E
            inc hl                      ; 6C1F
            ld a,d                      ; 6C20
            add a,&0F                   ; 6C21
            ld (hl),a                   ; 6C23
            push ix                     ; 6C24
            ld hl,&40AE                 ; 6C26
            call &BCAA                  ; SOUND QUEUE
            pop ix                      ; 6C2C
            jr L_6C06                   ; 6C2E
            ld hl,&6BEF                 ; 6C30
            ld (&6BFA),hl               ; 6C33
            ld ix,&6BDA                 ; 6C36
L_6C3A:
            ld a,(ix+0)                 ; 6C3A
            cp &FE                      ; 6C3D
            ret z                       ; 6C3F
            cp &FF                      ; 6C40
            jr nz,L_6C51                ; 6C42
L_6C44:
            inc ix                      ; 6C44
            inc ix                      ; 6C46
            ld hl,(&6BFA)               ; 6C48
            inc hl                      ; 6C4B
            ld (&6BFA),hl               ; 6C4C
            jr L_6C3A                   ; 6C4F
L_6C51:
            ld l,a                      ; 6C51
            ld h,(ix+1)                 ; 6C52
            ld a,h                      ; 6C55
            add a,&02                   ; 6C56
            ld h,a                      ; 6C58
            cp &BE                      ; 6C59
            jr c,L_6C6C                 ; 6C5B
            ld (ix+0),&FF               ; 6C5D
            ld h,&B8                    ; 6C61
            dec l                       ; 6C63
            dec l                       ; 6C64
            dec l                       ; 6C65
            dec l                       ; 6C66
            call sub_6BBD               ; 6C67
            jr L_6C44                   ; 6C6A
L_6C6C:
            ld bc,(&6BFA)               ; 6C6C
            ld a,(bc)                   ; 6C70
            ld e,a                      ; 6C71
            ld a,(&72C5)                ; 6C72
            cp &06                      ; 6C75
            jr c,L_6C95                 ; 6C77
            cp &09                      ; 6C79
            jr z,L_6C95                 ; 6C7B
            ld a,e                      ; 6C7D
            dec e                       ; 6C7E
            dec a                       ; 6C7F
            or a                        ; 6C80
            jr nz,L_6C95                ; 6C81
            ld a,(&6AEC)                ; 6C83
            add a,&03                   ; 6C86
            cp l                        ; 6C88
            jr z,L_6C93                 ; 6C89
            jr nc,L_6C92                ; 6C8B
            ld e,&03                    ; 6C8D
            dec l                       ; 6C8F
            jr L_6C95                   ; 6C90
L_6C92:
            inc l                       ; 6C92
L_6C93:
            ld e,&03                    ; 6C93
L_6C95:
            ld a,e                      ; 6C95
            ld (bc),a                   ; 6C96
            ld (&4006),hl               ; 6C97
            ld (ix+0),l                 ; 6C9A
            ld (ix+1),h                 ; 6C9D
            ld a,&0C                    ; 6CA0
            ld c,&0A                    ; 6CA2
            call sub_6867               ; 6CA4
            jr L_6C44                   ; 6CA7
            defb &FF,&00                                  ; 6CA9 '..'
            ld hl,(&6CA9)               ; 6CAB
            ld a,l                      ; 6CAE
            cp &FF                      ; 6CAF
            jr nz,L_6CD5                ; 6CB1
            ld a,&15                    ; 6CB3
            call &BB1E                  ; KM TEST KEY
            jr nz,L_6CC0                ; 6CB8
            call &BB24                  ; KM GET JOYSTICK
            bit 4,h                     ; 6CBD
            ret z                       ; 6CBF
L_6CC0:
            ld hl,&409C                 ; 6CC0
            call &BCAA                  ; SOUND QUEUE
            ld hl,(&6AEC)               ; 6CC6
            inc l                       ; 6CC9
            inc l                       ; 6CCA
            inc l                       ; 6CCB
            inc l                       ; 6CCC
            ld a,h                      ; 6CCD
            sub &09                     ; 6CCE
            ld h,a                      ; 6CD0
            ld (&6CA9),hl               ; 6CD1
            ret                         ; 6CD4
L_6CD5:
            dec h                       ; 6CD5
            dec h                       ; 6CD6
            ld a,h                      ; 6CD7
            cp &18                      ; 6CD8
            jr nc,L_6CEC                ; 6CDA
L_6CDC:
            inc h                       ; 6CDC
L_6CDD:
            xor a                       ; 6CDD
            ld c,&08                    ; 6CDE
            ld (&4006),hl               ; 6CE0
            call sub_6867               ; 6CE3
            ld a,&FF                    ; 6CE6
            ld (&6CA9),a                ; 6CE8
            ret                         ; 6CEB
L_6CEC:
            push hl                     ; 6CEC
            ld a,l                      ; 6CED
            add a,&03                   ; 6CEE
            ld l,a                      ; 6CF0
            ex de,hl                    ; 6CF1
            ld l,d                      ; 6CF2
            ld h,&00                    ; 6CF3
            add hl,hl                   ; 6CF5
            ld bc,&4159                 ; 6CF6
            add hl,bc                   ; 6CF9
            ld a,(hl)                   ; 6CFA
            inc hl                      ; 6CFB
            ld h,(hl)                   ; 6CFC
            ld l,a                      ; 6CFD
            ld d,&00                    ; 6CFE
            srl e                       ; 6D00
            add hl,de                   ; 6D02
            ld a,(hl)                   ; 6D03
            pop hl                      ; 6D04
            cp &33                      ; 6D05
            jr z,L_6CDD                 ; 6D07
            or a                        ; 6D09
            jr z,L_6D64                 ; 6D0A
            ld a,(&72C5)                ; 6D0C
            cp &09                      ; 6D0F
            call z,sub_6DDF             ; 6D11
            ld ix,&6A50                 ; 6D14
L_6D18:
            ld a,(ix+0)                 ; 6D18
            cp &FE                      ; 6D1B
            jr z,L_6CDC                 ; 6D1D
            cp &FF                      ; 6D1F
            jr nz,L_6D2D                ; 6D21
L_6D23:
            inc ix                      ; 6D23
            inc ix                      ; 6D25
            inc ix                      ; 6D27
            inc ix                      ; 6D29
            jr L_6D18                   ; 6D2B
L_6D2D:
            sub l                       ; 6D2D
            sub &04                     ; 6D2E
            cp &F0                      ; 6D30
            jr c,L_6D23                 ; 6D32
            ld a,(ix+1)                 ; 6D34
            sub h                       ; 6D37
            cp &F0                      ; 6D38
            jr c,L_6D23                 ; 6D3A
            push hl                     ; 6D3C
            ld l,(ix+0)                 ; 6D3D
            ld h,(ix+1)                 ; 6D40
            ld (ix+0),&FF               ; 6D43
            call sub_6BBD               ; 6D47
            push bc                     ; 6D4A
            push de                     ; 6D4B
            ld a,(&72C5)                ; 6D4C
            cp &09                      ; 6D4F
            jr nz,L_6D58                ; 6D51
            call sub_7ADF               ; 6D53
            jr L_6D5E                   ; 6D56
L_6D58:
            call sub_72DC               ; 6D58
            call sub_793D               ; 6D5B
L_6D5E:
            pop bc                      ; 6D5E
            pop de                      ; 6D5F
            pop hl                      ; 6D60
            jp L_6CDC                   ; 6D61
L_6D64:
            ld (&6CA9),hl               ; 6D64
            ld (&4006),hl               ; 6D67
            ld a,&0D                    ; 6D6A
            ld c,&08                    ; 6D6C
            call sub_6867               ; 6D6E
            ret                         ; 6D71
            defb &20,&10,&20,&10,&1F,&12,&1F,&12          ; 6D72 ' . .....'
            defb &1E,&14,&1E,&14,&1D,&16,&1D,&16          ; 6D7A '........'
            defb &1C,&18,&1C,&18,&1B,&1A,&1B,&1A          ; 6D82 '........'
            defb &1A,&1C,&1A,&1C,&19,&1E,&19,&1E          ; 6D8A '........'
            defb &19,&1E,&19,&1E,&1A,&1C,&1A,&1C          ; 6D92 '........'
            defb &1B,&1A,&1B,&1A,&1C,&18,&1C,&18          ; 6D9A '........'
            defb &1D,&16,&1D,&16,&1E,&14,&1E,&14          ; 6DA2 '........'
            defb &1F,&12,&1F,&12,&20,&10,&20,&10          ; 6DAA '.... . .'
            defb &FF                                      ; 6DB2 '.'
            ld de,&6D72                 ; 6DB3
            ld h,&19                    ; 6DB6
L_6DB8:
            ld a,(de)                   ; 6DB8
            cp &FF                      ; 6DB9
            ret z                       ; 6DBB
            ld l,a                      ; 6DBC
            inc de                      ; 6DBD
            inc h                       ; 6DBE
            ld a,(de)                   ; 6DBF
            ld b,a                      ; 6DC0
            inc de                      ; 6DC1
            push hl                     ; 6DC2
            push de                     ; 6DC3
            push bc                     ; 6DC4
            ex de,hl                    ; 6DC5
            ld l,d                      ; 6DC6
            ld h,&00                    ; 6DC7
            add hl,hl                   ; 6DC9
            ld bc,&4159                 ; 6DCA
            add hl,bc                   ; 6DCD
            ld a,(hl)                   ; 6DCE
            inc hl                      ; 6DCF
            ld h,(hl)                   ; 6DD0
            ld l,a                      ; 6DD1
            ld d,&00                    ; 6DD2
            add hl,de                   ; 6DD4
            pop bc                      ; 6DD5
            pop de                      ; 6DD6
L_6DD7:
            ld (hl),&33                 ; 6DD7
            inc hl                      ; 6DD9
            djnz L_6DD7                 ; 6DDA
            pop hl                      ; 6DDC
            jr L_6DB8                   ; 6DDD
sub_6DDF:
            ld a,&48                    ; 6DDF
            sub l                       ; 6DE1
            sub &04                     ; 6DE2
            cp &F0                      ; 6DE4
            ret c                       ; 6DE6
            ld a,&1A                    ; 6DE7
            sub h                       ; 6DE9
            cp &F0                      ; 6DEA
            ret c                       ; 6DEC
            ld hl,&40C9                 ; 6DED
            call &BCAA                  ; SOUND QUEUE
            ld bc,&0000                 ; 6DF3
L_6DF6:
            dec bc                      ; 6DF6
            ld a,c                      ; 6DF7
            or b                        ; 6DF8
            jr nz,L_6DF6                ; 6DF9
            jp L_781A                   ; 6DFB
            ld ix,&6A50                 ; 6DFE
L_6E02:
            ld a,(ix+0)                 ; 6E02
            cp &FE                      ; 6E05
            ret z                       ; 6E07
            cp &FF                      ; 6E08
            jr nz,L_6E16                ; 6E0A
L_6E0C:
            inc ix                      ; 6E0C
            inc ix                      ; 6E0E
            inc ix                      ; 6E10
            inc ix                      ; 6E12
            jr L_6E02                   ; 6E14
L_6E16:
            ld l,a                      ; 6E16
            ld h,(ix+1)                 ; 6E17
            ld b,(ix+2)                 ; 6E1A
            ld e,(ix+3)                 ; 6E1D
            call sub_6BFC               ; 6E20
            ld c,&10                    ; 6E23
            ld d,&00                    ; 6E25
            push hl                     ; 6E27
            ld hl,&694D                 ; 6E28
            add hl,de                   ; 6E2B
            ld e,(hl)                   ; 6E2C
            inc hl                      ; 6E2D
            ld d,(hl)                   ; 6E2E
            pop hl                      ; 6E2F
            ld a,l                      ; 6E30
            add a,e                     ; 6E31
            cp &01                      ; 6E32
            jr nc,L_6E38                ; 6E34
            jr L_6E67                   ; 6E36
L_6E38:
            cp &90                      ; 6E38
            jr c,L_6E3E                 ; 6E3A
            jr L_6E6B                   ; 6E3C
L_6E3E:
            ld l,a                      ; 6E3E
            ld a,h                      ; 6E3F
            add a,d                     ; 6E40
            ld h,a                      ; 6E41
            ld (ix+0),l                 ; 6E42
            ld (ix+1),h                 ; 6E45
            ld a,(ix+3)                 ; 6E48
            add a,&04                   ; 6E4B
            ld (ix+3),a                 ; 6E4D
            ld (&4006),hl               ; 6E50
            ld a,b                      ; 6E53
            bit 1,l                     ; 6E54
            jr nz,L_6E5F                ; 6E56
            inc a                       ; 6E58
            cp &0B                      ; 6E59
            jr nz,L_6E5F                ; 6E5B
            ld a,&08                    ; 6E5D
L_6E5F:
            ld (ix+2),a                 ; 6E5F
            call sub_6867               ; 6E62
            jr L_6E0C                   ; 6E65
L_6E67:
            ld a,&90                    ; 6E67
            jr L_6E6D                   ; 6E69
L_6E6B:
            ld a,&01                    ; 6E6B
L_6E6D:
            push af                     ; 6E6D
            ld a,l                      ; 6E6E
            sub e                       ; 6E6F
            ld l,a                      ; 6E70
            xor a                       ; 6E71
            ld (&4006),hl               ; 6E72
            call sub_6867               ; 6E75
            pop af                      ; 6E78
            jr L_6E3E                   ; 6E79
            ld ix,&6A50                 ; 6E7B
L_6E7F:
            ld a,(ix+0)                 ; 6E7F
            cp &FE                      ; 6E82
            ret z                       ; 6E84
            cp &FF                      ; 6E85
            jr nz,L_6E93                ; 6E87
L_6E89:
            inc ix                      ; 6E89
            inc ix                      ; 6E8B
            inc ix                      ; 6E8D
            inc ix                      ; 6E8F
            jr L_6E7F                   ; 6E91
L_6E93:
            ld l,a                      ; 6E93
            ld h,(ix+1)                 ; 6E94
            ld e,(ix+3)                 ; 6E97
            ld c,&10                    ; 6E9A
            ld a,l                      ; 6E9C
            add a,e                     ; 6E9D
            ld (&4006),hl               ; 6E9E
            cp &01                      ; 6EA1
            jr nc,L_6EAB                ; 6EA3
            xor a                       ; 6EA5
            call sub_6867               ; 6EA6
            ld a,&8F                    ; 6EA9
L_6EAB:
            cp &90                      ; 6EAB
            jr c,L_6EB5                 ; 6EAD
            xor a                       ; 6EAF
            call sub_6867               ; 6EB0
            ld a,&01                    ; 6EB3
L_6EB5:
            ld l,a                      ; 6EB5
            ld (ix+0),l                 ; 6EB6
            ld (&4006),hl               ; 6EB9
            ld a,&0E                    ; 6EBC
            call sub_6867               ; 6EBE
            jr L_6E89                   ; 6EC1
            ld ix,&6A50                 ; 6EC3
L_6EC7:
            ld a,(ix+0)                 ; 6EC7
            cp &FE                      ; 6ECA
            ret z                       ; 6ECC
            cp &FF                      ; 6ECD
            jr nz,L_6EDB                ; 6ECF
L_6ED1:
            inc ix                      ; 6ED1
            inc ix                      ; 6ED3
            inc ix                      ; 6ED5
            inc ix                      ; 6ED7
            jr L_6EC7                   ; 6ED9
L_6EDB:
            ld l,a                      ; 6EDB
            ld h,(ix+1)                 ; 6EDC
            ld e,(ix+2)                 ; 6EDF
            ld d,(ix+3)                 ; 6EE2
            call sub_6BFC               ; 6EE5
            ld c,&10                    ; 6EE8
            ld a,e                      ; 6EEA
            cp &40                      ; 6EEB
            jr c,L_6EF3                 ; 6EED
            ld b,&12                    ; 6EEF
            jr L_6EF5                   ; 6EF1
L_6EF3:
            ld b,&13                    ; 6EF3
L_6EF5:
            ld a,l                      ; 6EF5
            add a,e                     ; 6EF6
            cp &01                      ; 6EF7
            jr c,L_6F02                 ; 6EF9
            cp &90                      ; 6EFB
            jr nc,L_6F02                ; 6EFD
            ld l,a                      ; 6EFF
            jr L_6F09                   ; 6F00
L_6F02:
            ld l,a                      ; 6F02
            ld a,e                      ; 6F03
            cpl                         ; 6F04
            inc a                       ; 6F05
            ld (ix+2),a                 ; 6F06
L_6F09:
            ld a,h                      ; 6F09
            add a,d                     ; 6F0A
            cp &1E                      ; 6F0B
            jr c,L_6F16                 ; 6F0D
            cp &A0                      ; 6F0F
            jr nc,L_6F16                ; 6F11
            ld h,a                      ; 6F13
            jr L_6F1D                   ; 6F14
L_6F16:
            ld h,a                      ; 6F16
            ld a,d                      ; 6F17
            cpl                         ; 6F18
            inc a                       ; 6F19
            ld (ix+3),a                 ; 6F1A
L_6F1D:
            ld (ix+0),l                 ; 6F1D
            ld (ix+1),h                 ; 6F20
            ld (&4006),hl               ; 6F23
            ld a,b                      ; 6F26
            call sub_6867               ; 6F27
            jr L_6ED1                   ; 6F2A
            defb &00,&FF,&00,&FF,&00,&FF,&01,&FF          ; 6F2C '........'
            defb &00,&FF,&00,&FF,&01,&FF,&00,&FF          ; 6F34 '........'
            defb &00,&FF,&01,&FF,&01,&FF,&01,&FF          ; 6F3C '........'
            defb &01,&FF,&01,&FF,&01,&01,&01,&00          ; 6F44 '........'
            defb &01,&01,&00,&01,&01,&01,&01,&01          ; 6F4C '........'
            defb &00,&01,&00,&01,&01,&01,&00,&01          ; 6F54 '........'
            defb &00,&01,&01,&01,&00,&01,&00,&01          ; 6F5C '........'
            defb &01,&01,&00,&00                          ; 6F64 '....'
            ld ix,&6A50                 ; 6F68
L_6F6C:
            ld a,(ix+0)                 ; 6F6C
            cp &FE                      ; 6F6F
            ret z                       ; 6F71
            cp &FF                      ; 6F72
            jr nz,L_6F80                ; 6F74
L_6F76:
            inc ix                      ; 6F76
            inc ix                      ; 6F78
            inc ix                      ; 6F7A
            inc ix                      ; 6F7C
            jr L_6F6C                   ; 6F7E
L_6F80:
            ld l,a                      ; 6F80
            ld h,(ix+1)                 ; 6F81
            ld e,(ix+2)                 ; 6F84
            ld b,(ix+3)                 ; 6F87
            call sub_6BFC               ; 6F8A
            ld c,&10                    ; 6F8D
            inc e                       ; 6F8F
            inc e                       ; 6F90
            ld a,e                      ; 6F91
            cp &3A                      ; 6F92
            jr nz,L_6F98                ; 6F94
            ld e,&00                    ; 6F96
L_6F98:
            ld (ix+2),e                 ; 6F98
            ld d,&00                    ; 6F9B
            push hl                     ; 6F9D
            ld hl,&6F2C                 ; 6F9E
            add hl,de                   ; 6FA1
            ld e,(hl)                   ; 6FA2
            inc hl                      ; 6FA3
            ld d,(hl)                   ; 6FA4
            pop hl                      ; 6FA5
            ld a,b                      ; 6FA6
            cp &FF                      ; 6FA7
            jr nz,L_6FAF                ; 6FA9
            ld a,e                      ; 6FAB
            cpl                         ; 6FAC
            inc a                       ; 6FAD
            ld e,a                      ; 6FAE
L_6FAF:
            ld a,l                      ; 6FAF
            add a,e                     ; 6FB0
            cp &90                      ; 6FB1
            jr c,L_6FB7                 ; 6FB3
            ld b,&FF                    ; 6FB5
L_6FB7:
            cp &01                      ; 6FB7
            jr nc,L_6FBD                ; 6FB9
            ld b,&01                    ; 6FBB
L_6FBD:
            ld (ix+3),b                 ; 6FBD
            ld l,a                      ; 6FC0
            ld a,h                      ; 6FC1
            add a,d                     ; 6FC2
            ld h,a                      ; 6FC3
            ld (&4006),hl               ; 6FC4
            ld (ix+0),l                 ; 6FC7
            ld (ix+1),h                 ; 6FCA
            ld a,d                      ; 6FCD
            cp &01                      ; 6FCE
            jr z,L_6FD6                 ; 6FD0
            ld a,&14                    ; 6FD2
            jr L_6FD8                   ; 6FD4
L_6FD6:
            ld a,&15                    ; 6FD6
L_6FD8:
            call sub_6867               ; 6FD8
            jr L_6F76                   ; 6FDB
            ld ix,&6A50                 ; 6FDD
L_6FE1:
            ld a,(ix+0)                 ; 6FE1
            cp &FE                      ; 6FE4
            ret z                       ; 6FE6
            cp &FF                      ; 6FE7
            jr nz,L_6FF5                ; 6FE9
L_6FEB:
            inc ix                      ; 6FEB
            inc ix                      ; 6FED
            inc ix                      ; 6FEF
            inc ix                      ; 6FF1
            jr L_6FE1                   ; 6FF3
L_6FF5:
            ld l,a                      ; 6FF5
            ld h,(ix+1)                 ; 6FF6
            ld b,(ix+2)                 ; 6FF9
            ld e,(ix+3)                 ; 6FFC
            call sub_6BFC               ; 6FFF
            ld c,&10                    ; 7002
            ld a,l                      ; 7004
            add a,e                     ; 7005
            cp &01                      ; 7006
            jr c,L_700E                 ; 7008
            cp &90                      ; 700A
            jr c,L_7022                 ; 700C
L_700E:
            ld a,e                      ; 700E
            cpl                         ; 700F
            inc a                       ; 7010
            ld e,a                      ; 7011
            ld (ix+3),a                 ; 7012
            xor a                       ; 7015
            ld (&4006),hl               ; 7016
            call sub_6867               ; 7019
            ld a,h                      ; 701C
            add a,&10                   ; 701D
            ld h,a                      ; 701F
            jr L_7039                   ; 7020
L_7022:
            ld l,a                      ; 7022
            ld (ix+0),a                 ; 7023
            ld (&4006),hl               ; 7026
            bit 2,l                     ; 7029
            jr nz,L_7031                ; 702B
            ld a,&17                    ; 702D
            jr L_7033                   ; 702F
L_7031:
            ld a,&16                    ; 7031
L_7033:
            ld (ix+2),a                 ; 7033
            call sub_6867               ; 7036
L_7039:
            ld (ix+1),h                 ; 7039
            jr L_6FEB                   ; 703C
            defb &00                                      ; 703E '.'
            ld ix,&6A50                 ; 703F
L_7043:
            ld a,(ix+0)                 ; 7043
            cp &FE                      ; 7046
            ret z                       ; 7048
            cp &FF                      ; 7049
            jr nz,L_7057                ; 704B
L_704D:
            inc ix                      ; 704D
            inc ix                      ; 704F
            inc ix                      ; 7051
            inc ix                      ; 7053
            jr L_7043                   ; 7055
L_7057:
            ld l,a                      ; 7057
            ld h,(ix+1)                 ; 7058
            ld e,(ix+2)                 ; 705B
            ld d,(ix+3)                 ; 705E
            call sub_6BFC               ; 7061
            ld c,&10                    ; 7064
            ld a,l                      ; 7066
            add a,e                     ; 7067
            cp &01                      ; 7068
            jr c,L_708D                 ; 706A
            cp &90                      ; 706C
            jr nc,L_708D                ; 706E
            ld l,a                      ; 7070
            ld (ix+0),a                 ; 7071
            ld a,h                      ; 7074
            add a,d                     ; 7075
            ld h,a                      ; 7076
            ld (ix+1),a                 ; 7077
            ld a,l                      ; 707A
            ld (&4006),hl               ; 707B
            bit 2,a                     ; 707E
            jr z,L_7086                 ; 7080
            ld a,&18                    ; 7082
            jr L_7088                   ; 7084
L_7086:
            ld a,&19                    ; 7086
L_7088:
            call sub_6867               ; 7088
            jr L_704D                   ; 708B
L_708D:
            xor a                       ; 708D
            ld (&4006),hl               ; 708E
            call sub_6867               ; 7091
            ld a,(&703E)                ; 7094
            add a,&02                   ; 7097
            cp &0C                      ; 7099
            jr nz,L_709E                ; 709B
            xor a                       ; 709D
L_709E:
            ld (&703E),a                ; 709E
            ld (ix+0),&48               ; 70A1
            ld (ix+1),&64               ; 70A5
            ld e,a                      ; 70A9
            ld d,&00                    ; 70AA
            ld hl,&70BB                 ; 70AC
            add hl,de                   ; 70AF
            ld a,(hl)                   ; 70B0
            ld (ix+2),a                 ; 70B1
            inc hl                      ; 70B4
            ld a,(hl)                   ; 70B5
            ld (ix+3),a                 ; 70B6
            jr L_704D                   ; 70B9
            defb &FF,&00,&FF,&FF,&01,&FF,&01,&00          ; 70BB '........'
            defb &01,&01,&FF,&01                          ; 70C3 '....'
            ld ix,&6A50                 ; 70C7
L_70CB:
            ld a,(ix+0)                 ; 70CB
            cp &FE                      ; 70CE
            ret z                       ; 70D0
            cp &FF                      ; 70D1
            jr nz,L_70DF                ; 70D3
L_70D5:
            inc ix                      ; 70D5
            inc ix                      ; 70D7
            inc ix                      ; 70D9
            inc ix                      ; 70DB
            jr L_70CB                   ; 70DD
L_70DF:
            ld l,a                      ; 70DF
            ld h,(ix+1)                 ; 70E0
            ld b,(ix+2)                 ; 70E3
            call sub_6BFC               ; 70E6
            ld c,&10                    ; 70E9
            ld a,h                      ; 70EB
            inc a                       ; 70EC
            cp &A0                      ; 70ED
            jr c,L_710A                 ; 70EF
            ld h,&A0                    ; 70F1
            xor a                       ; 70F3
            ld (&4006),hl               ; 70F4
            call sub_6867               ; 70F7
            ld (ix+1),&1E               ; 70FA
            call sub_72BA               ; 70FE
            and &7F                     ; 7101
            add a,&08                   ; 7103
            ld (ix+0),a                 ; 7105
            jr L_70D5                   ; 7108
L_710A:
            ld h,a                      ; 710A
            ld a,l                      ; 710B
            bit 0,h                     ; 710C
            jr nz,L_7120                ; 710E
            ld a,(&6AEC)                ; 7110
            cp l                        ; 7113
            jr z,L_7120                 ; 7114
            jr c,L_711C                 ; 7116
            ld a,&01                    ; 7118
            jr L_711E                   ; 711A
L_711C:
            ld a,&FF                    ; 711C
L_711E:
            add a,l                     ; 711E
            ld l,a                      ; 711F
L_7120:
            ld (ix+0),a                 ; 7120
            ld (ix+1),h                 ; 7123
            ld (&4006),hl               ; 7126
            bit 3,h                     ; 7129
            jr nz,L_7131                ; 712B
            ld a,&1B                    ; 712D
            jr L_7133                   ; 712F
L_7131:
            ld a,&1A                    ; 7131
L_7133:
            ld (ix+2),a                 ; 7133
            call sub_6867               ; 7136
            jr L_70D5                   ; 7139
            ld ix,&6A50                 ; 713B
L_713F:
            ld a,(ix+0)                 ; 713F
            cp &FE                      ; 7142
            ret z                       ; 7144
            cp &FF                      ; 7145
            jr nz,L_7153                ; 7147
L_7149:
            inc ix                      ; 7149
            inc ix                      ; 714B
            inc ix                      ; 714D
            inc ix                      ; 714F
            jr L_713F                   ; 7151
L_7153:
            ld l,a                      ; 7153
            ld h,(ix+1)                 ; 7154
            ld b,(ix+2)                 ; 7157
            ld e,(ix+3)                 ; 715A
            call sub_6BFC               ; 715D
            ld c,&10                    ; 7160
            djnz L_7170                 ; 7162
            ld (&4006),hl               ; 7164
            xor a                       ; 7167
            call sub_6867               ; 7168
            call sub_7ABB               ; 716B
            jr L_7149                   ; 716E
L_7170:
            ld (ix+2),b                 ; 7170
            call sub_72BA               ; 7173
            cp &40                      ; 7176
            jr c,L_717E                 ; 7178
            ld a,&01                    ; 717A
            jr L_7180                   ; 717C
L_717E:
            ld a,&FF                    ; 717E
L_7180:
            add a,l                     ; 7180
            cp &01                      ; 7181
            jr c,L_718D                 ; 7183
            cp &90                      ; 7185
            jr nc,L_718D                ; 7187
            ld l,a                      ; 7189
            ld (ix+0),a                 ; 718A
L_718D:
            call sub_72BA               ; 718D
            cp &40                      ; 7190
            jr c,L_7198                 ; 7192
            ld a,&01                    ; 7194
            jr L_719A                   ; 7196
L_7198:
            ld a,&FF                    ; 7198
L_719A:
            add a,h                     ; 719A
            cp &1E                      ; 719B
            jr c,L_71A7                 ; 719D
            cp &A0                      ; 719F
            jr nc,L_71A7                ; 71A1
            ld h,a                      ; 71A3
            ld (ix+1),a                 ; 71A4
L_71A7:
            ld (&4006),hl               ; 71A7
            ld a,e                      ; 71AA
            bit 0,b                     ; 71AB
            jr nz,L_71B6                ; 71AD
            inc a                       ; 71AF
            cp &1F                      ; 71B0
            jr nz,L_71B6                ; 71B2
            ld a,&1C                    ; 71B4
L_71B6:
            ld (ix+3),a                 ; 71B6
            call sub_6867               ; 71B9
            jr L_7149                   ; 71BC
            ld ix,&6A50                 ; 71BE
L_71C2:
            ld a,(ix+0)                 ; 71C2
            cp &FE                      ; 71C5
            ret z                       ; 71C7
            cp &FF                      ; 71C8
            jr nz,L_71D6                ; 71CA
L_71CC:
            inc ix                      ; 71CC
            inc ix                      ; 71CE
            inc ix                      ; 71D0
            inc ix                      ; 71D2
            jr L_71C2                   ; 71D4
L_71D6:
            ld h,(ix+1)                 ; 71D6
            ld b,(ix+2)                 ; 71D9
            ld c,&10                    ; 71DC
            add a,b                     ; 71DE
            cp &01                      ; 71DF
            jr nc,L_71E5                ; 71E1
            ld b,&01                    ; 71E3
L_71E5:
            cp &90                      ; 71E5
            jr c,L_71EB                 ; 71E7
            ld b,&FF                    ; 71E9
L_71EB:
            ld (ix+2),b                 ; 71EB
            ld l,a                      ; 71EE
            bit 5,a                     ; 71EF
            jr z,L_71F7                 ; 71F1
            ld a,h                      ; 71F3
            inc a                       ; 71F4
            jr L_71F9                   ; 71F5
L_71F7:
            ld a,h                      ; 71F7
            dec a                       ; 71F8
L_71F9:
            cp &50                      ; 71F9
            jr nc,L_7201                ; 71FB
            ld a,&50                    ; 71FD
            jr L_7207                   ; 71FF
L_7201:
            cp &A0                      ; 7201
            jr c,L_7207                 ; 7203
            ld a,&A0                    ; 7205
L_7207:
            ld h,a                      ; 7207
            ld (ix+0),l                 ; 7208
            ld (ix+1),h                 ; 720B
            ld a,(ix+3)                 ; 720E
            bit 1,l                     ; 7211
            jr nz,L_721C                ; 7213
            inc a                       ; 7215
            cp &12                      ; 7216
            jr nz,L_721C                ; 7218
            ld a,&0F                    ; 721A
L_721C:
            ld (ix+3),a                 ; 721C
            ld (&4006),hl               ; 721F
            call sub_6867               ; 7222
            call sub_6BFC               ; 7225
            jr L_71CC                   ; 7228
            ld ix,&6BDA                 ; 722A
L_722E:
            ld a,(ix+0)                 ; 722E
            cp &FE                      ; 7231
            ret z                       ; 7233
            cp &FF                      ; 7234
            jr nz,L_723E                ; 7236
L_7238:
            inc ix                      ; 7238
            inc ix                      ; 723A
            jr L_722E                   ; 723C
L_723E:
            ld l,a                      ; 723E
            ld h,(ix+1)                 ; 723F
            ld a,h                      ; 7242
            add a,&02                   ; 7243
            ld h,a                      ; 7245
            cp &B8                      ; 7246
            jr c,L_7255                 ; 7248
            ld h,&B8                    ; 724A
            call sub_6BBD               ; 724C
            ld a,(&6AEC)                ; 724F
            ld l,a                      ; 7252
            ld h,&28                    ; 7253
L_7255:
            ld (ix+0),l                 ; 7255
            ld (ix+1),h                 ; 7258
            bit 1,h                     ; 725B
            jr nz,L_7263                ; 725D
            ld a,&1F                    ; 725F
            jr L_7265                   ; 7261
L_7263:
            ld a,&20                    ; 7263
L_7265:
            ld c,&10                    ; 7265
            ld (&4006),hl               ; 7267
            call sub_6867               ; 726A
            jr L_7238                   ; 726D
            defb &03                                      ; 726F '.'
sub_7270:
            ld a,(&726F)                ; 7270
            cp &05                      ; 7273
            jr c,L_7279                 ; 7275
            ld a,&05                    ; 7277
L_7279:
            ld b,a                      ; 7279
            ld c,&10                    ; 727A
            ld hl,&0060                 ; 727C
            ld d,a                      ; 727F
            dec b                       ; 7280
            jr z,L_7295                 ; 7281
L_7283:
            ld a,&0B                    ; 7283
            ld (&4006),hl               ; 7285
            call sub_6867               ; 7288
            ld a,l                      ; 728B
            add a,&10                   ; 728C
            ld l,a                      ; 728E
            djnz L_7283                 ; 728F
            ld a,d                      ; 7291
            cp &05                      ; 7292
            ret z                       ; 7294
L_7295:
            xor a                       ; 7295
            ld (&4006),hl               ; 7296
            call sub_6867               ; 7299
            ret                         ; 729C
sub_729D:
            push hl                     ; 729D
            push bc                     ; 729E
            push de                     ; 729F
            ld hl,&4189                 ; 72A0
            ld b,&B0                    ; 72A3
L_72A5:
            ld e,(hl)                   ; 72A5
            inc hl                      ; 72A6
            ld d,(hl)                   ; 72A7
            inc hl                      ; 72A8
            ex de,hl                    ; 72A9
            ld a,&50                    ; 72AA
L_72AC:
            ld (hl),&00                 ; 72AC
            inc hl                      ; 72AE
            dec a                       ; 72AF
            jr nz,L_72AC                ; 72B0
            ex de,hl                    ; 72B2
            djnz L_72A5                 ; 72B3
            pop de                      ; 72B5
            pop bc                      ; 72B6
            pop hl                      ; 72B7
            ret                         ; 72B8
            defb &23                                      ; 72B9 '#'
sub_72BA:
            ld a,(&72B9)                ; 72BA
            add a,&05                   ; 72BD
            ld (&72B9),a                ; 72BF
            xor &AA                     ; 72C2
            ret                         ; 72C4
            defb &01,&00,&00,&09,&00,&01,&10,&01          ; 72C5 '........'
            defb &20,&01,&30,&01,&40,&01,&50,&01          ; 72CD ' .0.@.P.'
            defb &60,&01,&70,&01,&80,&01,&0A              ; 72D5 '`.p....'
sub_72DC:
            ld a,(&72C5)                ; 72DC
            cp &09                      ; 72DF
            jr nz,L_72EF                ; 72E1
            ld a,(&72DB)                ; 72E3
            or a                        ; 72E6
            ret z                       ; 72E7
            dec a                       ; 72E8
            ld (&72DB),a                ; 72E9
            ld a,(&72C5)                ; 72EC
L_72EF:
            push hl                     ; 72EF
            push bc                     ; 72F0
            push de                     ; 72F1
            dec a                       ; 72F2
            add a,a                     ; 72F3
            ld e,a                      ; 72F4
            ld d,&00                    ; 72F5
            ld hl,&72C9                 ; 72F7
            add hl,de                   ; 72FA
            ld e,(hl)                   ; 72FB
            inc hl                      ; 72FC
            ld d,(hl)                   ; 72FD
            ld hl,&72C8                 ; 72FE
            ld a,(hl)                   ; 7301
            add a,e                     ; 7302
            daa                         ; 7303
            ld (hl),a                   ; 7304
            dec hl                      ; 7305
            ld a,(hl)                   ; 7306
            adc a,d                     ; 7307
            daa                         ; 7308
            ld (hl),a                   ; 7309
            dec hl                      ; 730A
            ld a,(hl)                   ; 730B
            adc a,&00                   ; 730C
            daa                         ; 730E
            ld (hl),a                   ; 730F
            ld a,&1F                    ; 7310
            call &BB5A                  ; TXT OUTPUT
            ld a,&07                    ; 7315
            call &BB5A                  ; TXT OUTPUT
            ld a,&01                    ; 731A
            call &BB5A                  ; TXT OUTPUT
            ld a,&0F                    ; 731F
            call &BB5A                  ; TXT OUTPUT
            ld a,&0F                    ; 7324
            call &BB5A                  ; TXT OUTPUT
            ld b,&03                    ; 7329
L_732B:
            ld a,(hl)                   ; 732B
            srl a                       ; 732C
            srl a                       ; 732E
            srl a                       ; 7330
            srl a                       ; 7332
            add a,&30                   ; 7334
            call &BB5A                  ; TXT OUTPUT
            ld a,(hl)                   ; 7339
            and &0F                     ; 733A
            add a,&30                   ; 733C
            call &BB5A                  ; TXT OUTPUT
            inc hl                      ; 7341
            djnz L_732B                 ; 7342
            call sub_734E               ; 7344
            pop de                      ; 7347
            pop bc                      ; 7348
            pop hl                      ; 7349
            ret                         ; 734A
            defb &01,&00,&00                              ; 734B '...'
sub_734E:
            ld hl,&734D                 ; 734E
            ld bc,&72C8                 ; 7351
            call sub_7769               ; 7354
            ret nc                      ; 7357
            dec hl                      ; 7358
            dec hl                      ; 7359
            ld a,(hl)                   ; 735A
            add a,&01                   ; 735B
            daa                         ; 735D
            ld (hl),a                   ; 735E
            ld hl,&726F                 ; 735F
            inc (hl)                    ; 7362
            call sub_7270               ; 7363
            push ix                     ; 7366
            ld hl,&40C0                 ; 7368
            call &BCAA                  ; SOUND QUEUE
            pop ix                      ; 736E
            ret                         ; 7370
            defb &01,&01,&00,&01,&01,&00,&01,&01          ; 7371 '........'
            defb &00,&01,&01,&00,&01,&01,&00,&01          ; 7379 '........'
            defb &01,&00,&01,&01,&00,&01,&01,&00          ; 7381 '........'
            defb &01,&01,&00,&01,&01,&00,&01,&01          ; 7389 '........'
            defb &00,&01,&01,&00,&01,&01,&00,&01          ; 7391 '........'
            defb &01,&00,&01,&01,&00,&01,&01,&00          ; 7399 '........'
            defb &01,&01,&00,&01,&01,&00,&01,&01          ; 73A1 '........'
            defb &00,&01,&01,&00,&01,&01,&00,&01          ; 73A9 '........'
            defb &01,&00,&01,&01,&00,&01,&01,&00          ; 73B1 '........'
            defb &01,&01,&00,&01,&01,&00,&01,&01          ; 73B9 '........'
            defb &00,&01,&01,&00,&01,&01,&00,&01          ; 73C1 '........'
            defb &01,&00,&01,&01,&00,&01,&01,&00          ; 73C9 '........'
            defb &01,&01,&00,&01,&01,&00,&01,&01          ; 73D1 '........'
            defb &00,&01,&01,&00,&01,&01,&00,&01          ; 73D9 '........'
            defb &01,&00,&01,&01,&00,&01,&01,&00          ; 73E1 '........'
            defb &01,&01,&00,&01,&01,&00,&01,&01          ; 73E9 '........'
            defb &00,&01,&01,&00,&01,&01,&00,&01          ; 73F1 '........'
            defb &01,&00,&01,&01,&00,&01,&01,&00          ; 73F9 '........'
            defb &01,&01,&00,&01,&01,&00,&01,&01          ; 7401 '........'
            defb &00,&01,&01,&00,&01,&01,&00,&01          ; 7409 '........'
            defb &01,&00,&01,&01,&00,&01,&01,&00          ; 7411 '........'
            defb &01,&01,&00,&01,&01,&00,&01,&01          ; 7419 '........'
            defb &00,&01,&01,&00,&00,&20,&00,&8F          ; 7421 '..... ..'
            defb &96,&00                                  ; 7429 '..'
            ld a,(&7427)                ; 742B
            ld bc,(&7425)               ; 742E
            ld e,a                      ; 7432
            ld d,&00                    ; 7433
            inc a                       ; 7435
            ld (&7427),a                ; 7436
            ld hl,&7371                 ; 7439
            add hl,de                   ; 743C
            ld a,c                      ; 743D
            add a,(hl)                  ; 743E
            ld c,a                      ; 743F
            ld a,b                      ; 7440
            inc a                       ; 7441
            cp &B8                      ; 7442
            jr nz,L_7453                ; 7444
            ld l,c                      ; 7446
            ld h,&B8                    ; 7447
            call sub_6BBD               ; 7449
            xor a                       ; 744C
            ld c,a                      ; 744D
            ld (&7427),a                ; 744E
            ld a,&20                    ; 7451
L_7453:
            ld b,a                      ; 7453
            ld (&7425),bc               ; 7454
            ld (&4006),bc               ; 7458
            ld c,&10                    ; 745C
            ld a,&21                    ; 745E
            call sub_6867               ; 7460
            ld a,(&742A)                ; 7463
            ld bc,(&7428)               ; 7466
            ld e,a                      ; 746A
            ld d,&00                    ; 746B
            inc a                       ; 746D
            ld (&742A),a                ; 746E
            ld hl,&7371                 ; 7471
            add hl,de                   ; 7474
            ld a,c                      ; 7475
            sub (hl)                    ; 7476
            ld c,a                      ; 7477
            ld a,b                      ; 7478
            inc a                       ; 7479
            cp &B8                      ; 747A
            jr nz,L_748C                ; 747C
            ld l,c                      ; 747E
            ld h,&B8                    ; 747F
            call sub_6BBD               ; 7481
            ld c,&90                    ; 7484
            xor a                       ; 7486
            ld (&742A),a                ; 7487
            ld a,&20                    ; 748A
L_748C:
            ld b,a                      ; 748C
            ld (&7428),bc               ; 748D
            ld (&4006),bc               ; 7491
            ld c,&10                    ; 7495
            ld a,&21                    ; 7497
            call sub_6867               ; 7499
            ret                         ; 749C
            defb &CD,&30,&6C,&CD,&2B,&74,&CD,&AB          ; 749D '.0l.+t..'
            defb &6C,&CD,&EE,&6A,&CD,&FE,&6D,&CD          ; 74A5 'l..j..m.'
            defb &09,&69,&CD,&AB,&6C,&18,&E9,&CD          ; 74AD '.i..l...'
            defb &83,&88,&CD,&7B,&6E,&CD,&2A,&72          ; 74B5 '...{n.*r'
            defb &CD,&EE,&6A,&CD,&2B,&74,&CD,&AB          ; 74BD '..j.+t..'
            defb &6C,&CD,&09,&69,&CD,&AB,&6C,&18          ; 74C5 'l..i..l.'
            defb &E9,&CD,&30,&6C,&CD,&2B,&74,&CD          ; 74CD '..0l.+t.'
            defb &AB,&6C,&CD,&C3,&6E,&CD,&EE,&6A          ; 74D5 '.l..n..j'
            defb &CD,&09,&69,&CD,&AB,&6C,&18,&E9          ; 74DD '..i..l..'
            defb &CD,&30,&6C,&CD,&2B,&74,&CD,&AB          ; 74E5 '.0l.+t..'
            defb &6C,&CD,&68,&6F,&CD,&EE,&6A,&CD          ; 74ED 'l.ho..j.'
            defb &09,&69,&CD,&AB,&6C,&18,&E9,&CD          ; 74F5 '.i..l...'
            defb &30,&6C,&CD,&2B,&74,&CD,&AB,&6C          ; 74FD '0l.+t..l'
            defb &CD,&EE,&6A,&CD,&DD,&6F,&CD,&09          ; 7505 '..j..o..'
            defb &69,&CD,&AB,&6C,&18,&E9,&CD,&3F          ; 750D 'i..l...?'
            defb &70,&CD,&2B,&74,&CD,&AB,&6C,&CD          ; 7515 'p.+t..l.'
            defb &EE,&6A,&CD,&30,&6C,&CD,&09,&69          ; 751D '.j.0l..i'
            defb &CD,&AB,&6C,&18,&E9,&CD,&C7,&70          ; 7525 '..l....p'
            defb &CD,&2B,&74,&CD,&AB,&6C,&CD,&EE          ; 752D '.+t..l..'
            defb &6A,&CD,&30,&6C,&CD,&09,&69,&CD          ; 7535 'j.0l..i.'
            defb &AB,&6C,&18,&E9,&CD,&3B,&71,&CD          ; 753D '.l...;q.'
            defb &2B,&74,&CD,&AB,&6C,&CD,&30,&6C          ; 7545 '+t..l.0l'
            defb &CD,&EE,&6A,&CD,&09,&69,&CD,&AB          ; 754D '..j..i..'
            defb &6C,&18,&E9,&3E,&0F,&32,&DB,&72          ; 7555 'l..>.2.r'
            defb &CD,&B3,&6D,&CD,&A2,&6A,&CD,&7B          ; 755D '..m..j.{'
            defb &6A,&CD,&BE,&71,&CD,&AB,&6C,&CD          ; 7565 'j..q..l.'
            defb &2B,&74,&CD,&EE,&6A,&CD,&09,&69          ; 756D '+t..j..i'
            defb &CD,&AB,&6C,&CD,&30,&6C,&CD,&BA          ; 7575 '..l.0l..'
            defb &6A,&18,&E3,&9D,&74,&B4,&74,&CE          ; 757D 'j...t.t.'
            defb &74,&E5,&74,&FC,&74,&13,&75,&2A          ; 7585 't.t.t.u*'
            defb &75,&41,&75,&58,&75,&B6,&78,&C4          ; 758D 'uAuXu.x.'
            defb &78,&D2,&78,&E0,&78,&EE,&78,&FC          ; 7595 'x.x.x.x.'
            defb &78,&0A,&79,&18,&79,&26,&79              ; 759D 'x.y.y&y'
L_75A4:
            call sub_729D               ; 75A4
            ld a,(&7633)                ; 75A7
            or a                        ; 75AA
            jr nz,L_75DF                ; 75AB
            ld hl,&831E                 ; 75AD
            ld a,(&72C5)                ; 75B0
            dec a                       ; 75B3
            add a,a                     ; 75B4
            ld e,a                      ; 75B5
            ld d,&00                    ; 75B6
            add hl,de                   ; 75B8
            ld e,(hl)                   ; 75B9
            inc hl                      ; 75BA
            ld d,(hl)                   ; 75BB
            ex de,hl                    ; 75BC
            call print_string           ; 75BD
L_75C0:
            ld a,&15                    ; 75C0
            call &BB1E                  ; KM TEST KEY
            jr z,L_75CE                 ; 75C5
            call &BB24                  ; KM GET JOYSTICK
            bit 4,h                     ; 75CA
            jr nz,L_75C0                ; 75CC
L_75CE:
            ld a,&15                    ; 75CE
            call &BB1E                  ; KM TEST KEY
            jr nz,L_75DC                ; 75D3
            call &BB24                  ; KM GET JOYSTICK
            bit 4,h                     ; 75D8
            jr z,L_75CE                 ; 75DA
L_75DC:
            call sub_76B6               ; 75DC
L_75DF:
            call sub_7784               ; 75DF
L_75E2:
            ld a,&15                    ; 75E2
            call &BB1E                  ; KM TEST KEY
            jr z,L_75F0                 ; 75E7
            call &BB24                  ; KM GET JOYSTICK
            bit 4,h                     ; 75EC
            jr nz,L_75E2                ; 75EE
L_75F0:
            ld a,&15                    ; 75F0
            call &BB1E                  ; KM TEST KEY
            jr nz,main                  ; 75F5
            call &BB24                  ; KM GET JOYSTICK
            bit 4,h                     ; 75FA
            jr z,L_75F0                 ; 75FC
main:
            ld hl,&4118                 ; 75FE
            call print_string           ; 7601
            ld a,&03                    ; 7604
            ld (&7816),a                ; 7606
            ld (&726F),a                ; 7609
            call sub_7270               ; 760C
            ld a,&01                    ; 760F
            ld (&734B),a                ; 7611
            xor a                       ; 7614
            ld (&7819),a                ; 7615
            ld a,&06                    ; 7618
            ld (&7817),a                ; 761A
            call sub_77EF               ; 761D
            ld a,(&72C5)                ; 7620
            ld (&7633),a                ; 7623
            xor a                       ; 7626
            ld (&72C6),a                ; 7627
            ld (&72C7),a                ; 762A
            ld (&72C8),a                ; 762D
            jp L_781A                   ; 7630
            defb &00,&00,&00,&00,&20,&20,&20,&20          ; 7633 '....    '
            defb &20,&20,&20,&20,&20,&20,&00,&00          ; 763B '      ..'
            defb &00,&20,&20,&20,&20,&20,&20,&20          ; 7643 '.       '
            defb &20,&20,&20,&00,&00,&00,&20,&20          ; 764B '   ...  '
            defb &20,&20,&20,&20,&20,&20,&20,&20          ; 7653 '        '
            defb &00,&00,&00,&20,&20,&20,&20,&20          ; 765B '...     '
            defb &20,&20,&20,&20,&20,&00,&00,&00          ; 7663 '     ...'
            defb &20,&20,&20,&20,&20,&20,&20,&20          ; 766B '        '
            defb &20,&20,&00,&00,&00,&20,&20,&20          ; 7673 '  ...   '
            defb &20,&20,&20,&20,&20,&20,&20,&00          ; 767B '       .'
            defb &00,&00,&20,&20,&20,&20,&20,&20          ; 7683 '..      '
            defb &20,&20,&20,&20,&00,&00,&00,&20          ; 768B '    ... '
            defb &20,&20,&20,&20,&20,&20,&20,&20          ; 7693 '        '
            defb &20,&00,&00,&00,&20,&20,&20,&20          ; 769B ' ...    '
            defb &20,&20,&20,&20,&20,&20,&00,&00          ; 76A3 '      ..'
            defb &00,&20,&20,&20,&20,&20,&20,&20          ; 76AB '.       '
            defb &20,&20,&20                              ; 76B3 '   '
sub_76B6:
            ld a,(&7633)                ; 76B6
            or a                        ; 76B9
            ret nz                      ; 76BA
            ld bc,&72C8                 ; 76BB
            ld hl,&76AB                 ; 76BE
            call sub_7769               ; 76C1
            ret nc                      ; 76C4
            call sub_729D               ; 76C5
            ld de,&000D                 ; 76C8
            ld a,&0A                    ; 76CB
L_76CD:
            and a                       ; 76CD
            sbc hl,de                   ; 76CE
            dec a                       ; 76D0
            jr z,L_76D8                 ; 76D1
            call sub_7769               ; 76D3
            jr c,L_76CD                 ; 76D6
L_76D8:
            add hl,de                   ; 76D8
            ld de,&76AB                 ; 76D9
            push hl                     ; 76DC
            and a                       ; 76DD
            sbc hl,de                   ; 76DE
            jr z,L_76F2                 ; 76E0
            pop hl                      ; 76E2
            push hl                     ; 76E3
            ex de,hl                    ; 76E4
            and a                       ; 76E5
            sbc hl,de                   ; 76E6
            ld b,h                      ; 76E8
            ld c,l                      ; 76E9
            ld de,&76B5                 ; 76EA
            ld hl,&76A8                 ; 76ED
            lddr                        ; 76F0
L_76F2:
            pop hl                      ; 76F2
            push hl                     ; 76F3
            ld b,&0A                    ; 76F4
L_76F6:
            inc hl                      ; 76F6
            ld (hl),&20                 ; 76F7
            djnz L_76F6                 ; 76F9
            pop hl                      ; 76FB
            dec hl                      ; 76FC
            dec hl                      ; 76FD
            ld de,&72C6                 ; 76FE
            ld b,&03                    ; 7701
L_7703:
            ld a,(de)                   ; 7703
            ld (hl),a                   ; 7704
            inc hl                      ; 7705
            inc de                      ; 7706
            djnz L_7703                 ; 7707
            call sub_7728               ; 7709
            ret                         ; 770C
            defb &0F,&02,&1F,&02,&08,&50,&4C,&45          ; 770D '.....PLE'
            defb &41,&53,&45,&20,&45,&4E,&54,&45          ; 7715 'ASE ENTE'
            defb &52,&20,&20,&4E,&41,&4D,&45,&1F          ; 771D 'R  NAME.'
            defb &06,&0C,&FF                              ; 7725 '...'
sub_7728:
            push hl                     ; 7728
            ld hl,&770D                 ; 7729
            call print_string           ; 772C
            call &BB03                  ; KM RESET
            pop hl                      ; 7732
            ld b,&00                    ; 7733
L_7735:
            call &BB09                  ; KM READ CHAR
            ld c,a                      ; 7738
            jr nc,L_7735                ; 7739
            cp &0D                      ; 773B
            ret z                       ; 773D
            cp &7F                      ; 773E
            jr z,L_7754                 ; 7740
            cp &20                      ; 7742
            jr c,L_7735                 ; 7744
            ld a,b                      ; 7746
            cp &0A                      ; 7747
            jr z,L_7735                 ; 7749
            inc b                       ; 774B
            ld a,c                      ; 774C
            ld (hl),a                   ; 774D
            inc hl                      ; 774E
            call &BB5A                  ; TXT OUTPUT
            jr L_7735                   ; 7752
L_7754:
            ld a,b                      ; 7754
            or a                        ; 7755
            jr z,L_7735                 ; 7756
            dec b                       ; 7758
            dec hl                      ; 7759
            ld (hl),&20                 ; 775A
            ld a,&08                    ; 775C
            call &BB5A                  ; TXT OUTPUT
            ld a,&10                    ; 7761
            call &BB5A                  ; TXT OUTPUT
            jr L_7735                   ; 7766
            defb &00                                      ; 7768 '.'
sub_7769:
            ld (&7768),a                ; 7769
            push hl                     ; 776C
            push bc                     ; 776D
            push de                     ; 776E
            ld e,c                      ; 776F
            ld d,b                      ; 7770
            ex de,hl                    ; 7771
            ld a,(de)                   ; 7772
            and a                       ; 7773
            sub (hl)                    ; 7774
            dec de                      ; 7775
            dec hl                      ; 7776
            ld a,(de)                   ; 7777
            sbc a,(hl)                  ; 7778
            dec de                      ; 7779
            dec hl                      ; 777A
            ld a,(de)                   ; 777B
            sbc a,(hl)                  ; 777C
            pop de                      ; 777D
            pop bc                      ; 777E
            pop hl                      ; 777F
            ld a,(&7768)                ; 7780
            ret                         ; 7783
sub_7784:
            ld a,&0F                    ; 7784
            call &BB5A                  ; TXT OUTPUT
            ld a,&0E                    ; 7789
            call &BB5A                  ; TXT OUTPUT
            call sub_729D               ; 778E
            ld e,&06                    ; 7791
            ld d,&0A                    ; 7793
            ld hl,&7634                 ; 7795
L_7798:
            ld a,&1F                    ; 7798
            call &BB5A                  ; TXT OUTPUT
            ld a,&03                    ; 779D
            call &BB5A                  ; TXT OUTPUT
            ld a,e                      ; 77A2
            call &BB5A                  ; TXT OUTPUT
            ld b,&03                    ; 77A6
L_77A8:
            ld a,(hl)                   ; 77A8
            srl a                       ; 77A9
            srl a                       ; 77AB
            srl a                       ; 77AD
            srl a                       ; 77AF
            add a,&30                   ; 77B1
            call &BB5A                  ; TXT OUTPUT
            ld a,(hl)                   ; 77B6
            and &0F                     ; 77B7
            add a,&30                   ; 77B9
            call &BB5A                  ; TXT OUTPUT
            inc hl                      ; 77BE
            djnz L_77A8                 ; 77BF
            ld b,&0A                    ; 77C1
            ld a,&20                    ; 77C3
            call &BB5A                  ; TXT OUTPUT
L_77C8:
            ld a,(hl)                   ; 77C8
            call &BB5A                  ; TXT OUTPUT
            inc hl                      ; 77CC
            djnz L_77C8                 ; 77CD
            ld a,e                      ; 77CF
            add a,&02                   ; 77D0
            ld e,a                      ; 77D2
            dec d                       ; 77D3
            jr nz,L_7798                ; 77D4
            ret                         ; 77D6
            defb &0F,&0F,&1F,&02,&0C,&45,&4E,&54          ; 77D7 '.....ENT'
            defb &45,&52,&20,&4C,&45,&56,&45,&4C          ; 77DF 'ER LEVEL'
            defb &20,&20,&28,&31,&2D,&39,&29,&FF          ; 77E7 '  (1-9).'
sub_77EF:
            call sub_729D               ; 77EF
            ld hl,&77D7                 ; 77F2
            call print_string           ; 77F5
            call &BB03                  ; KM RESET
L_77FB:
            call &BB09                  ; KM READ CHAR
            jr nc,L_77FB                ; 77FE
            cp &31                      ; 7800
            jr c,L_77FB                 ; 7802
            cp &3A                      ; 7804
            jr nc,L_77FB                ; 7806
            sub &31                     ; 7808
            ld (&72C5),a                ; 780A
            ld bc,&1F40                 ; 780D
L_7810:
            dec bc                      ; 7810
            ld a,b                      ; 7811
            or c                        ; 7812
            jr nz,L_7810                ; 7813
            ret                         ; 7815
            defb &03,&06,&06,&00                          ; 7816 '....'
L_781A:
            ld sp,&AFC8                 ; 781A
            ld a,&FF                    ; 781D
            ld (&6CA9),a                ; 781F
            ld l,&48                    ; 7822
            ld h,&B8                    ; 7824
            ld (&6AEC),hl               ; 7826
            call sub_729D               ; 7829
            call sub_7B44               ; 782C
            ld hl,&6A50                 ; 782F
            call sub_4150               ; 7832
            ld hl,&68BF                 ; 7835
            call sub_4150               ; 7838
            ld hl,&6BDA                 ; 783B
            call sub_4150               ; 783E
            ld a,(&72C5)                ; 7841
            inc a                       ; 7844
            cp &0A                      ; 7845
            jr nz,L_7861                ; 7847
            ld a,(&7819)                ; 7849
            inc a                       ; 784C
            ld (&7819),a                ; 784D
            ld a,(&7816)                ; 7850
            inc a                       ; 7853
            ld (&7816),a                ; 7854
            ld a,(&7817)                ; 7857
            add a,&05                   ; 785A
            ld (&7817),a                ; 785C
            ld a,&01                    ; 785F
L_7861:
            ld (&72C5),a                ; 7861
            ld a,&1F                    ; 7864
            call &BB5A                  ; TXT OUTPUT
            ld a,&09                    ; 7869
            call &BB5A                  ; TXT OUTPUT
            ld a,&02                    ; 786E
            call &BB5A                  ; TXT OUTPUT
            ld a,&0F                    ; 7873
            call &BB5A                  ; TXT OUTPUT
            ld a,&0A                    ; 7878
            call &BB5A                  ; TXT OUTPUT
            ld a,(&72C5)                ; 787D
            add a,&30                   ; 7880
            call &BB5A                  ; TXT OUTPUT
            ld a,(&7817)                ; 7885
            ld (&7818),a                ; 7888
            ld a,(&7816)                ; 788B
            ld b,a                      ; 788E
            ld a,(&72C5)                ; 788F
            dec a                       ; 7892
            add a,a                     ; 7893
            ld e,a                      ; 7894
            ld d,&00                    ; 7895
            push de                     ; 7897
            ld hl,&7592                 ; 7898
            add hl,de                   ; 789B
            ld e,(hl)                   ; 789C
            inc hl                      ; 789D
            ld d,(hl)                   ; 789E
            ex de,hl                    ; 789F
            ld ix,&6A50                 ; 78A0
            ld de,&78A9                 ; 78A4
            push de                     ; 78A7
            jp (hl)                     ; 78A8
            defb &CD,&9D,&72,&D1                          ; 78A9 '..r.'
L_78AD:
            ld hl,&7580                 ; 78AD
            add hl,de                   ; 78B0
            ld e,(hl)                   ; 78B1
            inc hl                      ; 78B2
            ld d,(hl)                   ; 78B3
            ex de,hl                    ; 78B4
            jp (hl)                     ; 78B5
            defb &CD,&87,&79,&DD,&23,&DD,&23,&DD          ; 78B6 '..y.#.#.'
            defb &23,&DD,&23,&10,&F3,&C9,&CD,&BA          ; 78BE '#.#.....'
            defb &79,&DD,&23,&DD,&23,&DD,&23,&DD          ; 78C6 'y.#.#.#.'
            defb &23,&10,&F3,&C9,&CD,&E3,&79,&DD          ; 78CE '#.....y.'
            defb &23,&DD,&23,&DD,&23,&DD,&23,&10          ; 78D6 '#.#.#.#.'
            defb &F3,&C9,&CD,&27,&7A,&DD,&23,&DD          ; 78DE '...'z.#.'
            defb &23,&DD,&23,&DD,&23,&10,&F3,&C9          ; 78E6 '#.#.#...'
            defb &CD,&57,&7A,&DD,&23,&DD,&23,&DD          ; 78EE '.Wz.#.#.'
            defb &23,&DD,&23,&10,&F3,&C9,&CD,&7A          ; 78F6 '#.#....z'
            defb &7A,&DD,&23,&DD,&23,&DD,&23,&DD          ; 78FE 'z.#.#.#.'
            defb &23,&10,&F3,&C9,&CD,&A0,&7A,&DD          ; 7906 '#.....z.'
            defb &23,&DD,&23,&DD,&23,&DD,&23,&10          ; 790E '#.#.#.#.'
            defb &F3,&C9,&CD,&BB,&7A,&DD,&23,&DD          ; 7916 '....z.#.'
            defb &23,&DD,&23,&DD,&23,&10,&F3,&C9          ; 791E '#.#.#...'
            defb &CD,&F2,&7A,&DD,&23,&DD,&23,&DD          ; 7926 '..z.#.#.'
            defb &23,&DD,&23,&10,&F3,&C9                  ; 792E '#.#...'
L_7934:
            dec (ix+3)                  ; 7934
            jr z,L_7954                 ; 7937
            ld (ix+0),l                 ; 7939
            ret                         ; 793C
sub_793D:
            push ix                     ; 793D
            push hl                     ; 793F
            push bc                     ; 7940
            push de                     ; 7941
            ld hl,&40A5                 ; 7942
            call &BCAA                  ; SOUND QUEUE
            pop de                      ; 7948
            pop bc                      ; 7949
            pop hl                      ; 794A
            pop ix                      ; 794B
            ld a,(&72C5)                ; 794D
            cp &07                      ; 7950
            jr z,L_7934                 ; 7952
L_7954:
            ld a,(&7818)                ; 7954
            dec a                       ; 7957
            ld (&7818),a                ; 7958
            or a                        ; 795B
            jp z,L_781A                 ; 795C
            ld hl,&7816                 ; 795F
            cp (hl)                     ; 7962
            ret c                       ; 7963
            ld a,(&72C5)                ; 7964
            dec a                       ; 7967
            add a,a                     ; 7968
            ld e,a                      ; 7969
            ld d,&00                    ; 796A
            ld hl,&7975                 ; 796C
            add hl,de                   ; 796F
            ld e,(hl)                   ; 7970
            inc hl                      ; 7971
            ld d,(hl)                   ; 7972
            ex de,hl                    ; 7973
            jp (hl)                     ; 7974
            defb &87,&79,&BA,&79,&E3,&79,&27,&7A          ; 7975 '.y.y.y'z'
            defb &57,&7A,&7A,&7A,&A0,&7A,&BB,&7A          ; 797D 'Wzzz.z.z'
            defb &F2,&7A                                  ; 7985 '.z'
            call sub_72BA               ; 7987
            and &7F                     ; 798A
            add a,&08                   ; 798C
            ld (ix+0),a                 ; 798E
            call sub_72BA               ; 7991
            and &1F                     ; 7994
            ld c,a                      ; 7996
            call sub_72BA               ; 7997
            and &07                     ; 799A
            add a,c                     ; 799C
            add a,&47                   ; 799D
            ld (ix+1),a                 ; 799F
            ld (ix+1),a                 ; 79A2
            ld (ix+2),&09               ; 79A5
            call sub_72BA               ; 79A9
            cp &40                      ; 79AC
            jr c,L_79B4                 ; 79AE
            ld a,&00                    ; 79B0
            jr L_79B6                   ; 79B2
L_79B4:
            ld a,&02                    ; 79B4
L_79B6:
            ld (ix+3),a                 ; 79B6
            ret                         ; 79B9
            call sub_72BA               ; 79BA
            and &7F                     ; 79BD
            add a,&08                   ; 79BF
            ld (ix+0),a                 ; 79C1
            call sub_72BA               ; 79C4
            and &3F                     ; 79C7
            add a,&46                   ; 79C9
            ld (ix+1),a                 ; 79CB
            call sub_72BA               ; 79CE
            bit 0,a                     ; 79D1
            jr z,L_79D9                 ; 79D3
            ld a,&FF                    ; 79D5
            jr L_79DB                   ; 79D7
L_79D9:
            ld a,&01                    ; 79D9
L_79DB:
            ld (ix+2),&0E               ; 79DB
            ld (ix+3),a                 ; 79DF
            ret                         ; 79E2
            call sub_72BA               ; 79E3
            and &7F                     ; 79E6
            add a,&08                   ; 79E8
            ld (ix+0),a                 ; 79EA
            call sub_72BA               ; 79ED
            and &3F                     ; 79F0
            ld c,a                      ; 79F2
            call sub_72BA               ; 79F3
            and &1F                     ; 79F6
            add a,c                     ; 79F8
            ld c,a                      ; 79F9
            call sub_72BA               ; 79FA
            and &0F                     ; 79FD
            add a,c                     ; 79FF
            add a,&21                   ; 7A00
            ld (ix+1),a                 ; 7A02
            call sub_72BA               ; 7A05
            cp &40                      ; 7A08
            jr c,L_7A12                 ; 7A0A
            ld (ix+2),&FF               ; 7A0C
            jr L_7A16                   ; 7A10
L_7A12:
            ld (ix+2),&01               ; 7A12
L_7A16:
            call sub_72BA               ; 7A16
            cp &40                      ; 7A19
            jr c,L_7A22                 ; 7A1B
            ld (ix+3),&01               ; 7A1D
            ret                         ; 7A21
L_7A22:
            ld (ix+3),&FF               ; 7A22
            ret                         ; 7A26
            call sub_72BA               ; 7A27
            and &7F                     ; 7A2A
            add a,&08                   ; 7A2C
            ld (ix+0),a                 ; 7A2E
            call sub_72BA               ; 7A31
            and &3F                     ; 7A34
            ld c,a                      ; 7A36
            call sub_72BA               ; 7A37
            and &0F                     ; 7A3A
            add a,c                     ; 7A3C
            add a,&44                   ; 7A3D
            ld (ix+1),a                 ; 7A3F
            ld (ix+2),&00               ; 7A42
            call sub_72BA               ; 7A46
            cp &40                      ; 7A49
            jr c,L_7A51                 ; 7A4B
            ld a,&01                    ; 7A4D
            jr L_7A53                   ; 7A4F
L_7A51:
            ld a,&FF                    ; 7A51
L_7A53:
            ld (ix+3),a                 ; 7A53
            ret                         ; 7A56
            call sub_72BA               ; 7A57
            and &7F                     ; 7A5A
            add a,&08                   ; 7A5C
            ld (ix+0),a                 ; 7A5E
            ld (ix+1),&28               ; 7A61
            ld (ix+2),&16               ; 7A65
            call sub_72BA               ; 7A69
            cp &40                      ; 7A6C
            jr c,L_7A74                 ; 7A6E
            ld a,&FF                    ; 7A70
            jr L_7A76                   ; 7A72
L_7A74:
            ld a,&01                    ; 7A74
L_7A76:
            ld (ix+3),a                 ; 7A76
            ret                         ; 7A79
            ld (ix+0),&48               ; 7A7A
            ld (ix+1),&64               ; 7A7E
            ld a,(&703E)                ; 7A82
            add a,&02                   ; 7A85
            cp &0C                      ; 7A87
            jr nz,L_7A8C                ; 7A89
            xor a                       ; 7A8B
L_7A8C:
            ld (&703E),a                ; 7A8C
            ld e,a                      ; 7A8F
            ld d,&00                    ; 7A90
            ld hl,&70BB                 ; 7A92
            add hl,de                   ; 7A95
            ld a,(hl)                   ; 7A96
            ld (ix+2),a                 ; 7A97
            inc hl                      ; 7A9A
            ld a,(hl)                   ; 7A9B
            ld (ix+3),a                 ; 7A9C
            ret                         ; 7A9F
            ld (ix+1),&1E               ; 7AA0
            call sub_72BA               ; 7AA4
            and &7F                     ; 7AA7
            add a,&08                   ; 7AA9
            ld (ix+0),a                 ; 7AAB
            ld (ix+2),&1A               ; 7AAE
            ld a,(&7819)                ; 7AB2
            add a,&02                   ; 7AB5
            ld (ix+3),a                 ; 7AB7
            ret                         ; 7ABA
sub_7ABB:
            ld (ix+2),&20               ; 7ABB
            ld (ix+3),&1C               ; 7ABF
            call sub_72BA               ; 7AC3
            and &7F                     ; 7AC6
            add a,&08                   ; 7AC8
            ld (ix+0),a                 ; 7ACA
            call sub_72BA               ; 7ACD
            and &3F                     ; 7AD0
            ld c,a                      ; 7AD2
            call sub_72BA               ; 7AD3
            and &1F                     ; 7AD6
            add a,c                     ; 7AD8
            add a,&23                   ; 7AD9
            ld (ix+1),a                 ; 7ADB
            ret                         ; 7ADE
sub_7ADF:
            push ix                     ; 7ADF
            push hl                     ; 7AE1
            push bc                     ; 7AE2
            push de                     ; 7AE3
            call sub_72DC               ; 7AE4
            ld hl,&40A5                 ; 7AE7
            call &BCAA                  ; SOUND QUEUE
            pop de                      ; 7AED
            pop bc                      ; 7AEE
            pop hl                      ; 7AEF
            pop ix                      ; 7AF0
            call sub_72BA               ; 7AF2
            and &7F                     ; 7AF5
            add a,&08                   ; 7AF7
            ld (ix+0),a                 ; 7AF9
            call sub_72BA               ; 7AFC
            and &3F                     ; 7AFF
            ld c,a                      ; 7B01
            call sub_72BA               ; 7B02
            and &0F                     ; 7B05
            add a,c                     ; 7B07
            ld c,a                      ; 7B08
            call sub_72BA               ; 7B09
            and &07                     ; 7B0C
            add a,c                     ; 7B0E
            add a,&50                   ; 7B0F
            ld (ix+1),a                 ; 7B11
            call sub_72BA               ; 7B14
            cp &40                      ; 7B17
            jr c,L_7B1F                 ; 7B19
            ld a,&01                    ; 7B1B
            jr L_7B21                   ; 7B1D
L_7B1F:
            ld a,&FF                    ; 7B1F
L_7B21:
            ld (ix+2),a                 ; 7B21
            ld (ix+3),&10               ; 7B24
            ret                         ; 7B28
            defb &B5,&7C,&3C,&7D,&DF,&7D,&AC,&7E          ; 7B29 '.|<}.}.~'
            defb &47,&7F,&21,&80,&D8,&80,&76,&81          ; 7B31 'G.!...v.'
            defb &02,&82,&0E,&12,&14,&16,&18,&1B          ; 7B39 '........'
            defb &1C,&0F,&09                              ; 7B41 '...'
sub_7B44:
            ld a,(&72C5)                ; 7B44
            or a                        ; 7B47
            jr nz,L_7B4C                ; 7B48
            ld a,&09                    ; 7B4A
L_7B4C:
            dec a                       ; 7B4C
            ld e,a                      ; 7B4D
            ld d,&00                    ; 7B4E
            ld hl,&7B3B                 ; 7B50
            add hl,de                   ; 7B53
            ld a,(hl)                   ; 7B54
            ld c,&10                    ; 7B55
            ld l,&1C                    ; 7B57
            ld h,&AC                    ; 7B59
            ld (&4006),hl               ; 7B5B
            call sub_6867               ; 7B5E
            call sub_7BAC               ; 7B61
            ld a,(&72C5)                ; 7B64
            or a                        ; 7B67
            jr nz,L_7B6F                ; 7B68
            ld hl,&7BDF                 ; 7B6A
            jr L_7B87                   ; 7B6D
L_7B6F:
            dec a                       ; 7B6F
            add a,a                     ; 7B70
            ld e,a                      ; 7B71
            ld a,(&7633)                ; 7B72
            or a                        ; 7B75
            jr z,L_7B7D                 ; 7B76
            ld hl,&7BC9                 ; 7B78
            jr L_7B87                   ; 7B7B
L_7B7D:
            ld d,&00                    ; 7B7D
            ld hl,&7B29                 ; 7B7F
            add hl,de                   ; 7B82
            ld e,(hl)                   ; 7B83
            inc hl                      ; 7B84
            ld d,(hl)                   ; 7B85
            ex de,hl                    ; 7B86
L_7B87:
            call print_string           ; 7B87
            ld hl,&82D4                 ; 7B8A
            call print_string           ; 7B8D
L_7B90:
            ld a,&15                    ; 7B90
            call &BB1E                  ; KM TEST KEY
            jr z,L_7B9E                 ; 7B95
            call &BB24                  ; KM GET JOYSTICK
            bit 4,h                     ; 7B9A
            jr nz,L_7B90                ; 7B9C
L_7B9E:
            ld a,&15                    ; 7B9E
            call &BB1E                  ; KM TEST KEY
            ret nz                      ; 7BA3
            call &BB24                  ; KM GET JOYSTICK
            bit 4,h                     ; 7BA7
            jr z,L_7B9E                 ; 7BA9
            ret                         ; 7BAB
sub_7BAC:
            ld a,&0C                    ; 7BAC
            ld h,&AC                    ; 7BAE
            ld l,&6B                    ; 7BB0
            ld (&4006),hl               ; 7BB2
            ld c,&0A                    ; 7BB5
            call sub_6867               ; 7BB7
            ld c,&10                    ; 7BBA
            ld a,&21                    ; 7BBC
            ld h,&AC                    ; 7BBE
            ld l,&81                    ; 7BC0
            ld (&4006),hl               ; 7BC2
            call sub_6867               ; 7BC5
            ret                         ; 7BC8

; -------- &7BC9+  TEXT - 'THE MASTER' messages, enemy names, sheet-complete lines, UI --------
            defb &0F,&0C,&1F,&04,&0A,&0F,&0C,&50          ; 7BC9 '.......P'
            defb &52,&41,&43,&54,&49,&43,&45,&20          ; 7BD1 'RACTICE '
            defb &53,&48,&45,&45,&54,&FF,&0F,&0E          ; 7BD9 'SHEET...'
            defb &1F,&02,&06,&0F,&0C,&49,&20,&20          ; 7BE1 '.....I  '
            defb &41,&4D,&20,&20,&54,&48,&45,&20          ; 7BE9 'AM  THE '
            defb &20,&4D,&41,&53,&54,&45,&52,&1F          ; 7BF1 ' MASTER.'
            defb &01,&08,&0F,&04,&61,&6E,&64,&20          ; 7BF9 '....and '
            defb &20,&49,&20,&20,&61,&6D,&20,&20          ; 7C01 ' I  am  '
            defb &67,&6F,&69,&6E,&67,&20,&74,&6F          ; 7C09 'going to'
            defb &1F,&01,&09,&63,&6F,&6E,&71,&75          ; 7C11 '...conqu'
            defb &65,&72,&20,&74,&68,&65,&20,&20          ; 7C19 'er the  '
            defb &67,&61,&6C,&61,&78,&79,&2E,&1F          ; 7C21 'galaxy..'
            defb &01,&0A,&59,&6F,&75,&20,&20,&74          ; 7C29 '..You  t'
            defb &68,&69,&6E,&6B,&20,&20,&79,&6F          ; 7C31 'hink  yo'
            defb &75,&20,&20,&63,&61,&6E,&1F,&01          ; 7C39 'u  can..'
            defb &0B,&73,&74,&6F,&70,&20,&6D,&65          ; 7C41 '.stop me'
            defb &2C,&20,&64,&6F,&20,&79,&6F,&75          ; 7C49 ', do you'
            defb &3F,&20,&59,&6F,&75,&1F,&01,&0C          ; 7C51 '? You...'
            defb &68,&61,&76,&65,&20,&33,&20,&6C          ; 7C59 'have 3 l'
            defb &69,&76,&65,&73,&20,&74,&6F,&20          ; 7C61 'ives to '
            defb &74,&72,&79,&2C,&1F,&01,&0D,&70          ; 7C69 'try,...p'
            defb &6C,&75,&73,&20,&31,&20,&6D,&6F          ; 7C71 'lus 1 mo'
            defb &72,&65,&20,&66,&6F,&72,&20,&65          ; 7C79 're for e'
            defb &61,&63,&68,&1F,&01,&0E,&31,&30          ; 7C81 'ach...10'
            defb &2C,&30,&30,&30,&20,&70,&74,&73          ; 7C89 ',000 pts'
            defb &2E,&20,&46,&69,&72,&73,&74,&20          ; 7C91 '. First '
            defb &6D,&79,&1F,&01,&10,&0F,&05,&57          ; 7C99 'my.....W'
            defb &48,&49,&52,&4C,&49,&4E,&47,&20          ; 7CA1 'HIRLING '
            defb &20,&20,&44,&45,&52,&56,&49,&53          ; 7CA9 '  DERVIS'
            defb &48,&45,&53,&FF,&0F,&0E,&1F,&02          ; 7CB1 'HES.....'
            defb &06,&53,&68,&65,&65,&74,&20,&6F          ; 7CB9 '.Sheet o'
            defb &6E,&65,&20,&63,&6F,&6D,&70,&6C          ; 7CC1 'ne compl'
            defb &65,&74,&65,&1F,&02,&07,&5F,&5F          ; 7CC9 'ete...__'
            defb &5F,&5F,&5F,&5F,&5F,&5F,&5F,&5F          ; 7CD1 '________'
            defb &5F,&5F,&5F,&5F,&5F,&5F,&5F,&5F          ; 7CD9 '________'
            defb &1F,&02,&09,&0F,&04,&49,&20,&74          ; 7CE1 '.....I t'
            defb &68,&69,&6E,&6B,&20,&20,&79,&6F          ; 7CE9 'hink  yo'
            defb &75,&20,&20,&77,&65,&72,&65,&1F          ; 7CF1 'u  were.'
            defb &02,&0B,&56,&45,&52,&59,&20,&20          ; 7CF9 '..VERY  '
            defb &6C,&75,&63,&6B,&79,&20,&74,&68          ; 7D01 'lucky th'
            defb &65,&72,&65,&2C,&1F,&02,&0D,&62          ; 7D09 'ere,...b'
            defb &75,&74,&20,&20,&6D,&79,&20,&20          ; 7D11 'ut  my  '
            defb &20,&0F,&02,&52,&41,&4D,&53,&48          ; 7D19 ' ..RAMSH'
            defb &49,&50,&53,&0F,&04,&1F,&02,&0F          ; 7D21 'IPS.....'
            defb &77,&69,&6C,&6C,&20,&73,&6F,&72          ; 7D29 'will sor'
            defb &74,&20,&79,&6F,&75,&20,&6F,&75          ; 7D31 't you ou'
            defb &74,&2E,&FF,&0F,&0E,&1F,&02,&06          ; 7D39 't.......'
            defb &53,&68,&65,&65,&74,&20,&74,&77          ; 7D41 'Sheet tw'
            defb &6F,&20,&63,&6F,&6D,&70,&6C,&65          ; 7D49 'o comple'
            defb &74,&65,&1F,&02,&07,&5F,&5F,&5F          ; 7D51 'te...___'
            defb &5F,&5F,&5F,&5F,&5F,&5F,&5F,&5F          ; 7D59 '________'
            defb &5F,&5F,&5F,&5F,&5F,&5F,&5F,&1F          ; 7D61 '_______.'
            defb &01,&09,&0F,&04,&53,&6F,&20,&74          ; 7D69 '....So t'
            defb &68,&65,&20,&0F,&02,&52,&41,&4D          ; 7D71 'he ..RAM'
            defb &53,&48,&49,&50,&53,&0F,&04,&20          ; 7D79 'SHIPS.. '
            defb &77,&65,&72,&65,&1F,&01,&0B,&75          ; 7D81 'were...u'
            defb &6E,&6C,&75,&63,&6B,&79,&2E,&20          ; 7D89 'nlucky. '
            defb &4E,&65,&76,&65,&72,&20,&6D,&69          ; 7D91 'Never mi'
            defb &6E,&64,&2C,&1F,&01,&0D,&6D,&79          ; 7D99 'nd,...my'
            defb &20,&20,&0F,&02,&53,&0F,&03,&50          ; 7DA1 '  ..S..P'
            defb &0F,&04,&41,&0F,&05,&43,&0F,&06          ; 7DA9 '..A..C..'
            defb &45,&20,&4D,&0F,&05,&49,&0F,&04          ; 7DB1 'E M..I..'
            defb &4E,&0F,&03,&45,&0F,&02,&53,&20          ; 7DB9 'N..E..S '
            defb &20,&0F,&04,&61,&72,&65,&1F,&01          ; 7DC1 ' ..are..'
            defb &0F,&73,&75,&72,&65,&20,&74,&6F          ; 7DC9 '.sure to'
            defb &20,&62,&6C,&6F,&77,&20,&79,&6F          ; 7DD1 ' blow yo'
            defb &75,&20,&75,&70,&2E,&FF,&0F,&0E          ; 7DD9 'u up....'
            defb &1F,&01,&06,&53,&68,&65,&65,&74          ; 7DE1 '...Sheet'
            defb &20,&74,&68,&72,&65,&65,&20,&63          ; 7DE9 ' three c'
            defb &6F,&6D,&70,&6C,&65,&74,&65,&1F          ; 7DF1 'omplete.'
            defb &01,&07,&5F,&5F,&5F,&5F,&5F,&5F          ; 7DF9 '..______'
            defb &5F,&5F,&5F,&5F,&5F,&5F,&5F,&5F          ; 7E01 '________'
            defb &5F,&5F,&5F,&5F,&5F,&5F,&1F,&01          ; 7E09 '______..'
            defb &09,&0F,&04,&59,&6F,&75,&20,&72          ; 7E11 '...You r'
            defb &65,&61,&6C,&6C,&79,&20,&61,&72          ; 7E19 'eally ar'
            defb &65,&20,&73,&6D,&61,&72,&74,&1F          ; 7E21 'e smart.'
            defb &01,&0A,&62,&75,&74,&20,&20,&49          ; 7E29 '..but  I'
            defb &27,&76,&65,&20,&6F,&6E,&6C,&79          ; 7E31 ''ve only'
            defb &20,&20,&62,&65,&65,&6E,&1F,&01          ; 7E39 '  been..'
            defb &0B,&74,&6F,&79,&69,&6E,&67,&20          ; 7E41 '.toying '
            defb &20,&77,&69,&74,&68,&20,&79,&6F          ; 7E49 ' with yo'
            defb &75,&20,&20,&73,&6F,&1F,&01,&0C          ; 7E51 'u  so...'
            defb &66,&61,&72,&2E,&20,&20,&48,&65          ; 7E59 'far.  He'
            defb &61,&72,&20,&20,&63,&6F,&6D,&65          ; 7E61 'ar  come'
            defb &20,&20,&6D,&79,&1F,&01,&0D,&0F          ; 7E69 '  my....'
            defb &0D,&49,&4E,&54,&45,&52,&53,&54          ; 7E71 '.INTERST'
            defb &45,&4C,&4C,&41,&52,&20,&20,&20          ; 7E79 'ELLAR   '
            defb &50,&4F,&47,&4F,&53,&0F,&04,&1F          ; 7E81 'POGOS...'
            defb &01,&0E,&77,&68,&6F,&20,&20,&77          ; 7E89 '..who  w'
            defb &69,&6C,&6C,&20,&20,&6A,&75,&6D          ; 7E91 'ill  jum'
            defb &70,&20,&20,&61,&6C,&6C,&1F,&01          ; 7E99 'p  all..'
            defb &0F,&6F,&76,&65,&72,&20,&79,&6F          ; 7EA1 '.over yo'
            defb &75,&2E,&FF,&0F,&0E,&1F,&01,&05          ; 7EA9 'u.......'
            defb &53,&68,&65,&65,&74,&20,&66,&6F          ; 7EB1 'Sheet fo'
            defb &75,&72,&20,&20,&63,&6F,&6D,&70          ; 7EB9 'ur  comp'
            defb &6C,&65,&74,&65,&1F,&01,&06,&5F          ; 7EC1 'lete..._'
            defb &5F,&5F,&5F,&5F,&5F,&5F,&5F,&5F          ; 7EC9 '________'
            defb &5F,&5F,&5F,&5F,&5F,&5F,&5F,&5F          ; 7ED1 '________'
            defb &5F,&5F,&5F,&1F,&01,&08,&0F,&04          ; 7ED9 '___.....'
            defb &4D,&79,&20,&0F,&0D,&47,&41,&4C          ; 7EE1 'My ..GAL'
            defb &41,&43,&54,&49,&43,&20,&20,&53          ; 7EE9 'ACTIC  S'
            defb &50,&49,&44,&45,&52,&53,&0F,&04          ; 7EF1 'PIDERS..'
            defb &1F,&01,&0A,&64,&6F,&6E,&27,&74          ; 7EF9 '...don't'
            defb &20,&20,&20,&6A,&75,&73,&74,&20          ; 7F01 '   just '
            defb &20,&20,&63,&72,&61,&77,&6C,&1F          ; 7F09 '  crawl.'
            defb &01,&0C,&61,&72,&6F,&75,&6E,&64          ; 7F11 '..around'
            defb &2E,&20,&20,&20,&54,&68,&65,&79          ; 7F19 '.   They'
            defb &20,&20,&77,&69,&6C,&6C,&1F,&01          ; 7F21 '  will..'
            defb &0E,&66,&69,&6E,&69,&73,&68,&20          ; 7F29 '.finish '
            defb &20,&79,&6F,&75,&20,&6F,&66,&66          ; 7F31 ' you off'
            defb &20,&20,&66,&6F,&72,&1F,&01,&10          ; 7F39 '  for...'
            defb &73,&75,&72,&65,&2E,&FF,&0F,&0E          ; 7F41 'sure....'
            defb &1F,&01,&06,&53,&68,&65,&65,&74          ; 7F49 '...Sheet'
            defb &20,&66,&69,&76,&65,&20,&20,&63          ; 7F51 ' five  c'
            defb &6F,&6D,&70,&6C,&65,&74,&65,&1F          ; 7F59 'omplete.'
            defb &01,&07,&5F,&5F,&5F,&5F,&5F,&5F          ; 7F61 '..______'
            defb &5F,&5F,&5F,&5F,&5F,&5F,&5F,&5F          ; 7F69 '________'
            defb &5F,&5F,&5F,&5F,&5F,&5F,&1F,&01          ; 7F71 '______..'
            defb &09,&0F,&04,&53,&6F,&20,&20,&77          ; 7F79 '...So  w'
            defb &68,&61,&74,&20,&20,&61,&72,&65          ; 7F81 'hat  are'
            defb &20,&61,&20,&20,&66,&65,&77,&0F          ; 7F89 ' a  few.'
            defb &0D,&1F,&01,&0A,&53,&50,&49,&44          ; 7F91 '....SPID'
            defb &45,&52,&53,&2E,&0F,&04,&20,&20          ; 7F99 'ERS...  '
            defb &20,&49,&27,&6C,&6C,&20,&20,&62          ; 7FA1 ' I'll  b'
            defb &65,&74,&1F,&01,&0B,&74,&68,&61          ; 7FA9 'et...tha'
            defb &74,&20,&0F,&02,&43,&0F,&06,&4F          ; 7FB1 't ..C..O'
            defb &0F,&02,&53,&0F,&06,&4D,&0F,&02          ; 7FB9 '..S..M..'
            defb &49,&0F,&06,&43,&20,&53,&0F,&02          ; 7FC1 'I..C S..'
            defb &50,&0F,&06,&49,&0F,&02,&4E,&0F          ; 7FC9 'P..I..N.'
            defb &06,&4E,&0F,&02,&45,&0F,&06,&52          ; 7FD1 '.N..E..R'
            defb &0F,&02,&53,&0F,&04,&1F,&01,&0C          ; 7FD9 '..S.....'
            defb &77,&6F,&6E,&27,&74,&20,&20,&20          ; 7FE1 'won't   '
            defb &62,&65,&20,&20,&73,&75,&63,&68          ; 7FE9 'be  such'
            defb &20,&20,&20,&61,&1F,&01,&0D,&70          ; 7FF1 '   a...p'
            defb &75,&73,&68,&6F,&76,&65,&72,&2E          ; 7FF9 'ushover.'
            defb &20,&20,&20,&49,&20,&20,&74,&68          ; 8001 '   I  th'
            defb &69,&6E,&6B,&1F,&01,&0E,&79,&6F          ; 8009 'ink...yo'
            defb &75,&72,&20,&65,&6E,&64,&20,&69          ; 8011 'ur end i'
            defb &73,&20,&6E,&65,&61,&72,&2E,&FF          ; 8019 's near..'
            defb &0F,&0E,&1F,&02,&06,&53,&68,&65          ; 8021 '.....She'
            defb &65,&74,&20,&73,&69,&78,&20,&63          ; 8029 'et six c'
            defb &6F,&6D,&70,&6C,&65,&74,&65,&1F          ; 8031 'omplete.'
            defb &02,&07,&5F,&5F,&5F,&5F,&5F,&5F          ; 8039 '..______'
            defb &5F,&5F,&5F,&5F,&5F,&5F,&5F,&5F          ; 8041 '________'
            defb &5F,&5F,&5F,&5F,&1F,&01,&09,&0F          ; 8049 '____....'
            defb &04,&4D,&61,&79,&62,&65,&20,&20          ; 8051 '.Maybe  '
            defb &20,&79,&6F,&75,&20,&20,&61,&72          ; 8059 ' you  ar'
            defb &65,&20,&20,&20,&61,&1F,&01,&0A          ; 8061 'e   a...'
            defb &72,&65,&61,&73,&6F,&6E,&61,&62          ; 8069 'reasonab'
            defb &6C,&65,&20,&20,&66,&69,&67,&68          ; 8071 'le  figh'
            defb &74,&65,&72,&2C,&1F,&01,&0B,&6D          ; 8079 'ter,...m'
            defb &61,&79,&62,&65,&20,&20,&6E,&6F          ; 8081 'aybe  no'
            defb &74,&2C,&20,&20,&62,&75,&74,&20          ; 8089 't,  but '
            defb &20,&6D,&79,&1F,&01,&0C,&0F,&06          ; 8091 ' my.....'
            defb &41,&52,&4D,&4F,&55,&52,&45,&44          ; 8099 'ARMOURED'
            defb &20,&44,&52,&4F,&49,&44,&53,&20          ; 80A1 ' DROIDS '
            defb &20,&0F,&04,&61,&72,&65,&1F,&01          ; 80A9 ' ..are..'
            defb &0D,&75,&74,&74,&65,&72,&6C,&79          ; 80B1 '.utterly'
            defb &20,&20,&20,&64,&65,&64,&69,&63          ; 80B9 '   dedic'
            defb &61,&74,&65,&64,&2C,&1F,&01,&0E          ; 80C1 'ated,...'
            defb &61,&6E,&64,&20,&76,&65,&72,&79          ; 80C9 'and very'
            defb &20,&6D,&65,&61,&6E,&2E,&FF,&0F          ; 80D1 ' mean...'
            defb &0E,&1F,&01,&05,&53,&68,&65,&65          ; 80D9 '....Shee'
            defb &74,&20,&73,&65,&76,&65,&6E,&20          ; 80E1 't seven '
            defb &63,&6F,&6D,&70,&6C,&65,&74,&65          ; 80E9 'complete'
            defb &1F,&01,&06,&5F,&5F,&5F,&5F,&5F          ; 80F1 '..._____'
            defb &5F,&5F,&5F,&5F,&5F,&5F,&5F,&5F          ; 80F9 '________'
            defb &5F,&5F,&5F,&5F,&5F,&5F,&5F,&1F          ; 8101 '_______.'
            defb &01,&08,&0F,&04,&49,&27,&6D,&20          ; 8109 '....I'm '
            defb &20,&20,&6E,&6F,&74,&20,&20,&20          ; 8111 '  not   '
            defb &66,&69,&6E,&69,&73,&68,&65,&64          ; 8119 'finished'
            defb &1F,&01,&0A,&79,&65,&74,&2E,&20          ; 8121 '...yet. '
            defb &20,&4D,&79,&20,&20,&0F,&02,&48          ; 8129 ' My  ..H'
            defb &59,&50,&45,&52,&0F,&03,&53,&50          ; 8131 'YPER..SP'
            defb &41,&43,&45,&1F,&01,&0C,&0F,&0A          ; 8139 'ACE.....'
            defb &43,&48,&49,&43,&4B,&45,&4E,&53          ; 8141 'CHICKENS'
            defb &20,&20,&0F,&04,&68,&61,&76,&65          ; 8149 '  ..have'
            defb &20,&67,&6F,&74,&20,&61,&1F,&01          ; 8151 ' got a..'
            defb &0E,&66,&65,&77,&20,&20,&73,&75          ; 8159 '.few  su'
            defb &72,&70,&72,&69,&73,&65,&73,&20          ; 8161 'rprises '
            defb &20,&20,&66,&6F,&72,&1F,&01,&10          ; 8169 '  for...'
            defb &79,&6F,&75,&2E,&FF,&0F,&0E,&1F          ; 8171 'you.....'
            defb &01,&06,&53,&68,&65,&65,&74,&20          ; 8179 '..Sheet '
            defb &65,&69,&67,&68,&74,&20,&63,&6F          ; 8181 'eight co'
            defb &6D,&70,&6C,&65,&74,&65,&1F,&01          ; 8189 'mplete..'
            defb &07,&5F,&5F,&5F,&5F,&5F,&5F,&5F          ; 8191 '._______'
            defb &5F,&5F,&5F,&5F,&5F,&5F,&5F,&5F          ; 8199 '________'
            defb &5F,&5F,&5F,&5F,&5F,&1F,&01,&09          ; 81A1 '_____...'
            defb &0F,&04,&59,&6F,&75,&20,&72,&65          ; 81A9 '..You re'
            defb &61,&6C,&6C,&79,&20,&61,&72,&65          ; 81B1 'ally are'
            defb &20,&67,&6F,&6F,&64,&21,&1F,&01          ; 81B9 ' good!..'
            defb &0B,&4E,&6F,&77,&20,&20,&69,&74          ; 81C1 '.Now  it'
            defb &20,&69,&73,&20,&6A,&75,&73,&74          ; 81C9 ' is just'
            defb &20,&20,&79,&6F,&75,&1F,&01,&0D          ; 81D1 '  you...'
            defb &76,&65,&72,&73,&75,&73,&20,&20          ; 81D9 'versus  '
            defb &6D,&65,&20,&2E,&2E,&2E,&2E,&20          ; 81E1 'me .... '
            defb &20,&74,&68,&65,&1F,&01,&0F,&0F          ; 81E9 ' the....'
            defb &0A,&20,&20,&20,&20,&4D,&20,&41          ; 81F1 '.    M A'
            defb &20,&53,&20,&54,&20,&45,&20,&52          ; 81F9 ' S T E R'
            defb &FF,&0F,&0E,&1F,&01,&06,&53,&68          ; 8201 '......Sh'
            defb &65,&65,&74,&20,&6E,&69,&6E,&65          ; 8209 'eet nine'
            defb &20,&20,&63,&6F,&6D,&70,&6C,&65          ; 8211 '  comple'
            defb &74,&65,&1F,&01,&07,&5F,&5F,&5F          ; 8219 'te...___'
            defb &5F,&5F,&5F,&5F,&5F,&5F,&5F,&5F          ; 8221 '________'
            defb &5F,&5F,&5F,&5F,&5F,&5F,&5F,&5F          ; 8229 '________'
            defb &5F,&1F,&01,&09,&0F,&04,&59,&6F          ; 8231 '_.....Yo'
            defb &75,&20,&64,&65,&66,&65,&61,&74          ; 8239 'u defeat'
            defb &65,&64,&20,&6D,&65,&20,&74,&68          ; 8241 'ed me th'
            defb &61,&74,&1F,&01,&0A,&74,&69,&6D          ; 8249 'at...tim'
            defb &65,&2C,&20,&20,&20,&62,&75,&74          ; 8251 'e,   but'
            defb &20,&20,&49,&20,&20,&77,&69,&6C          ; 8259 '  I  wil'
            defb &6C,&1F,&01,&0B,&72,&65,&74,&75          ; 8261 'l...retu'
            defb &72,&6E,&2E,&20,&20,&54,&68,&69          ; 8269 'rn.  Thi'
            defb &73,&20,&74,&69,&6D,&65,&20,&49          ; 8271 's time I'
            defb &1F,&01,&0C,&77,&69,&6C,&6C,&20          ; 8279 '...will '
            defb &68,&61,&76,&65,&20,&65,&76,&65          ; 8281 'have eve'
            defb &6E,&20,&20,&6D,&6F,&72,&65,&1F          ; 8289 'n  more.'
            defb &01,&0D,&6F,&66,&20,&20,&20,&6D          ; 8291 '..of   m'
            defb &79,&20,&20,&66,&6F,&72,&63,&65          ; 8299 'y  force'
            defb &73,&20,&20,&20,&74,&6F,&1F,&01          ; 82A1 's   to..'
            defb &0E,&66,&69,&67,&68,&74,&20,&79          ; 82A9 '.fight y'
            defb &6F,&75,&2C,&20,&20,&61,&6E,&64          ; 82B1 'ou,  and'
            defb &20,&74,&68,&65,&79,&1F,&01,&0F          ; 82B9 ' they...'
            defb &77,&69,&6C,&6C,&20,&20,&62,&65          ; 82C1 'will  be'
            defb &20,&73,&74,&72,&6F,&6E,&67,&65          ; 82C9 ' stronge'
            defb &72,&2E,&FF,&0F,&08,&1F,&01,&13          ; 82D1 'r.......'
            defb &5F,&5F,&5F,&5F,&5F,&5F,&5F,&5F          ; 82D9 '________'
            defb &5F,&5F,&5F,&5F,&5F,&5F,&5F,&5F          ; 82E1 '________'
            defb &5F,&5F,&5F,&5F,&0F,&04,&1F,&01          ; 82E9 '____....'
            defb &15,&53,&68,&6F,&6F,&74,&20,&74          ; 82F1 '.Shoot t'
            defb &68,&65,&20,&20,&41,&76,&6F,&69          ; 82F9 'he  Avoi'
            defb &64,&20,&74,&68,&65,&1F,&10,&17          ; 8301 'd the...'
            defb &2B,&1F,&03,&19,&46,&69,&72,&65          ; 8309 '+...Fire'
            defb &20,&74,&6F,&20,&63,&6F,&6E,&74          ; 8311 ' to cont'
            defb &69,&6E,&75,&65,&FF,&30,&83,&9B          ; 8319 'inue.0..'
            defb &83,&0E,&84,&AD,&84,&48,&85,&E8          ; 8321 '.....H..'
            defb &85,&91,&86,&2C,&87,&B5,&87,&1F          ; 8329 '...,....'
            defb &01,&0B,&0F,&05,&49,&20,&74,&68          ; 8331 '....I th'
            defb &6F,&75,&67,&68,&74,&20,&79,&6F          ; 8339 'ought yo'
            defb &75,&27,&64,&20,&67,&69,&76,&65          ; 8341 'u'd give'
            defb &1F,&01,&0D,&6D,&65,&20,&20,&6D          ; 8349 '...me  m'
            defb &6F,&72,&65,&20,&20,&6F,&70,&70          ; 8351 'ore  opp'
            defb &6F,&73,&69,&74,&69,&6F,&6E,&1F          ; 8359 'osition.'
            defb &01,&0F,&74,&68,&61,&6E,&20,&20          ; 8361 '..than  '
            defb &74,&68,&61,&74,&2E,&20,&20,&20          ; 8369 'that.   '
            defb &42,&65,&74,&74,&65,&72,&1F,&01          ; 8371 'Better..'
            defb &11,&74,&72,&79,&20,&20,&61,&67          ; 8379 '.try  ag'
            defb &61,&69,&6E,&2E,&1F,&03,&19,&0F          ; 8381 'ain.....'
            defb &0E,&46,&69,&72,&65,&20,&74,&6F          ; 8389 '.Fire to'
            defb &20,&63,&6F,&6E,&74,&69,&6E,&75          ; 8391 ' continu'
            defb &65,&FF,&1F,&01,&0B,&0F,&05,&54          ; 8399 'e......T'
            defb &68,&6F,&75,&67,&68,&74,&20,&73          ; 83A1 'hought s'
            defb &6F,&21,&20,&49,&74,&27,&73,&20          ; 83A9 'o! It's '
            defb &6E,&6F,&74,&1F,&01,&0D,&73,&6F          ; 83B1 'not...so'
            defb &20,&65,&61,&73,&79,&20,&74,&6F          ; 83B9 ' easy to'
            defb &20,&20,&6F,&76,&65,&72,&63,&6F          ; 83C1 '  overco'
            defb &6D,&65,&1F,&01,&0F,&6D,&79,&20          ; 83C9 'me...my '
            defb &20,&66,&6F,&72,&63,&65,&73,&2C          ; 83D1 ' forces,'
            defb &20,&20,&69,&73,&20,&20,&69,&74          ; 83D9 '  is  it'
            defb &2E,&1F,&01,&11,&53,&74,&69,&6C          ; 83E1 '....Stil'
            defb &6C,&2C,&20,&6B,&65,&65,&70,&20          ; 83E9 'l, keep '
            defb &74,&72,&79,&69,&6E,&67,&2E,&1F          ; 83F1 'trying..'
            defb &03,&19,&0F,&0E,&46,&69,&72,&65          ; 83F9 '....Fire'
            defb &20,&74,&6F,&20,&63,&6F,&6E,&74          ; 8401 ' to cont'
            defb &69,&6E,&75,&65,&FF,&1F,&01,&0A          ; 8409 'inue....'
            defb &0F,&05,&53,&69,&6D,&70,&6C,&65          ; 8411 '..Simple'
            defb &20,&20,&0F,&02,&53,&0F,&03,&50          ; 8419 '  ..S..P'
            defb &0F,&04,&41,&0F,&05,&43,&0F,&06          ; 8421 '..A..C..'
            defb &45,&20,&20,&4D,&0F,&05,&49,&0F          ; 8429 'E  M..I.'
            defb &04,&4E,&0F,&03,&45,&0F,&02,&53          ; 8431 '.N..E..S'
            defb &1F,&01,&0C,&0F,&05,&77,&69,&70          ; 8439 '.....wip'
            defb &65,&64,&20,&20,&20,&6F,&75,&74          ; 8441 'ed   out'
            defb &20,&20,&45,&61,&72,&74,&68,&27          ; 8449 '  Earth''
            defb &73,&1F,&01,&0E,&67,&72,&65,&61          ; 8451 's...grea'
            defb &74,&65,&73,&74,&20,&20,&20,&64          ; 8459 'test   d'
            defb &65,&66,&65,&6E,&64,&65,&72,&3F          ; 8461 'efender?'
            defb &1F,&01,&10,&53,&75,&72,&65,&6C          ; 8469 '...Surel'
            defb &79,&20,&20,&20,&79,&6F,&75,&20          ; 8471 'y   you '
            defb &20,&61,&72,&65,&6E,&27,&74,&1F          ; 8479 ' aren't.'
            defb &01,&12,&67,&6F,&69,&6E,&67,&20          ; 8481 '..going '
            defb &74,&6F,&20,&73,&74,&6F,&70,&20          ; 8489 'to stop '
            defb &74,&68,&65,&72,&65,&3F,&1F,&03          ; 8491 'there?..'
            defb &19,&0F,&0E,&46,&69,&72,&65,&20          ; 8499 '...Fire '
            defb &74,&6F,&20,&63,&6F,&6E,&74,&69          ; 84A1 'to conti'
            defb &6E,&75,&65,&FF,&1F,&01,&09,&0F          ; 84A9 'nue.....'
            defb &05,&57,&68,&6F,&20,&20,&67,&6F          ; 84B1 '.Who  go'
            defb &74,&20,&20,&6A,&75,&6D,&70,&65          ; 84B9 't  jumpe'
            defb &64,&20,&20,&6F,&6E,&1F,&01,&0B          ; 84C1 'd  on...'
            defb &74,&68,&65,&6E,&3F,&20,&20,&4A          ; 84C9 'then?  J'
            defb &75,&73,&74,&20,&77,&68,&65,&6E          ; 84D1 'ust when'
            defb &20,&79,&6F,&75,&1F,&01,&0D,&77          ; 84D9 ' you...w'
            defb &65,&72,&65,&20,&20,&20,&67,&65          ; 84E1 'ere   ge'
            defb &74,&74,&69,&6E,&67,&20,&20,&69          ; 84E9 'tting  i'
            defb &6E,&74,&6F,&1F,&01,&0F,&74,&68          ; 84F1 'nto...th'
            defb &65,&20,&73,&77,&69,&6E,&67,&20          ; 84F9 'e swing '
            defb &6F,&66,&20,&74,&68,&69,&6E,&67          ; 8501 'of thing'
            defb &73,&2E,&1F,&01,&11,&59,&6F,&75          ; 8509 's....You'
            defb &20,&20,&63,&61,&6E,&27,&74,&20          ; 8511 '  can't '
            defb &20,&6C,&65,&74,&20,&20,&20,&69          ; 8519 ' let   i'
            defb &74,&1F,&01,&13,&72,&65,&73,&74          ; 8521 't...rest'
            defb &20,&61,&74,&20,&74,&68,&61,&74          ; 8529 ' at that'
            defb &2E,&1F,&03,&19,&0F,&0E,&46,&69          ; 8531 '......Fi'
            defb &72,&65,&20,&74,&6F,&20,&63,&6F          ; 8539 're to co'
            defb &6E,&74,&69,&6E,&75,&65,&FF,&1F          ; 8541 'ntinue..'
            defb &01,&09,&0F,&05,&49,&20,&20,&77          ; 8549 '....I  w'
            defb &61,&72,&6E,&65,&64,&20,&20,&79          ; 8551 'arned  y'
            defb &6F,&75,&2E,&20,&20,&57,&68,&79          ; 8559 'ou.  Why'
            defb &1F,&01,&0B,&6E,&6F,&74,&20,&20          ; 8561 '...not  '
            defb &73,&74,&69,&63,&6B,&20,&20,&74          ; 8569 'stick  t'
            defb &6F,&20,&20,&79,&6F,&75,&72,&1F          ; 8571 'o  your.'
            defb &01,&0D,&73,&69,&6D,&70,&6C,&65          ; 8579 '..simple'
            defb &20,&45,&61,&72,&74,&68,&20,&73          ; 8581 ' Earth s'
            defb &70,&69,&64,&65,&72,&73,&1F,&01          ; 8589 'piders..'
            defb &0F,&69,&6E,&73,&74,&65,&61,&64          ; 8591 '.instead'
            defb &3F,&20,&20,&20,&4F,&72,&20,&20          ; 8599 '?   Or  '
            defb &6D,&61,&79,&62,&65,&1F,&01,&11          ; 85A1 'maybe...'
            defb &79,&6F,&75,&20,&20,&20,&20,&66          ; 85A9 'you    f'
            defb &61,&6E,&63,&79,&20,&20,&20,&20          ; 85B1 'ancy    '
            defb &79,&6F,&75,&72,&1F,&01,&13,&63          ; 85B9 'your...c'
            defb &68,&61,&6E,&63,&65,&73,&20,&6E          ; 85C1 'hances n'
            defb &65,&78,&74,&20,&74,&69,&6D,&65          ; 85C9 'ext time'
            defb &3F,&1F,&03,&19,&0F,&0E,&46,&69          ; 85D1 '?.....Fi'
            defb &72,&65,&20,&74,&6F,&20,&63,&6F          ; 85D9 're to co'
            defb &6E,&74,&69,&6E,&75,&65,&FF,&1F          ; 85E1 'ntinue..'
            defb &01,&08,&0F,&05,&59,&6F,&75,&20          ; 85E9 '....You '
            defb &20,&20,&63,&6F,&75,&6C,&64,&20          ; 85F1 '  could '
            defb &20,&20,&62,&65,&63,&6F,&6D,&65          ; 85F9 '  become'
            defb &1F,&01,&0A,&66,&61,&69,&72,&6C          ; 8601 '...fairl'
            defb &79,&20,&20,&20,&20,&72,&65,&61          ; 8609 'y    rea'
            defb &73,&6F,&6E,&61,&62,&6C,&65,&1F          ; 8611 'sonable.'
            defb &01,&0C,&77,&69,&74,&68,&20,&20          ; 8619 '..with  '
            defb &20,&61,&20,&20,&6C,&6F,&74,&20          ; 8621 ' a  lot '
            defb &20,&20,&6D,&6F,&72,&65,&1F,&01          ; 8629 '  more..'
            defb &0E,&70,&72,&61,&63,&74,&69,&63          ; 8631 '.practic'
            defb &65,&2E,&20,&53,&74,&69,&6C,&6C          ; 8639 'e. Still'
            defb &2C,&20,&79,&6F,&75,&1F,&01,&10          ; 8641 ', you...'
            defb &77,&6F,&6E,&27,&74,&20,&20,&67          ; 8649 'won't  g'
            defb &65,&74,&20,&20,&69,&74,&20,&20          ; 8651 'et  it  '
            defb &6A,&75,&73,&74,&1F,&01,&12,&73          ; 8659 'just...s'
            defb &69,&74,&74,&69,&6E,&67,&20,&74          ; 8661 'itting t'
            defb &68,&65,&72,&65,&2C,&20,&20,&77          ; 8669 'here,  w'
            defb &69,&6C,&6C,&1F,&01,&14,&79,&6F          ; 8671 'ill...yo'
            defb &75,&3F,&1F,&03,&19,&0F,&0E,&46          ; 8679 'u?.....F'
            defb &69,&72,&65,&20,&74,&6F,&20,&63          ; 8681 'ire to c'
            defb &6F,&6E,&74,&69,&6E,&75,&65,&FF          ; 8689 'ontinue.'
            defb &1F,&01,&09,&0F,&05,&53,&6F,&20          ; 8691 '.....So '
            defb &20,&6E,&65,&61,&72,&20,&61,&6E          ; 8699 ' near an'
            defb &64,&20,&79,&65,&74,&20,&20,&73          ; 86A1 'd yet  s'
            defb &6F,&1F,&01,&0B,&66,&61,&72,&21          ; 86A9 'o...far!'
            defb &20,&20,&4F,&6E,&6C,&79,&20,&20          ; 86B1 '  Only  '
            defb &74,&77,&6F,&20,&6D,&6F,&72,&65          ; 86B9 'two more'
            defb &1F,&01,&0D,&64,&65,&66,&65,&6E          ; 86C1 '...defen'
            defb &63,&65,&73,&20,&20,&20,&61,&6E          ; 86C9 'ces   an'
            defb &64,&20,&20,&20,&79,&6F,&75,&1F          ; 86D1 'd   you.'
            defb &01,&0F,&77,&6F,&75,&6C,&64,&20          ; 86D9 '..would '
            defb &20,&68,&61,&76,&65,&20,&20,&68          ; 86E1 ' have  h'
            defb &61,&64,&20,&20,&20,&61,&1F,&01          ; 86E9 'ad   a..'
            defb &11,&63,&72,&61,&63,&6B,&20,&20          ; 86F1 '.crack  '
            defb &61,&74,&20,&20,&6D,&65,&2C,&20          ; 86F9 'at  me, '
            defb &20,&20,&74,&68,&65,&1F,&05,&13          ; 8701 '  the...'
            defb &0F,&06,&4D,&20,&41,&20,&53,&20          ; 8709 '..M A S '
            defb &54,&20,&45,&20,&52,&1F,&03,&19          ; 8711 'T E R...'
            defb &0F,&0E,&46,&69,&72,&65,&20,&74          ; 8719 '..Fire t'
            defb &6F,&20,&63,&6F,&6E,&74,&69,&6E          ; 8721 'o contin'
            defb &75,&65,&FF,&1F,&01,&0A,&0F,&05          ; 8729 'ue......'
            defb &48,&55,&48,&21,&20,&20,&20,&49          ; 8731 'HUH!   I'
            defb &20,&20,&20,&6B,&6E,&65,&77,&20          ; 8739 '   knew '
            defb &20,&79,&6F,&75,&1F,&01,&0C,&77          ; 8741 ' you...w'
            defb &6F,&75,&6C,&64,&6E,&27,&74,&20          ; 8749 'ouldn't '
            defb &6D,&61,&6B,&65,&20,&69,&74,&2E          ; 8751 'make it.'
            defb &20,&20,&49,&1F,&01,&0E,&77,&61          ; 8759 '  I...wa'
            defb &73,&20,&20,&6A,&75,&73,&74,&20          ; 8761 's  just '
            defb &20,&74,&6F,&6F,&20,&20,&67,&6F          ; 8769 ' too  go'
            defb &6F,&64,&1F,&01,&10,&66,&6F,&72          ; 8771 'od...for'
            defb &20,&79,&6F,&75,&2C,&20,&20,&77          ; 8779 ' you,  w'
            defb &61,&73,&6E,&27,&74,&20,&20,&49          ; 8781 'asn't  I'
            defb &3F,&1F,&01,&12,&43,&6F,&6D,&65          ; 8789 '?...Come'
            defb &20,&6F,&6E,&2C,&20,&61,&64,&6D          ; 8791 ' on, adm'
            defb &69,&74,&20,&69,&74,&2E,&1F,&03          ; 8799 'it it...'
            defb &19,&0F,&0E,&46,&69,&72,&65,&20          ; 87A1 '...Fire '
            defb &74,&6F,&20,&63,&6F,&6E,&74,&69          ; 87A9 'to conti'
            defb &6E,&75,&65,&FF,&1F,&01,&08,&0F          ; 87B1 'nue.....'
            defb &05,&59,&6F,&75,&20,&20,&6D,&61          ; 87B9 '.You  ma'
            defb &79,&20,&20,&68,&61,&76,&65,&20          ; 87C1 'y  have '
            defb &20,&62,&65,&65,&6E,&1F,&01,&0A          ; 87C9 ' been...'
            defb &6C,&75,&63,&6B,&79,&20,&65,&6E          ; 87D1 'lucky en'
            defb &6F,&75,&67,&68,&20,&74,&6F,&20          ; 87D9 'ough to '
            defb &77,&69,&70,&65,&1F,&01,&0C,&6F          ; 87E1 'wipe...o'
            defb &75,&74,&20,&6D,&79,&20,&66,&6F          ; 87E9 'ut my fo'
            defb &72,&63,&65,&73,&2C,&20,&62,&75          ; 87F1 'rces, bu'
            defb &74,&20,&49,&1F,&01,&0E,&77,&61          ; 87F9 't I...wa'
            defb &73,&20,&74,&6F,&6F,&20,&67,&6F          ; 8801 's too go'
            defb &6F,&64,&20,&66,&6F,&72,&20,&79          ; 8809 'od for y'
            defb &6F,&75,&1F,&01,&10,&69,&6E,&20          ; 8811 'ou...in '
            defb &74,&68,&65,&20,&20,&65,&6E,&64          ; 8819 'the  end'
            defb &2E,&20,&20,&57,&6F,&72,&74,&68          ; 8821 '.  Worth'
            defb &79,&1F,&01,&12,&6F,&70,&70,&6F          ; 8829 'y...oppo'
            defb &6E,&65,&6E,&74,&73,&20,&61,&72          ; 8831 'nents ar'
            defb &65,&20,&61,&6C,&77,&61,&79,&73          ; 8839 'e always'
            defb &1F,&01,&14,&77,&65,&6C,&63,&6F          ; 8841 '...welco'
            defb &6D,&65,&20,&20,&74,&68,&6F,&75          ; 8849 'me  thou'
            defb &67,&68,&2C,&20,&20,&73,&6F,&1F          ; 8851 'gh,  so.'
            defb &01,&16,&77,&68,&79,&20,&6E,&6F          ; 8859 '..why no'
            defb &74,&20,&74,&72,&79,&20,&61,&67          ; 8861 't try ag'
            defb &61,&69,&6E,&3F,&1F,&03,&19,&0F          ; 8869 'ain?....'
            defb &0E,&46,&69,&72,&65,&20,&74,&6F          ; 8871 '.Fire to'
            defb &20,&63,&6F,&6E,&74,&69,&6E,&75          ; 8879 ' continu'
            defb &65,&FF                                  ; 8881 'e.'
            ld hl,&6BDA                 ; 8883
            ld b,&03                    ; 8886
            ld c,&0A                    ; 8888
            ld e,&1C                    ; 888A
L_888C:
            ld (hl),c                   ; 888C
            inc hl                      ; 888D
            ld (hl),e                   ; 888E
            inc hl                      ; 888F
            ld a,c                      ; 8890
            add a,&37                   ; 8891
            ld c,a                      ; 8893
            ld a,e                      ; 8894
            add a,&2C                   ; 8895
            ld e,a                      ; 8897
            djnz L_888C                 ; 8898
            ret                         ; 889A

; -------- &889B+  data / tables --------
            defb &00,&00,&00,&00,&00,&00,&00,&00          ; 889B '........'
            defb &00,&00,&00,&00,&00,&00,&00,&00          ; 88A3 '........'
            defb &00,&00,&00,&00,&00,&00,&00,&00          ; 88AB '........'
            defb &00,&00,&00,&00,&00,&00,&00,&00          ; 88B3 '........'
            defb &00,&00,&00,&00,&00,&00,&00,&00          ; 88BB '........'
            defb &00,&00,&00,&00,&00,&00,&00,&00          ; 88C3 '........'
            defb &00                                      ; 88CB '.'
            nop                         ; 88CC
            nop                         ; 88CD
            nop                         ; 88CE
            nop                         ; 88CF
            nop                         ; 88D0
            nop                         ; 88D1
            nop                         ; 88D2
            nop                         ; 88D3
            nop                         ; 88D4
            nop                         ; 88D5
            nop                         ; 88D6
            nop                         ; 88D7
            nop                         ; 88D8
            nop                         ; 88D9
            nop                         ; 88DA
            nop                         ; 88DB
            nop                         ; 88DC
            nop                         ; 88DD
            nop                         ; 88DE
            nop                         ; 88DF
            nop                         ; 88E0
            nop                         ; 88E1
            nop                         ; 88E2
            nop                         ; 88E3
            nop                         ; 88E4
            nop                         ; 88E5
            nop                         ; 88E6
            nop                         ; 88E7
            nop                         ; 88E8
            nop                         ; 88E9
            nop                         ; 88EA
            nop                         ; 88EB
            nop                         ; 88EC
            nop                         ; 88ED
            nop                         ; 88EE
            nop                         ; 88EF
            nop                         ; 88F0
            nop                         ; 88F1
            nop                         ; 88F2
            nop                         ; 88F3
            nop                         ; 88F4
            nop                         ; 88F5
            nop                         ; 88F6
            nop                         ; 88F7
            nop                         ; 88F8
            nop                         ; 88F9
            nop                         ; 88FA
            nop                         ; 88FB
            nop                         ; 88FC
            nop                         ; 88FD
            nop                         ; 88FE
            nop                         ; 88FF
